/*
 * SPDX-FileCopyrightText: 2022-2026 Espressif Systems (Shanghai) CO LTD
 * SPDX-FileCopyrightText: 2026 Peter M. <petermm@gmail.com>
 *
 * SPDX-License-Identifier: Apache-2.0 OR BSD-2-Clause
 */
/* ESP32-H2 public ROM ABI, from ESP-IDF release/v6.1
 * (9a97f6c54ec638111ce55cd36581b3c192f15207), esp32h2.rom.ld,
 * esp32h2.rom.spiflash.ld, esp32h2.rom.api.ld and esp32h2.rom.version.ld.
 * Every symbol is wrapped in PROVIDE so an application definition wins.
 */
SECTIONS {
  PROVIDE ( Cache_Address_Through_Cache = 0x40000604 ) ;
  PROVIDE ( Cache_Config_ICache_Autoload = 0x40000640 ) ;
  PROVIDE ( Cache_Disable_ICache = 0x40000664 ) ;
  PROVIDE ( Cache_Disable_ICache_Autoload = 0x40000648 ) ;
  PROVIDE ( Cache_Disable_ICache_PreLock = 0x40000650 ) ;
  PROVIDE ( Cache_Enable_ICache = 0x40000668 ) ;
  PROVIDE ( Cache_Enable_ICache_Autoload = 0x40000644 ) ;
  PROVIDE ( Cache_Enable_ICache_PreLock = 0x4000064c ) ;
  PROVIDE ( Cache_End_ICache_Preload = 0x4000063c ) ;
  PROVIDE ( Cache_Freeze_ICache_Disable = 0x40000678 ) ;
  PROVIDE ( Cache_Freeze_ICache_Enable = 0x40000674 ) ;
  PROVIDE ( Cache_Get_DROM_MMU_End = 0x40000684 ) ;
  PROVIDE ( Cache_Get_ICache_Line_Size = 0x400005fc ) ;
  PROVIDE ( Cache_Get_IROM_MMU_End = 0x40000680 ) ;
  PROVIDE ( Cache_Get_Mode = 0x40000600 ) ;
  PROVIDE ( Cache_Get_Virtual_Addr = 0x40000694 ) ;
  PROVIDE ( Cache_ICache_Preload_Done = 0x40000638 ) ;
  PROVIDE ( Cache_Invalidate_Addr = 0x4000061c ) ;
  PROVIDE ( Cache_Invalidate_ICache_All = 0x40000620 ) ;
  PROVIDE ( Cache_Invalidate_ICache_Items = 0x40000614 ) ;
  PROVIDE ( Cache_Lock_Addr = 0x4000065c ) ;
  PROVIDE ( Cache_Lock_ICache_Items = 0x40000654 ) ;
  PROVIDE ( Cache_MMU_Init = 0x40000688 ) ;
  PROVIDE ( Cache_MSPI_MMU_Set = 0x4000068c ) ;
  PROVIDE ( Cache_Mask_All = 0x40000624 ) ;
  PROVIDE ( Cache_Op_Addr = 0x40000618 ) ;
  PROVIDE ( Cache_Resume_ICache = 0x40000670 ) ;
  PROVIDE ( Cache_Resume_ICache_Autoload = 0x40000630 ) ;
  PROVIDE ( Cache_Set_IDROM_MMU_Size = 0x4000067c ) ;
  PROVIDE ( Cache_Start_ICache_Preload = 0x40000634 ) ;
  PROVIDE ( Cache_Suspend_ICache = 0x4000066c ) ;
  PROVIDE ( Cache_Suspend_ICache_Autoload = 0x4000062c ) ;
  PROVIDE ( Cache_Travel_Tag_Memory = 0x40000690 ) ;
  PROVIDE ( Cache_UnMask_Dram0 = 0x40000628 ) ;
  PROVIDE ( Cache_Unlock_Addr = 0x40000660 ) ;
  PROVIDE ( Cache_Unlock_ICache_Items = 0x40000658 ) ;
  PROVIDE ( Disable_QMode = 0x400001cc ) ;
  PROVIDE ( Enable_QMode = 0x400001d0 ) ;
  PROVIDE ( GetSecurityInfoProc = 0x400000bc ) ;
  PROVIDE ( GetUartDevice = 0x400000b4 ) ;
  PROVIDE ( MD5Final = 0x40000720 ) ;
  PROVIDE ( MD5Init = 0x40000718 ) ;
  PROVIDE ( MD5Update = 0x4000071c ) ;
  PROVIDE ( MMU_Get_Page_Mode = 0x40000610 ) ;
  PROVIDE ( MMU_Set_Page_Mode = 0x4000060c ) ;
  PROVIDE ( ROM_Boot_Cache_Init = 0x40000608 ) ;
  PROVIDE ( SPIEraseArea = 0x40000150 ) ;
  PROVIDE ( SPILock = 0x40000194 ) ;
  PROVIDE ( SPIMasterReadModeCnfig = 0x40000198 ) ;
  PROVIDE ( SPI_Common_Command = 0x4000019c ) ;
  PROVIDE ( SPI_WakeUp = 0x400001a0 ) ;
  PROVIDE ( SPI_block_erase = 0x400001a4 ) ;
  PROVIDE ( SPI_chip_erase = 0x400001a8 ) ;
  PROVIDE ( SPI_init = 0x400001ac ) ;
  PROVIDE ( SPI_page_program = 0x400001b0 ) ;
  PROVIDE ( SPI_read_data = 0x400001b4 ) ;
  PROVIDE ( SPI_sector_erase = 0x400001b8 ) ;
  PROVIDE ( SPI_write_enable = 0x40000154 ) ;
  PROVIDE ( SelectSpiFunction = 0x400001bc ) ;
  PROVIDE ( SetSpiDrvs = 0x400001c0 ) ;
  PROVIDE ( UartDwnLdProc = 0x400000b8 ) ;
  PROVIDE ( UartGetCmdLn = 0x40000054 ) ;
  PROVIDE ( UartRxString = 0x40000050 ) ;
  PROVIDE ( Uart_Init = 0x400000c0 ) ;
  PROVIDE ( Wait_SPI_Idle = 0x400001c4 ) ;
  PROVIDE ( _SPIEraseArea = 0x40000134 ) ;
  PROVIDE ( _SPI_write_enable = 0x40000138 ) ;
  PROVIDE ( _esp_rom_spiflash_erase_block = 0x40000124 ) ;
  PROVIDE ( _esp_rom_spiflash_erase_sector = 0x40000120 ) ;
  PROVIDE ( _esp_rom_spiflash_read = 0x4000012c ) ;
  PROVIDE ( _esp_rom_spiflash_unlock = 0x40000130 ) ;
  PROVIDE ( _esp_rom_spiflash_write = 0x40000128 ) ;
  PROVIDE ( _rom_chip_id = 0x40000010 ) ;
  PROVIDE ( _rom_eco_version = 0x40000014 ) ;
  PROVIDE ( _rom_ets_ecdsa_verify = 0x4000083c ) ;
  PROVIDE ( _rom_ets_secure_boot_verify_signature = 0x40000844 ) ;
  PROVIDE ( analog_super_wdt_reset_happened = 0x4000001c ) ;
  PROVIDE ( clear_super_wdt_reset_flag = 0x4000009c ) ;
  PROVIDE ( crc16_be = 0x40000734 ) ;
  PROVIDE ( crc16_be_table_ptr = 0x4001ffe8 ) ;
  PROVIDE ( crc16_le = 0x40000728 ) ;
  PROVIDE ( crc16_le_table_ptr = 0x4001fff4 ) ;
  PROVIDE ( crc32_be = 0x40000730 ) ;
  PROVIDE ( crc32_be_table_ptr = 0x4001ffec ) ;
  PROVIDE ( crc32_le = 0x40000724 ) ;
  PROVIDE ( crc32_le_table_ptr = 0x4001fff8 ) ;
  PROVIDE ( crc8_be = 0x40000738 ) ;
  PROVIDE ( crc8_be_table_ptr = 0x4001ffe4 ) ;
  PROVIDE ( crc8_le = 0x4000072c ) ;
  PROVIDE ( crc8_le_table_ptr = 0x4001fff0 ) ;
  PROVIDE ( detect_spi_flash_chip = 0x4000026c ) ;
  PROVIDE ( disable_default_watchdog = 0x400000a0 ) ;
  PROVIDE ( esp_crc8 = 0x4000073c ) ;
  PROVIDE ( esp_enable_cache_flash_wrap = 0x400001f8 ) ;
  PROVIDE ( esp_flash_api_funcs = 0x4084ffe4 ) ;
  PROVIDE ( esp_flash_chip_driver_initialized = 0x40000224 ) ;
  PROVIDE ( esp_flash_default_chip = 0x4084ffe8 ) ;
  PROVIDE ( esp_flash_erase_chip = 0x40000230 ) ;
  PROVIDE ( esp_flash_get_chip_write_protect = 0x40000238 ) ;
  PROVIDE ( esp_flash_get_protectable_regions = 0x40000240 ) ;
  PROVIDE ( esp_flash_get_protected_region = 0x40000244 ) ;
  PROVIDE ( esp_flash_get_size = 0x4000022c ) ;
  PROVIDE ( esp_flash_read_chip_id = 0x40000268 ) ;
  PROVIDE ( esp_flash_read_encrypted = 0x40000258 ) ;
  PROVIDE ( esp_flash_read_id = 0x40000228 ) ;
  PROVIDE ( esp_flash_set_chip_write_protect = 0x4000023c ) ;
  PROVIDE ( esp_flash_set_io_mode = 0x40000260 ) ;
  PROVIDE ( esp_flash_set_protected_region = 0x40000248 ) ;
  PROVIDE ( esp_flash_suspend_cmd_init = 0x40000274 ) ;
  PROVIDE ( esp_rom_crc16_be = 0x40000734 ) ;
  PROVIDE ( esp_rom_crc16_le = 0x40000728 ) ;
  PROVIDE ( esp_rom_crc32_be = 0x40000730 ) ;
  PROVIDE ( esp_rom_crc32_le = 0x40000724 ) ;
  PROVIDE ( esp_rom_crc8_be = 0x40000738 ) ;
  PROVIDE ( esp_rom_crc8_le = 0x4000072c ) ;
  PROVIDE ( esp_rom_delay_us = 0x40000040 ) ;
  PROVIDE ( esp_rom_efuse_is_secure_boot_enabled = 0x400007f4 ) ;
  PROVIDE ( esp_rom_efuse_mac_address_crc8 = 0x4000073c ) ;
  PROVIDE ( esp_rom_get_cpu_ticks_per_us = 0x40000044 ) ;
  PROVIDE ( esp_rom_get_reset_reason = 0x40000018 ) ;
  PROVIDE ( esp_rom_get_rtc_wake_addr = 0x400000a8 ) ;
  PROVIDE ( esp_rom_gpio_connect_in_signal = 0x400006a4 ) ;
  PROVIDE ( esp_rom_gpio_connect_out_signal = 0x400006a8 ) ;
  PROVIDE ( esp_rom_gpio_pad_pullup_only = 0x400006c8 ) ;
  PROVIDE ( esp_rom_gpio_pad_select_gpio = 0x400006cc ) ;
  PROVIDE ( esp_rom_gpio_pad_set_drv = 0x400006d0 ) ;
  PROVIDE ( esp_rom_gpio_pad_unhold = 0x400006d4 ) ;
  PROVIDE ( esp_rom_install_uart_printf = 0x40000034 ) ;
  PROVIDE ( esp_rom_md5_final = 0x40000720 ) ;
  PROVIDE ( esp_rom_md5_init = 0x40000718 ) ;
  PROVIDE ( esp_rom_md5_update = 0x4000071c ) ;
  PROVIDE ( esp_rom_output_flush_tx = 0x40000074 ) ;
  PROVIDE ( esp_rom_output_putc = 0x40000080 ) ;
  PROVIDE ( esp_rom_output_rx_one_char = 0x40000060 ) ;
  PROVIDE ( esp_rom_output_rx_string = 0x40000050 ) ;
  PROVIDE ( esp_rom_output_set_as_console = 0x40000084 ) ;
  PROVIDE ( esp_rom_output_tx_one_char = 0x40000058 ) ;
  PROVIDE ( esp_rom_output_tx_wait_idle = 0x40000078 ) ;
  PROVIDE ( esp_rom_printf = 0x40000028 ) ;
  PROVIDE ( esp_rom_route_intr_matrix = 0x400006fc ) ;
  PROVIDE ( esp_rom_set_cpu_ticks_per_us = 0x40000048 ) ;
  PROVIDE ( esp_rom_set_rtc_wake_addr = 0x400000a4 ) ;
  PROVIDE ( esp_rom_software_reset_cpu = 0x40000094 ) ;
  PROVIDE ( esp_rom_software_reset_system = 0x40000090 ) ;
  PROVIDE ( esp_rom_spi_flash_auto_sus_res = 0x40000164 ) ;
  PROVIDE ( esp_rom_spi_flash_send_resume = 0x40000168 ) ;
  PROVIDE ( esp_rom_spi_flash_update_id = 0x4000016c ) ;
  PROVIDE ( esp_rom_spi_set_address_bit_len = 0x40000190 ) ;
  PROVIDE ( esp_rom_spiflash_attach = 0x400001d4 ) ;
  PROVIDE ( esp_rom_spiflash_clear_bp = 0x4000014c ) ;
  PROVIDE ( esp_rom_spiflash_common_cmd = 0x4000019c ) ;
  PROVIDE ( esp_rom_spiflash_config_clk = 0x40000170 ) ;
  PROVIDE ( esp_rom_spiflash_config_param = 0x40000158 ) ;
  PROVIDE ( esp_rom_spiflash_config_readmode = 0x40000174 ) ;
  PROVIDE ( esp_rom_spiflash_erase_area = 0x40000150 ) ;
  PROVIDE ( esp_rom_spiflash_erase_block = 0x40000140 ) ;
  PROVIDE ( esp_rom_spiflash_erase_chip = 0x4000011c ) ;
  PROVIDE ( esp_rom_spiflash_erase_sector = 0x4000013c ) ;
  PROVIDE ( esp_rom_spiflash_fix_dummylen = 0x400001c8 ) ;
  PROVIDE ( esp_rom_spiflash_read = 0x40000148 ) ;
  PROVIDE ( esp_rom_spiflash_read_status = 0x40000178 ) ;
  PROVIDE ( esp_rom_spiflash_read_statushigh = 0x4000017c ) ;
  PROVIDE ( esp_rom_spiflash_read_user_cmd = 0x4000015c ) ;
  PROVIDE ( esp_rom_spiflash_select_padsfunc = 0x400001bc ) ;
  PROVIDE ( esp_rom_spiflash_select_qio_pins = 0x40000160 ) ;
  PROVIDE ( esp_rom_spiflash_set_drvs = 0x400001c0 ) ;
  PROVIDE ( esp_rom_spiflash_unlock = 0x4000014c ) ;
  PROVIDE ( esp_rom_spiflash_wait_idle = 0x40000108 ) ;
  PROVIDE ( esp_rom_spiflash_write = 0x40000144 ) ;
  PROVIDE ( esp_rom_spiflash_write_disable = 0x40000270 ) ;
  PROVIDE ( esp_rom_spiflash_write_enable = 0x40000154 ) ;
  PROVIDE ( esp_rom_spiflash_write_encrypted = 0x4000010c ) ;
  PROVIDE ( esp_rom_spiflash_write_encrypted_dest = 0x40000110 ) ;
  PROVIDE ( esp_rom_spiflash_write_encrypted_disable = 0x40000118 ) ;
  PROVIDE ( esp_rom_spiflash_write_encrypted_enable = 0x40000114 ) ;
  PROVIDE ( esp_rom_spiflash_write_status = 0x40000180 ) ;
  PROVIDE ( esp_rom_uart_flush_tx = 0x40000074 ) ;
  PROVIDE ( esp_rom_uart_putc = 0x40000080 ) ;
  PROVIDE ( esp_rom_uart_rx_one_char = 0x40000060 ) ;
  PROVIDE ( esp_rom_uart_rx_string = 0x40000050 ) ;
  PROVIDE ( esp_rom_uart_set_as_console = 0x40000084 ) ;
  PROVIDE ( esp_rom_uart_tx_one_char = 0x4000005c ) ;
  PROVIDE ( esp_rom_uart_tx_wait_idle = 0x40000078 ) ;
  PROVIDE ( esprv_intc_int_disable = 0x400006f0 ) ;
  PROVIDE ( esprv_intc_int_enable = 0x400006ec ) ;
  PROVIDE ( esprv_intc_int_set_priority = 0x400006e4 ) ;
  PROVIDE ( esprv_intc_int_set_threshold = 0x400006e8 ) ;
  PROVIDE ( esprv_intc_int_set_type = 0x400006f4 ) ;
  PROVIDE ( ets_aes_block = 0x40000788 ) ;
  PROVIDE ( ets_aes_disable = 0x40000780 ) ;
  PROVIDE ( ets_aes_enable = 0x4000077c ) ;
  PROVIDE ( ets_aes_setkey = 0x40000784 ) ;
  PROVIDE ( ets_aes_setkey_dec = 0x4000078c ) ;
  PROVIDE ( ets_aes_setkey_enc = 0x40000790 ) ;
  PROVIDE ( ets_bigint_disable = 0x40000798 ) ;
  PROVIDE ( ets_bigint_enable = 0x40000794 ) ;
  PROVIDE ( ets_bigint_getz = 0x400007ac ) ;
  PROVIDE ( ets_bigint_modexp = 0x400007a4 ) ;
  PROVIDE ( ets_bigint_modmult = 0x400007a0 ) ;
  PROVIDE ( ets_bigint_multiply = 0x4000079c ) ;
  PROVIDE ( ets_bigint_wait_finish = 0x400007a8 ) ;
  PROVIDE ( ets_clk_assist_debug_clock_enable = 0x40000098 ) ;
  PROVIDE ( ets_clk_get_cpu_freq = 0x4000069c ) ;
  PROVIDE ( ets_clk_get_xtal_freq = 0x40000698 ) ;
  PROVIDE ( ets_delay_us = 0x40000040 ) ;
  PROVIDE ( ets_ds_disable = 0x400007b4 ) ;
  PROVIDE ( ets_ds_enable = 0x400007b0 ) ;
  PROVIDE ( ets_ds_encrypt_params = 0x400007c4 ) ;
  PROVIDE ( ets_ds_finish_sign = 0x400007c0 ) ;
  PROVIDE ( ets_ds_is_busy = 0x400007bc ) ;
  PROVIDE ( ets_ds_start_sign = 0x400007b8 ) ;
  PROVIDE ( ets_efuse_cache_encryption_enabled = 0x400007fc ) ;
  PROVIDE ( ets_efuse_clear_program_registers = 0x400007d4 ) ;
  PROVIDE ( ets_efuse_count_unused_key_blocks = 0x400007f0 ) ;
  PROVIDE ( ets_efuse_direct_boot_mode_disabled = 0x40000818 ) ;
  PROVIDE ( ets_efuse_download_modes_disabled = 0x40000800 ) ;
  PROVIDE ( ets_efuse_find_purpose = 0x40000804 ) ;
  PROVIDE ( ets_efuse_find_unused_key_block = 0x400007e8 ) ;
  PROVIDE ( ets_efuse_force_send_resume = 0x40000808 ) ;
  PROVIDE ( ets_efuse_get_flash_delay_us = 0x4000080c ) ;
  PROVIDE ( ets_efuse_get_key_purpose = 0x400007e0 ) ;
  PROVIDE ( ets_efuse_get_mac = 0x40000810 ) ;
  PROVIDE ( ets_efuse_get_read_register_address = 0x400007dc ) ;
  PROVIDE ( ets_efuse_get_uart_print_control = 0x40000814 ) ;
  PROVIDE ( ets_efuse_jtag_disabled = 0x40000820 ) ;
  PROVIDE ( ets_efuse_key_block_unused = 0x400007e4 ) ;
  PROVIDE ( ets_efuse_program = 0x400007d0 ) ;
  PROVIDE ( ets_efuse_read = 0x400007cc ) ;
  PROVIDE ( ets_efuse_rs_calculate = 0x400007ec ) ;
  PROVIDE ( ets_efuse_secure_boot_aggressive_revoke_enabled = 0x400007f8 ) ;
  PROVIDE ( ets_efuse_secure_boot_enabled = 0x400007f4 ) ;
  PROVIDE ( ets_efuse_secure_boot_fast_wake_enabled = 0x40000830 ) ;
  PROVIDE ( ets_efuse_security_download_modes_enabled = 0x4000081c ) ;
  PROVIDE ( ets_efuse_usb_device_disabled = 0x4000082c ) ;
  PROVIDE ( ets_efuse_usb_download_mode_disabled = 0x40000828 ) ;
  PROVIDE ( ets_efuse_usb_print_is_disabled = 0x40000824 ) ;
  PROVIDE ( ets_efuse_write_key = 0x400007d8 ) ;
  PROVIDE ( ets_emsa_pss_verify = 0x40000834 ) ;
  PROVIDE ( ets_get_cpu_frequency = 0x40000044 ) ;
  PROVIDE ( ets_get_printf_channel = 0x4000003c ) ;
  PROVIDE ( ets_hmac_calculate_downstream = 0x40000770 ) ;
  PROVIDE ( ets_hmac_calculate_message = 0x4000076c ) ;
  PROVIDE ( ets_hmac_disable = 0x40000768 ) ;
  PROVIDE ( ets_hmac_enable = 0x40000764 ) ;
  PROVIDE ( ets_hmac_invalidate_downstream = 0x40000774 ) ;
  PROVIDE ( ets_install_lock = 0x4000004c ) ;
  PROVIDE ( ets_install_putc1 = 0x4000002c ) ;
  PROVIDE ( ets_install_putc2 = 0x40000030 ) ;
  PROVIDE ( ets_install_uart_printf = 0x40000034 ) ;
  PROVIDE ( ets_install_usb_printf = 0x40000038 ) ;
  PROVIDE ( ets_intr_lock = 0x40000700 ) ;
  PROVIDE ( ets_intr_unlock = 0x40000704 ) ;
  PROVIDE ( ets_isr_attach = 0x40000708 ) ;
  PROVIDE ( ets_isr_mask = 0x4000070c ) ;
  PROVIDE ( ets_isr_unmask = 0x40000710 ) ;
  PROVIDE ( ets_jtag_enable_temporarily = 0x40000778 ) ;
  PROVIDE ( ets_mgf1_sha256 = 0x400007c8 ) ;
  PROVIDE ( ets_ops_table_ptr = 0x4084fff8 ) ;
  PROVIDE ( ets_printf = 0x40000028 ) ;
  PROVIDE ( ets_rom_layout_p = 0x4001fffc ) ;
  PROVIDE ( ets_rsa_pss_verify = 0x40000838 ) ;
  PROVIDE ( ets_secure_boot_read_key_digests = 0x40000848 ) ;
  PROVIDE ( ets_secure_boot_revoke_public_key_digest = 0x4000084c ) ;
  PROVIDE ( ets_set_user_start = 0x400000c4 ) ;
  PROVIDE ( ets_sha_clone = 0x40000760 ) ;
  PROVIDE ( ets_sha_disable = 0x40000744 ) ;
  PROVIDE ( ets_sha_enable = 0x40000740 ) ;
  PROVIDE ( ets_sha_finish = 0x4000075c ) ;
  PROVIDE ( ets_sha_get_state = 0x40000748 ) ;
  PROVIDE ( ets_sha_init = 0x4000074c ) ;
  PROVIDE ( ets_sha_process = 0x40000750 ) ;
  PROVIDE ( ets_sha_starts = 0x40000754 ) ;
  PROVIDE ( ets_sha_update = 0x40000758 ) ;
  PROVIDE ( ets_update_cpu_frequency = 0x40000048 ) ;
  PROVIDE ( ets_write_char_uart = 0x40000080 ) ;
  PROVIDE ( g_flash_guard_ops = 0x4084fff4 ) ;
  PROVIDE ( g_saved_pc = 0x4084fffc ) ;
  PROVIDE ( intr_matrix_set = 0x400006fc ) ;
  PROVIDE ( md5_vector = 0x40000714 ) ;
  PROVIDE ( memspi_host_erase_block = 0x4000030c ) ;
  PROVIDE ( memspi_host_erase_chip = 0x40000304 ) ;
  PROVIDE ( memspi_host_erase_sector = 0x40000308 ) ;
  PROVIDE ( memspi_host_flush_cache = 0x40000300 ) ;
  PROVIDE ( memspi_host_program_page = 0x40000310 ) ;
  PROVIDE ( memspi_host_read = 0x40000314 ) ;
  PROVIDE ( memspi_host_read_data_slicer = 0x40000320 ) ;
  PROVIDE ( memspi_host_read_id_hs = 0x400002f8 ) ;
  PROVIDE ( memspi_host_read_status_hs = 0x400002fc ) ;
  PROVIDE ( memspi_host_set_max_read_len = 0x4000031c ) ;
  PROVIDE ( memspi_host_set_write_protect = 0x40000318 ) ;
  PROVIDE ( memspi_host_write_data_slicer = 0x40000324 ) ;
  PROVIDE ( multofup = 0x4000008c ) ;
  PROVIDE ( mz_adler32 = 0x400000c8 ) ;
  PROVIDE ( mz_free = 0x400000cc ) ;
  PROVIDE ( recv_packet = 0x400000b0 ) ;
  PROVIDE ( rom_cache_internal_table_ptr = 0x4084ffc8 ) ;
  PROVIDE ( rom_cache_op_cb = 0x4084ffcc ) ;
  PROVIDE ( rom_esp_flash_erase_region = 0x40000234 ) ;
  PROVIDE ( rom_esp_flash_write = 0x40000250 ) ;
  PROVIDE ( rom_esp_flash_write_encrypted = 0x40000254 ) ;
  PROVIDE ( rom_gpio_bypass_matrix_in = 0x400006e0 ) ;
  PROVIDE ( rom_gpio_input_get = 0x400006a0 ) ;
  PROVIDE ( rom_gpio_matrix_in = 0x400006a4 ) ;
  PROVIDE ( rom_gpio_matrix_out = 0x400006a8 ) ;
  PROVIDE ( rom_gpio_output_disable = 0x400006ac ) ;
  PROVIDE ( rom_gpio_output_enable = 0x400006b0 ) ;
  PROVIDE ( rom_gpio_output_set = 0x400006b4 ) ;
  PROVIDE ( rom_gpio_pad_hold = 0x400006b8 ) ;
  PROVIDE ( rom_gpio_pad_input_disable = 0x400006bc ) ;
  PROVIDE ( rom_gpio_pad_input_enable = 0x400006c0 ) ;
  PROVIDE ( rom_gpio_pad_pulldown = 0x400006c4 ) ;
  PROVIDE ( rom_gpio_pad_pullup = 0x400006c8 ) ;
  PROVIDE ( rom_gpio_pad_select_gpio = 0x400006cc ) ;
  PROVIDE ( rom_gpio_pad_set_drv = 0x400006d0 ) ;
  PROVIDE ( rom_gpio_pad_unhold = 0x400006d4 ) ;
  PROVIDE ( rom_gpio_pin_wakeup_disable = 0x400006d8 ) ;
  PROVIDE ( rom_gpio_pin_wakeup_enable = 0x400006dc ) ;
  PROVIDE ( rom_spi_flash_disable_cache = 0x400001e8 ) ;
  PROVIDE ( rom_spi_flash_mmap = 0x40000204 ) ;
  PROVIDE ( rom_spi_flash_mmap_pages = 0x40000208 ) ;
  PROVIDE ( rom_spi_flash_munmap = 0x4000020c ) ;
  PROVIDE ( rom_spi_flash_restore_cache = 0x400001ec ) ;
  PROVIDE ( rom_spiflash_legacy_data = 0x4084ffec ) ;
  PROVIDE ( rom_spiflash_legacy_funcs = 0x4084fff0 ) ;
  PROVIDE ( roundup2 = 0x40000088 ) ;
  PROVIDE ( rtc_get_reset_reason = 0x40000018 ) ;
  PROVIDE ( rtc_get_wakeup_cause = 0x40000020 ) ;
  PROVIDE ( rtc_unhold_all_pads = 0x40000024 ) ;
  PROVIDE ( send_packet = 0x400000ac ) ;
  PROVIDE ( software_reset = 0x40000090 ) ;
  PROVIDE ( software_reset_cpu = 0x40000094 ) ;
  PROVIDE ( spi_cache_mode_switch = 0x40000184 ) ;
  PROVIDE ( spi_common_set_dummy_output = 0x40000188 ) ;
  PROVIDE ( spi_common_set_flash_cs_timing = 0x4000018c ) ;
  PROVIDE ( spi_dummy_len_fix = 0x400001c8 ) ;
  PROVIDE ( spi_flash_attach = 0x400001d4 ) ;
  PROVIDE ( spi_flash_boot_attach = 0x40000264 ) ;
  PROVIDE ( spi_flash_cache2phys = 0x4000021c ) ;
  PROVIDE ( spi_flash_cache_enabled = 0x400001f0 ) ;
  PROVIDE ( spi_flash_check_and_flush_cache = 0x40000214 ) ;
  PROVIDE ( spi_flash_chip_gd_get_io_mode = 0x400002ec ) ;
  PROVIDE ( spi_flash_chip_gd_probe = 0x400002f0 ) ;
  PROVIDE ( spi_flash_chip_gd_set_io_mode = 0x400002f4 ) ;
  PROVIDE ( spi_flash_chip_generic_config_data = 0x4084ffe0 ) ;
  PROVIDE ( spi_flash_chip_generic_config_host_io_mode = 0x400002bc ) ;
  PROVIDE ( spi_flash_chip_generic_detect_size = 0x4000027c ) ;
  PROVIDE ( spi_flash_chip_generic_erase_block = 0x4000029c ) ;
  PROVIDE ( spi_flash_chip_generic_erase_chip = 0x40000294 ) ;
  PROVIDE ( spi_flash_chip_generic_erase_sector = 0x40000298 ) ;
  PROVIDE ( spi_flash_chip_generic_get_caps = 0x400002e4 ) ;
  PROVIDE ( spi_flash_chip_generic_get_io_mode = 0x400002c8 ) ;
  PROVIDE ( spi_flash_chip_generic_get_write_protect = 0x400002a4 ) ;
  PROVIDE ( spi_flash_chip_generic_page_program = 0x400002a0 ) ;
  PROVIDE ( spi_flash_chip_generic_probe = 0x40000278 ) ;
  PROVIDE ( spi_flash_chip_generic_read = 0x400002c0 ) ;
  PROVIDE ( spi_flash_chip_generic_read_reg = 0x400002ac ) ;
  PROVIDE ( spi_flash_chip_generic_read_unique_id = 0x400002e0 ) ;
  PROVIDE ( spi_flash_chip_generic_reset = 0x40000290 ) ;
  PROVIDE ( spi_flash_chip_generic_set_io_mode = 0x400002dc ) ;
  PROVIDE ( spi_flash_chip_generic_set_write_protect = 0x40000288 ) ;
  PROVIDE ( spi_flash_chip_generic_suspend_cmd_conf = 0x400002e8 ) ;
  PROVIDE ( spi_flash_chip_generic_wait_idle = 0x400002b8 ) ;
  PROVIDE ( spi_flash_chip_generic_write = 0x40000280 ) ;
  PROVIDE ( spi_flash_chip_generic_write_encrypted = 0x40000284 ) ;
  PROVIDE ( spi_flash_chip_generic_yield = 0x400002b0 ) ;
  PROVIDE ( spi_flash_common_read_status_16b_rdsr_rdsr2 = 0x400002a8 ) ;
  PROVIDE ( spi_flash_common_read_status_8b_rdsr = 0x400002cc ) ;
  PROVIDE ( spi_flash_common_read_status_8b_rdsr2 = 0x400002c4 ) ;
  PROVIDE ( spi_flash_common_set_io_mode = 0x400002d8 ) ;
  PROVIDE ( spi_flash_common_write_status_16b_wrsr = 0x4000028c ) ;
  PROVIDE ( spi_flash_common_write_status_8b_wrsr = 0x400002d0 ) ;
  PROVIDE ( spi_flash_common_write_status_8b_wrsr2 = 0x400002d4 ) ;
  PROVIDE ( spi_flash_encryption = 0x4084ffdc ) ;
  PROVIDE ( spi_flash_encryption_hal_check = 0x40000388 ) ;
  PROVIDE ( spi_flash_encryption_hal_destroy = 0x40000384 ) ;
  PROVIDE ( spi_flash_encryption_hal_disable = 0x40000378 ) ;
  PROVIDE ( spi_flash_encryption_hal_done = 0x40000380 ) ;
  PROVIDE ( spi_flash_encryption_hal_enable = 0x40000374 ) ;
  PROVIDE ( spi_flash_encryption_hal_prepare = 0x4000037c ) ;
  PROVIDE ( spi_flash_generic_wait_host_idle = 0x400002b4 ) ;
  PROVIDE ( spi_flash_get_chip_size = 0x400001d8 ) ;
  PROVIDE ( spi_flash_guard_get = 0x400001e0 ) ;
  PROVIDE ( spi_flash_guard_set = 0x400001dc ) ;
  PROVIDE ( spi_flash_hal_check_status = 0x40000354 ) ;
  PROVIDE ( spi_flash_hal_common_command = 0x40000334 ) ;
  PROVIDE ( spi_flash_hal_configure_host_io_mode = 0x40000330 ) ;
  PROVIDE ( spi_flash_hal_device_config = 0x4000032c ) ;
  PROVIDE ( spi_flash_hal_disable_auto_resume_mode = 0x40000368 ) ;
  PROVIDE ( spi_flash_hal_disable_auto_suspend_mode = 0x40000364 ) ;
  PROVIDE ( spi_flash_hal_erase_block = 0x40000344 ) ;
  PROVIDE ( spi_flash_hal_erase_chip = 0x4000033c ) ;
  PROVIDE ( spi_flash_hal_erase_sector = 0x40000340 ) ;
  PROVIDE ( spi_flash_hal_host_idle = 0x40000350 ) ;
  PROVIDE ( spi_flash_hal_poll_cmd_done = 0x40000328 ) ;
  PROVIDE ( spi_flash_hal_program_page = 0x40000348 ) ;
  PROVIDE ( spi_flash_hal_read = 0x40000338 ) ;
  PROVIDE ( spi_flash_hal_resume = 0x4000036c ) ;
  PROVIDE ( spi_flash_hal_set_write_protect = 0x4000034c ) ;
  PROVIDE ( spi_flash_hal_setup_auto_resume_mode = 0x40000360 ) ;
  PROVIDE ( spi_flash_hal_setup_auto_suspend_mode = 0x4000035c ) ;
  PROVIDE ( spi_flash_hal_setup_read_suspend = 0x40000358 ) ;
  PROVIDE ( spi_flash_hal_suspend = 0x40000370 ) ;
  PROVIDE ( spi_flash_mmap_dump = 0x40000210 ) ;
  PROVIDE ( spi_flash_mmap_get_free_pages = 0x40000218 ) ;
  PROVIDE ( spi_flash_mmap_os_func_set = 0x400001fc ) ;
  PROVIDE ( spi_flash_mmap_page_num_init = 0x40000200 ) ;
  PROVIDE ( spi_flash_phys2cache = 0x40000220 ) ;
  PROVIDE ( spi_flash_read_encrypted = 0x400001e4 ) ;
  PROVIDE ( tdefl_compress = 0x400000d0 ) ;
  PROVIDE ( tdefl_compress_buffer = 0x400000d4 ) ;
  PROVIDE ( tdefl_compress_mem_to_heap = 0x400000d8 ) ;
  PROVIDE ( tdefl_compress_mem_to_mem = 0x400000dc ) ;
  PROVIDE ( tdefl_compress_mem_to_output = 0x400000e0 ) ;
  PROVIDE ( tdefl_get_adler32 = 0x400000e4 ) ;
  PROVIDE ( tdefl_get_prev_return_status = 0x400000e8 ) ;
  PROVIDE ( tdefl_init = 0x400000ec ) ;
  PROVIDE ( tdefl_write_image_to_png_file_in_memory = 0x400000f0 ) ;
  PROVIDE ( tdefl_write_image_to_png_file_in_memory_ex = 0x400000f4 ) ;
  PROVIDE ( tinfl_decompress = 0x400000f8 ) ;
  PROVIDE ( tinfl_decompress_mem_to_callback = 0x400000fc ) ;
  PROVIDE ( tinfl_decompress_mem_to_heap = 0x40000100 ) ;
  PROVIDE ( tinfl_decompress_mem_to_mem = 0x40000104 ) ;
  PROVIDE ( uartAttach = 0x40000070 ) ;
  PROVIDE ( uart_div_modify = 0x4000007c ) ;
  PROVIDE ( uart_rx_intr_handler = 0x40000068 ) ;
  PROVIDE ( uart_rx_one_char = 0x40000060 ) ;
  PROVIDE ( uart_rx_one_char_block = 0x40000064 ) ;
  PROVIDE ( uart_rx_readbuff = 0x4000006c ) ;
  PROVIDE ( uart_tx_flush = 0x40000074 ) ;
  PROVIDE ( uart_tx_one_char = 0x40000058 ) ;
  PROVIDE ( uart_tx_one_char2 = 0x4000005c ) ;
  PROVIDE ( uart_tx_switch = 0x40000084 ) ;
  PROVIDE ( uart_tx_wait_idle = 0x40000078 ) ;
  PROVIDE ( usb_serial_device_rx_one_char = 0x400009c0 ) ;
  PROVIDE ( usb_serial_device_rx_one_char_block = 0x400009c4 ) ;
  PROVIDE ( usb_serial_device_tx_flush = 0x400009c8 ) ;
  PROVIDE ( usb_serial_device_tx_one_char = 0x400009cc ) ;
}
