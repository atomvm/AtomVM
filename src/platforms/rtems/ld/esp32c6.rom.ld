/*
 * SPDX-FileCopyrightText: 2026 Espressif Systems (Shanghai) CO LTD
 * SPDX-FileCopyrightText: 2026 Peter M. <petermm@gmail.com>
 *
 * SPDX-License-Identifier: Apache-2.0 OR BSD-2-Clause
 */
SECTIONS {
  PROVIDE ( .data_bss_ok = 0x400017dc ) ;
  PROVIDE ( .data_ok = 0x400017b2 ) ;
  PROVIDE ( .stack_ok = 0x4000177a ) ;
  PROVIDE ( BasicOFDMSched_ptr = 0x4087ff1c ) ;
  PROVIDE ( CSWTCH.147 = 0x40049a88 ) ;
  PROVIDE ( CSWTCH.169 = 0x4004d840 ) ;
  PROVIDE ( CSWTCH.170 = 0x4004d840 ) ;
  PROVIDE ( CSWTCH.171 = 0x4004d840 ) ;
  PROVIDE ( CSWTCH.22 = 0x4004cf7c ) ;
  PROVIDE ( CSWTCH.222 = 0x40049c70 ) ;
  PROVIDE ( Cache_Address_Through_Cache = 0x400275f8 ) ;
  PROVIDE ( Cache_Config_ICache_Autoload = 0x40027974 ) ;
  PROVIDE ( Cache_Disable_ICache = 0x40027b7c ) ;
  PROVIDE ( Cache_Disable_ICache_Autoload = 0x40027a50 ) ;
  PROVIDE ( Cache_Disable_ICache_PreLock = 0x40027ade ) ;
  PROVIDE ( Cache_Enable_ICache = 0x40027bd0 ) ;
  PROVIDE ( Cache_Enable_ICache_Autoload = 0x40027a3e ) ;
  PROVIDE ( Cache_Enable_ICache_PreLock = 0x40027a84 ) ;
  PROVIDE ( Cache_End_ICache_Preload = 0x40027960 ) ;
  PROVIDE ( Cache_Freeze_ICache_Disable = 0x4002783a ) ;
  PROVIDE ( Cache_Freeze_ICache_Enable = 0x40027802 ) ;
  PROVIDE ( Cache_Get_DROM_MMU_End = 0x40027c62 ) ;
  PROVIDE ( Cache_Get_ICache_Line_Size = 0x400275aa ) ;
  PROVIDE ( Cache_Get_IROM_MMU_End = 0x40027c58 ) ;
  PROVIDE ( Cache_Get_Mode = 0x400275b0 ) ;
  PROVIDE ( Cache_Get_Virtual_Addr = 0x40027e18 ) ;
  PROVIDE ( Cache_ICache_Preload_Done = 0x40027954 ) ;
  PROVIDE ( Cache_Invalidate_Addr = 0x4002786c ) ;
  PROVIDE ( Cache_Invalidate_ICache_All = 0x400278b4 ) ;
  PROVIDE ( Cache_Invalidate_ICache_Items = 0x400276bc ) ;
  PROVIDE ( Cache_Lock_Addr = 0x40027af0 ) ;
  PROVIDE ( Cache_Lock_ICache_Items = 0x4002778a ) ;
  PROVIDE ( Cache_MMU_Init = 0x40027c76 ) ;
  PROVIDE ( Cache_MSPI_MMU_Set = 0x40027c90 ) ;
  PROVIDE ( Cache_Mask_All = 0x400278cc ) ;
  PROVIDE ( Cache_Op_Addr = 0x400276f6 ) ;
  PROVIDE ( Cache_Resume_ICache = 0x40027bd0 ) ;
  PROVIDE ( Cache_Resume_ICache_Autoload = 0x40027858 ) ;
  PROVIDE ( Cache_Set_IDROM_MMU_Size = 0x40027c28 ) ;
  PROVIDE ( Cache_Start_ICache_Preload = 0x400278e6 ) ;
  PROVIDE ( Cache_Suspend_ICache = 0x40027be6 ) ;
  PROVIDE ( Cache_Suspend_ICache_Autoload = 0x40027766 ) ;
  PROVIDE ( Cache_Travel_Tag_Memory = 0x40027d96 ) ;
  PROVIDE ( Cache_UnMask_Dram0 = 0x400278da ) ;
  PROVIDE ( Cache_Unlock_Addr = 0x40027b36 ) ;
  PROVIDE ( Cache_Unlock_ICache_Items = 0x400277c6 ) ;
  PROVIDE ( Clip8 = 0x4004ca90 ) ;
  PROVIDE ( Disable_QMode = 0x40024824 ) ;
  PROVIDE ( EFUSE = 0x600b0800 ) ;
  PROVIDE ( Enable_QMode = 0x400247d4 ) ;
  PROVIDE ( FilePacketSendDeflatedReqMsgProc = 0x40023866 ) ;
  PROVIDE ( FilePacketSendReqMsgProc = 0x400234cc ) ;
  PROVIDE ( FlashDwnLdDeflatedStartMsgProc = 0x40023800 ) ;
  PROVIDE ( FlashDwnLdParamCfgMsgProc = 0x400235d0 ) ;
  PROVIDE ( FlashDwnLdStartMsgProc = 0x4002345c ) ;
  PROVIDE ( FlashDwnLdStopDeflatedReqMsgProc = 0x4002396c ) ;
  PROVIDE ( FlashDwnLdStopReqMsgProc = 0x40023596 ) ;
  PROVIDE ( GetAccess = 0x40009d0e ) ;
  PROVIDE ( GetSecurityInfoProc = 0x40023a60 ) ;
  PROVIDE ( GetUartDevice = 0x4002313e ) ;
  PROVIDE ( Ipsf = 0x4004ce90 ) ;
  PROVIDE ( LP_WDT = 0x600b1c00 ) ;
  PROVIDE ( L_shift = 0x40041cd6 ) ;
  PROVIDE ( MD5Final = 0x4001bd96 ) ;
  PROVIDE ( MD5Init = 0x4001bcb8 ) ;
  PROVIDE ( MD5Transform = 0x4001b3b0 ) ;
  PROVIDE ( MD5Update = 0x4001bcea ) ;
  PROVIDE ( MMU_Get_Page_Mode = 0x400275ea ) ;
  PROVIDE ( MMU_Set_Page_Mode = 0x400275d4 ) ;
  PROVIDE ( MemDwnLdStartMsgProc = 0x400235fc ) ;
  PROVIDE ( MemDwnLdStopReqMsgProc = 0x400236b4 ) ;
  PROVIDE ( MemPacketSendReqMsgProc = 0x40023634 ) ;
  PROVIDE ( RC_GetBlockAckTime = 0x4000d398 ) ;
  PROVIDE ( RC_GetCtsTime = 0x4000d420 ) ;
  PROVIDE ( ROM_Boot_Cache_Init = 0x40027620 ) ;
  PROVIDE ( ROM_Direct_Boot_Cache_Init = 0x40027656 ) ;
  PROVIDE ( ROM_Direct_Boot_MMU_Init = 0x40027672 ) ;
  PROVIDE ( RV_STK_A0 = 0x00000028 ) ;
  PROVIDE ( RV_STK_A1 = 0x0000002c ) ;
  PROVIDE ( RV_STK_A2 = 0x00000030 ) ;
  PROVIDE ( RV_STK_A3 = 0x00000034 ) ;
  PROVIDE ( RV_STK_A4 = 0x00000038 ) ;
  PROVIDE ( RV_STK_A5 = 0x0000003c ) ;
  PROVIDE ( RV_STK_A6 = 0x00000040 ) ;
  PROVIDE ( RV_STK_A7 = 0x00000044 ) ;
  PROVIDE ( RV_STK_CAUSE = 0x00000084 ) ;
  PROVIDE ( RV_STK_EPC = 0x00000000 ) ;
  PROVIDE ( RV_STK_GP = 0x0000000c ) ;
  PROVIDE ( RV_STK_INTC_THRESH = 0x0000008c ) ;
  PROVIDE ( RV_STK_RA = 0x00000004 ) ;
  PROVIDE ( RV_STK_S0 = 0x00000020 ) ;
  PROVIDE ( RV_STK_S1 = 0x00000024 ) ;
  PROVIDE ( RV_STK_S10 = 0x00000068 ) ;
  PROVIDE ( RV_STK_S11 = 0x0000006c ) ;
  PROVIDE ( RV_STK_S2 = 0x00000048 ) ;
  PROVIDE ( RV_STK_S3 = 0x0000004c ) ;
  PROVIDE ( RV_STK_S4 = 0x00000050 ) ;
  PROVIDE ( RV_STK_S5 = 0x00000054 ) ;
  PROVIDE ( RV_STK_S6 = 0x00000058 ) ;
  PROVIDE ( RV_STK_S7 = 0x0000005c ) ;
  PROVIDE ( RV_STK_S8 = 0x00000060 ) ;
  PROVIDE ( RV_STK_S9 = 0x00000064 ) ;
  PROVIDE ( RV_STK_SP = 0x00000008 ) ;
  PROVIDE ( RV_STK_STATUS = 0x00000080 ) ;
  PROVIDE ( RV_STK_T0 = 0x00000014 ) ;
  PROVIDE ( RV_STK_T1 = 0x00000018 ) ;
  PROVIDE ( RV_STK_T2 = 0x0000001c ) ;
  PROVIDE ( RV_STK_T3 = 0x00000070 ) ;
  PROVIDE ( RV_STK_T4 = 0x00000074 ) ;
  PROVIDE ( RV_STK_T5 = 0x00000078 ) ;
  PROVIDE ( RV_STK_T6 = 0x0000007c ) ;
  PROVIDE ( RV_STK_TP = 0x00000010 ) ;
  PROVIDE ( RV_STK_TVAL = 0x00000088 ) ;
  PROVIDE ( RcvMsg = 0x400230e0 ) ;
  PROVIDE ( RvExcFrameSize = 0x00000090 ) ;
  PROVIDE ( SPIEraseArea = 0x40025184 ) ;
  PROVIDE ( SPILock = 0x40024c0c ) ;
  PROVIDE ( SPIMEM0 = 0x60002000 ) ;
  PROVIDE ( SPIMEM1 = 0x60003000 ) ;
  PROVIDE ( SPIMasterReadModeCnfig = 0x40024d08 ) ;
  PROVIDE ( SPI_Common_Command = 0x4002443e ) ;
  PROVIDE ( SPI_WakeUp = 0x400242b2 ) ;
  PROVIDE ( SPI_block_erase = 0x40024388 ) ;
  PROVIDE ( SPI_chip_erase = 0x40024308 ) ;
  PROVIDE ( SPI_init = 0x400249e4 ) ;
  PROVIDE ( SPI_page_program = 0x40024692 ) ;
  PROVIDE ( SPI_read_data = 0x40024100 ) ;
  PROVIDE ( SPI_sector_erase = 0x40024340 ) ;
  PROVIDE ( SPI_write_enable = 0x40024676 ) ;
  PROVIDE ( SYSTIMER = 0x6000a000 ) ;
  PROVIDE ( SelectSpiFunction = 0x40024068 ) ;
  PROVIDE ( SendMsg = 0x40022ece ) ;
  PROVIDE ( SetSpiDrvs = 0x40023f70 ) ;
  PROVIDE ( TIMERG0 = 0x60008000 ) ;
  PROVIDE ( TIMERG1 = 0x60009000 ) ;
  PROVIDE ( TRC_AMPDU_PER_DOWN_THRESHOLD = 0x40011866 ) ;
  PROVIDE ( TRC_AMPDU_PER_UP_THRESHOLD = 0x40011c12 ) ;
  PROVIDE ( TRC_PER_IS_GOOD = 0x40011096 ) ;
  PROVIDE ( UartConnCheck = 0x40023388 ) ;
  PROVIDE ( UartConnectProc = 0x400236da ) ;
  PROVIDE ( UartDev = 0x4087f568 ) ;
  PROVIDE ( UartDwnLdProc = 0x40023b64 ) ;
  PROVIDE ( UartGetCmdLn = 0x400230f0 ) ;
  PROVIDE ( UartRegReadProc = 0x40023758 ) ;
  PROVIDE ( UartRegWriteProc = 0x400236e6 ) ;
  PROVIDE ( UartRxString = 0x40022e20 ) ;
  PROVIDE ( UartSecureDwnLdProc = 0x40023148 ) ;
  PROVIDE ( UartSetBaudProc = 0x400237e2 ) ;
  PROVIDE ( UartSpiAttachProc = 0x40023798 ) ;
  PROVIDE ( UartSpiReadProc = 0x400237b4 ) ;
  PROVIDE ( Uart_Init = 0x40022c82 ) ;
  PROVIDE ( VerifyFlashMd5Proc = 0x4002399e ) ;
  PROVIDE ( Wait_SPI_Idle = 0x400242e8 ) ;
  PROVIDE ( Zig = 0x4004cf10 ) ;
  PROVIDE ( _Balloc = 0x4003f81a ) ;
  PROVIDE ( _Bfree = 0x4003f8c2 ) ;
  PROVIDE ( _C_numeric_locale = 0x400498d0 ) ;
  PROVIDE ( _SPIEraseArea = 0x400250dc ) ;
  PROVIDE ( _SPI_write_enable = 0x40024630 ) ;
  PROVIDE ( __GNU_EH_FRAME_HDR = 0x4200c208 ) ;
  PROVIDE ( __absvdi2 = 0x40029770 ) ;
  PROVIDE ( __absvsi2 = 0x4002975a ) ;
  PROVIDE ( __action_table = 0x40048a68 ) ;
  PROVIDE ( __adddf3 = 0x4002bff0 ) ;
  PROVIDE ( __addsf3 = 0x4002dcf0 ) ;
  PROVIDE ( __addvdi3 = 0x400297ae ) ;
  PROVIDE ( __addvsi3 = 0x40029790 ) ;
  PROVIDE ( __any_on = 0x400402be ) ;
  PROVIDE ( __ascii_mbtowc = 0x4003f7e0 ) ;
  PROVIDE ( __ascii_wctomb = 0x40041712 ) ;
  PROVIDE ( __ashldi3 = 0x400296ca ) ;
  PROVIDE ( __ashrdi3 = 0x400296f4 ) ;
  PROVIDE ( __assert_func = 0x40028374 ) ;
  PROVIDE ( __b2d = 0x40040026 ) ;
  PROVIDE ( __bswapdi2 = 0x4002ad0a ) ;
  PROVIDE ( __bswapsi2 = 0x4002ace6 ) ;
  PROVIDE ( __call_Cache_Address_Through_Cache = 0x40000630 ) ;
  PROVIDE ( __call_Cache_Config_ICache_Autoload = 0x4000066c ) ;
  PROVIDE ( __call_Cache_Disable_ICache = 0x40000690 ) ;
  PROVIDE ( __call_Cache_Disable_ICache_Autoload = 0x40000674 ) ;
  PROVIDE ( __call_Cache_Disable_ICache_PreLock = 0x4000067c ) ;
  PROVIDE ( __call_Cache_Enable_ICache = 0x40000694 ) ;
  PROVIDE ( __call_Cache_Enable_ICache_Autoload = 0x40000670 ) ;
  PROVIDE ( __call_Cache_Enable_ICache_PreLock = 0x40000678 ) ;
  PROVIDE ( __call_Cache_End_ICache_Preload = 0x40000668 ) ;
  PROVIDE ( __call_Cache_Freeze_ICache_Disable = 0x400006a4 ) ;
  PROVIDE ( __call_Cache_Freeze_ICache_Enable = 0x400006a0 ) ;
  PROVIDE ( __call_Cache_Get_DROM_MMU_End = 0x400006b0 ) ;
  PROVIDE ( __call_Cache_Get_ICache_Line_Size = 0x40000628 ) ;
  PROVIDE ( __call_Cache_Get_IROM_MMU_End = 0x400006ac ) ;
  PROVIDE ( __call_Cache_Get_Mode = 0x4000062c ) ;
  PROVIDE ( __call_Cache_Get_Virtual_Addr = 0x400006c0 ) ;
  PROVIDE ( __call_Cache_ICache_Preload_Done = 0x40000664 ) ;
  PROVIDE ( __call_Cache_Invalidate_Addr = 0x40000648 ) ;
  PROVIDE ( __call_Cache_Invalidate_ICache_All = 0x4000064c ) ;
  PROVIDE ( __call_Cache_Invalidate_ICache_Items = 0x40000640 ) ;
  PROVIDE ( __call_Cache_Lock_Addr = 0x40000688 ) ;
  PROVIDE ( __call_Cache_Lock_ICache_Items = 0x40000680 ) ;
  PROVIDE ( __call_Cache_MMU_Init = 0x400006b4 ) ;
  PROVIDE ( __call_Cache_MSPI_MMU_Set = 0x400006b8 ) ;
  PROVIDE ( __call_Cache_Mask_All = 0x40000650 ) ;
  PROVIDE ( __call_Cache_Op_Addr = 0x40000644 ) ;
  PROVIDE ( __call_Cache_Resume_ICache = 0x4000069c ) ;
  PROVIDE ( __call_Cache_Resume_ICache_Autoload = 0x4000065c ) ;
  PROVIDE ( __call_Cache_Set_IDROM_MMU_Size = 0x400006a8 ) ;
  PROVIDE ( __call_Cache_Start_ICache_Preload = 0x40000660 ) ;
  PROVIDE ( __call_Cache_Suspend_ICache = 0x40000698 ) ;
  PROVIDE ( __call_Cache_Suspend_ICache_Autoload = 0x40000658 ) ;
  PROVIDE ( __call_Cache_Travel_Tag_Memory = 0x400006bc ) ;
  PROVIDE ( __call_Cache_UnMask_Dram0 = 0x40000654 ) ;
  PROVIDE ( __call_Cache_Unlock_Addr = 0x4000068c ) ;
  PROVIDE ( __call_Cache_Unlock_ICache_Items = 0x40000684 ) ;
  PROVIDE ( __call_Disable_QMode = 0x400001d4 ) ;
  PROVIDE ( __call_Enable_QMode = 0x400001d8 ) ;
  PROVIDE ( __call_GetAccess = 0x40000bf4 ) ;
  PROVIDE ( __call_GetSecurityInfoProc = 0x400000bc ) ;
  PROVIDE ( __call_GetUartDevice = 0x400000b4 ) ;
  PROVIDE ( __call_MD5Final = 0x40000754 ) ;
  PROVIDE ( __call_MD5Init = 0x4000074c ) ;
  PROVIDE ( __call_MD5Update = 0x40000750 ) ;
  PROVIDE ( __call_MMU_Get_Page_Mode = 0x4000063c ) ;
  PROVIDE ( __call_MMU_Set_Page_Mode = 0x40000638 ) ;
  PROVIDE ( __call_RC_GetBlockAckTime = 0x40000be0 ) ;
  PROVIDE ( __call_ROM_Boot_Cache_Init = 0x40000634 ) ;
  PROVIDE ( __call_SPIEraseArea = 0x40000158 ) ;
  PROVIDE ( __call_SPILock = 0x4000019c ) ;
  PROVIDE ( __call_SPIMasterReadModeCnfig = 0x400001a0 ) ;
  PROVIDE ( __call_SPI_Common_Command = 0x400001a4 ) ;
  PROVIDE ( __call_SPI_WakeUp = 0x400001a8 ) ;
  PROVIDE ( __call_SPI_block_erase = 0x400001ac ) ;
  PROVIDE ( __call_SPI_chip_erase = 0x400001b0 ) ;
  PROVIDE ( __call_SPI_init = 0x400001b4 ) ;
  PROVIDE ( __call_SPI_page_program = 0x400001b8 ) ;
  PROVIDE ( __call_SPI_read_data = 0x400001bc ) ;
  PROVIDE ( __call_SPI_sector_erase = 0x400001c0 ) ;
  PROVIDE ( __call_SPI_write_enable = 0x4000015c ) ;
  PROVIDE ( __call_SelectSpiFunction = 0x400001c4 ) ;
  PROVIDE ( __call_SetSpiDrvs = 0x400001c8 ) ;
  PROVIDE ( __call_TRC_AMPDU_PER_DOWN_THRESHOLD = 0x40000dac ) ;
  PROVIDE ( __call_TRC_AMPDU_PER_UP_THRESHOLD = 0x40000db0 ) ;
  PROVIDE ( __call_TRC_PER_IS_GOOD = 0x40000dc0 ) ;
  PROVIDE ( __call_UartDwnLdProc = 0x400000b8 ) ;
  PROVIDE ( __call_UartGetCmdLn = 0x40000054 ) ;
  PROVIDE ( __call_UartRxString = 0x40000050 ) ;
  PROVIDE ( __call_Uart_Init = 0x400000c0 ) ;
  PROVIDE ( __call_Wait_SPI_Idle = 0x400001cc ) ;
  PROVIDE ( __call__SPIEraseArea = 0x4000013c ) ;
  PROVIDE ( __call__SPI_write_enable = 0x40000140 ) ;
  PROVIDE ( __call___absvdi2 = 0x40000884 ) ;
  PROVIDE ( __call___absvsi2 = 0x40000888 ) ;
  PROVIDE ( __call___adddf3 = 0x4000088c ) ;
  PROVIDE ( __call___addsf3 = 0x40000890 ) ;
  PROVIDE ( __call___addvdi3 = 0x40000894 ) ;
  PROVIDE ( __call___addvsi3 = 0x40000898 ) ;
  PROVIDE ( __call___ashldi3 = 0x4000089c ) ;
  PROVIDE ( __call___ashrdi3 = 0x400008a0 ) ;
  PROVIDE ( __call___bswapdi2 = 0x400008a4 ) ;
  PROVIDE ( __call___bswapsi2 = 0x400008a8 ) ;
  PROVIDE ( __call___clear_cache = 0x400008ac ) ;
  PROVIDE ( __call___clrsbdi2 = 0x400008b0 ) ;
  PROVIDE ( __call___clrsbsi2 = 0x400008b4 ) ;
  PROVIDE ( __call___clzdi2 = 0x400008b8 ) ;
  PROVIDE ( __call___clzsi2 = 0x400008bc ) ;
  PROVIDE ( __call___cmpdi2 = 0x400008c0 ) ;
  PROVIDE ( __call___ctzdi2 = 0x400008c4 ) ;
  PROVIDE ( __call___ctzsi2 = 0x400008c8 ) ;
  PROVIDE ( __call___divdc3 = 0x400008cc ) ;
  PROVIDE ( __call___divdf3 = 0x400008d0 ) ;
  PROVIDE ( __call___divdi3 = 0x400008d4 ) ;
  PROVIDE ( __call___divsc3 = 0x400008d8 ) ;
  PROVIDE ( __call___divsf3 = 0x400008dc ) ;
  PROVIDE ( __call___divsi3 = 0x400008e0 ) ;
  PROVIDE ( __call___eqdf2 = 0x400008e4 ) ;
  PROVIDE ( __call___eqsf2 = 0x400008e8 ) ;
  PROVIDE ( __call___extenddftf2 = 0x400009ec ) ;
  PROVIDE ( __call___extendsfdf2 = 0x400008ec ) ;
  PROVIDE ( __call___ffsdi2 = 0x400008f0 ) ;
  PROVIDE ( __call___ffssi2 = 0x400008f4 ) ;
  PROVIDE ( __call___fixdfdi = 0x400008f8 ) ;
  PROVIDE ( __call___fixdfsi = 0x400008fc ) ;
  PROVIDE ( __call___fixsfdi = 0x40000900 ) ;
  PROVIDE ( __call___fixsfsi = 0x40000904 ) ;
  PROVIDE ( __call___fixunsdfsi = 0x40000908 ) ;
  PROVIDE ( __call___fixunssfdi = 0x4000090c ) ;
  PROVIDE ( __call___fixunssfsi = 0x40000910 ) ;
  PROVIDE ( __call___floatdidf = 0x40000914 ) ;
  PROVIDE ( __call___floatdisf = 0x40000918 ) ;
  PROVIDE ( __call___floatsidf = 0x4000091c ) ;
  PROVIDE ( __call___floatsisf = 0x40000920 ) ;
  PROVIDE ( __call___floatundidf = 0x40000924 ) ;
  PROVIDE ( __call___floatundisf = 0x40000928 ) ;
  PROVIDE ( __call___floatunsidf = 0x4000092c ) ;
  PROVIDE ( __call___floatunsisf = 0x40000930 ) ;
  PROVIDE ( __call___gcc_bcmp = 0x40000934 ) ;
  PROVIDE ( __call___gedf2 = 0x40000938 ) ;
  PROVIDE ( __call___gesf2 = 0x4000093c ) ;
  PROVIDE ( __call___gtdf2 = 0x40000940 ) ;
  PROVIDE ( __call___gtsf2 = 0x40000944 ) ;
  PROVIDE ( __call___ledf2 = 0x40000948 ) ;
  PROVIDE ( __call___lesf2 = 0x4000094c ) ;
  PROVIDE ( __call___lshrdi3 = 0x40000950 ) ;
  PROVIDE ( __call___ltdf2 = 0x40000954 ) ;
  PROVIDE ( __call___ltsf2 = 0x40000958 ) ;
  PROVIDE ( __call___moddi3 = 0x4000095c ) ;
  PROVIDE ( __call___modsi3 = 0x40000960 ) ;
  PROVIDE ( __call___muldc3 = 0x40000964 ) ;
  PROVIDE ( __call___muldf3 = 0x40000968 ) ;
  PROVIDE ( __call___muldi3 = 0x4000096c ) ;
  PROVIDE ( __call___mulsc3 = 0x40000970 ) ;
  PROVIDE ( __call___mulsf3 = 0x40000974 ) ;
  PROVIDE ( __call___mulsi3 = 0x40000978 ) ;
  PROVIDE ( __call___mulvdi3 = 0x4000097c ) ;
  PROVIDE ( __call___mulvsi3 = 0x40000980 ) ;
  PROVIDE ( __call___nedf2 = 0x40000984 ) ;
  PROVIDE ( __call___negdf2 = 0x40000988 ) ;
  PROVIDE ( __call___negdi2 = 0x4000098c ) ;
  PROVIDE ( __call___negsf2 = 0x40000990 ) ;
  PROVIDE ( __call___negvdi2 = 0x40000994 ) ;
  PROVIDE ( __call___negvsi2 = 0x40000998 ) ;
  PROVIDE ( __call___nesf2 = 0x4000099c ) ;
  PROVIDE ( __call___paritysi2 = 0x400009a0 ) ;
  PROVIDE ( __call___popcountdi2 = 0x400009a4 ) ;
  PROVIDE ( __call___popcountsi2 = 0x400009a8 ) ;
  PROVIDE ( __call___powidf2 = 0x400009ac ) ;
  PROVIDE ( __call___powisf2 = 0x400009b0 ) ;
  PROVIDE ( __call___smakebuf_r = 0x400005c0 ) ;
  PROVIDE ( __call___sprint_r = 0x400005d4 ) ;
  PROVIDE ( __call___subdf3 = 0x400009b4 ) ;
  PROVIDE ( __call___subsf3 = 0x400009b8 ) ;
  PROVIDE ( __call___subvdi3 = 0x400009bc ) ;
  PROVIDE ( __call___subvsi3 = 0x400009c0 ) ;
  PROVIDE ( __call___swbuf = 0x400005cc ) ;
  PROVIDE ( __call___swbuf_r = 0x400005c8 ) ;
  PROVIDE ( __call___swhatbuf_r = 0x400005c4 ) ;
  PROVIDE ( __call___swsetup_r = 0x400005d0 ) ;
  PROVIDE ( __call___truncdfsf2 = 0x400009c4 ) ;
  PROVIDE ( __call___trunctfdf2 = 0x400009f0 ) ;
  PROVIDE ( __call___ucmpdi2 = 0x400009c8 ) ;
  PROVIDE ( __call___udiv_w_sdiv = 0x400009d8 ) ;
  PROVIDE ( __call___udivdi3 = 0x400009cc ) ;
  PROVIDE ( __call___udivmoddi4 = 0x400009d0 ) ;
  PROVIDE ( __call___udivsi3 = 0x400009d4 ) ;
  PROVIDE ( __call___umoddi3 = 0x400009dc ) ;
  PROVIDE ( __call___umodsi3 = 0x400009e0 ) ;
  PROVIDE ( __call___unorddf2 = 0x400009e4 ) ;
  PROVIDE ( __call___unordsf2 = 0x400009e8 ) ;
  PROVIDE ( __call__esp_rom_spiflash_erase_block = 0x4000012c ) ;
  PROVIDE ( __call__esp_rom_spiflash_erase_sector = 0x40000128 ) ;
  PROVIDE ( __call__esp_rom_spiflash_read = 0x40000134 ) ;
  PROVIDE ( __call__esp_rom_spiflash_unlock = 0x40000138 ) ;
  PROVIDE ( __call__esp_rom_spiflash_write = 0x40000130 ) ;
  PROVIDE ( __call__fflush_r = 0x400005b4 ) ;
  PROVIDE ( __call__fiprintf_r = 0x400005d8 ) ;
  PROVIDE ( __call__fprintf_r = 0x400005dc ) ;
  PROVIDE ( __call__fwalk = 0x400005b8 ) ;
  PROVIDE ( __call__fwalk_reent = 0x400005bc ) ;
  PROVIDE ( __call__isatty_r = 0x400004d4 ) ;
  PROVIDE ( __call__rvfp__adddf3 = 0x400009f4 ) ;
  PROVIDE ( __call__rvfp__addsf3 = 0x400009f8 ) ;
  PROVIDE ( __call__rvfp__eqdf2 = 0x400009fc ) ;
  PROVIDE ( __call__rvfp__eqsf2 = 0x40000a00 ) ;
  PROVIDE ( __call__rvfp__extendsfdf2 = 0x40000a04 ) ;
  PROVIDE ( __call__rvfp__fixdfdi = 0x40000a08 ) ;
  PROVIDE ( __call__rvfp__fixdfsi = 0x40000a0c ) ;
  PROVIDE ( __call__rvfp__fixsfdi = 0x40000a10 ) ;
  PROVIDE ( __call__rvfp__fixsfsi = 0x40000a14 ) ;
  PROVIDE ( __call__rvfp__fixunsdfsi = 0x40000a18 ) ;
  PROVIDE ( __call__rvfp__fixunssfdi = 0x40000a1c ) ;
  PROVIDE ( __call__rvfp__fixunssfsi = 0x40000a20 ) ;
  PROVIDE ( __call__rvfp__floatdidf = 0x40000a24 ) ;
  PROVIDE ( __call__rvfp__floatdisf = 0x40000a28 ) ;
  PROVIDE ( __call__rvfp__floatsidf = 0x40000a2c ) ;
  PROVIDE ( __call__rvfp__floatsisf = 0x40000a30 ) ;
  PROVIDE ( __call__rvfp__floatundidf = 0x40000a34 ) ;
  PROVIDE ( __call__rvfp__floatundisf = 0x40000a38 ) ;
  PROVIDE ( __call__rvfp__floatunsidf = 0x40000a3c ) ;
  PROVIDE ( __call__rvfp__floatunsisf = 0x40000a40 ) ;
  PROVIDE ( __call__rvfp__gedf2 = 0x40000a44 ) ;
  PROVIDE ( __call__rvfp__gesf2 = 0x40000a48 ) ;
  PROVIDE ( __call__rvfp__gtdf2 = 0x40000a4c ) ;
  PROVIDE ( __call__rvfp__gtsf2 = 0x40000a50 ) ;
  PROVIDE ( __call__rvfp__ledf2 = 0x40000a54 ) ;
  PROVIDE ( __call__rvfp__lesf2 = 0x40000a58 ) ;
  PROVIDE ( __call__rvfp__ltdf2 = 0x40000a5c ) ;
  PROVIDE ( __call__rvfp__ltsf2 = 0x40000a60 ) ;
  PROVIDE ( __call__rvfp__muldf3 = 0x40000a64 ) ;
  PROVIDE ( __call__rvfp__mulsf3 = 0x40000a68 ) ;
  PROVIDE ( __call__rvfp__nedf2 = 0x40000a6c ) ;
  PROVIDE ( __call__rvfp__nesf2 = 0x40000a70 ) ;
  PROVIDE ( __call__rvfp__subdf3 = 0x40000a74 ) ;
  PROVIDE ( __call__rvfp__subsf3 = 0x40000a78 ) ;
  PROVIDE ( __call__rvfp__truncdfsf2 = 0x40000a7c ) ;
  PROVIDE ( __call__vfiprintf_r = 0x400005e0 ) ;
  PROVIDE ( __call__vfprintf_r = 0x400005e4 ) ;
  PROVIDE ( __call_abs = 0x40000578 ) ;
  PROVIDE ( __call_abs_temp = 0x40001130 ) ;
  PROVIDE ( __call_agc_reg_init = 0x4000137c ) ;
  PROVIDE ( __call_ampdu_dispatch = 0x40000b50 ) ;
  PROVIDE ( __call_ampdu_dispatch_all = 0x40000b54 ) ;
  PROVIDE ( __call_ampdu_dispatch_as_many_as_possible = 0x40000b58 ) ;
  PROVIDE ( __call_ampdu_dispatch_movement = 0x40000b5c ) ;
  PROVIDE ( __call_ampdu_dispatch_upto = 0x40000b60 ) ;
  PROVIDE ( __call_analog_super_wdt_reset_happened = 0x4000001c ) ;
  PROVIDE ( __call_ant_btrx_cfg_rom = 0x400011f0 ) ;
  PROVIDE ( __call_ant_bttx_cfg_rom = 0x400011ec ) ;
  PROVIDE ( __call_ant_dft_cfg_rom = 0x400011e0 ) ;
  PROVIDE ( __call_ant_wifirx_cfg_rom = 0x400011e8 ) ;
  PROVIDE ( __call_ant_wifitx_cfg_rom = 0x400011e4 ) ;
  PROVIDE ( __call_asprintf = 0x400005fc ) ;
  PROVIDE ( __call_atoi = 0x400005a0 ) ;
  PROVIDE ( __call_atol = 0x400005a4 ) ;
  PROVIDE ( __call_bb_bss_cbw40_dig = 0x4000134c ) ;
  PROVIDE ( __call_bb_reg_init = 0x40001380 ) ;
  PROVIDE ( __call_bb_wdg_cfg = 0x40001370 ) ;
  PROVIDE ( __call_bb_wdg_test_en = 0x40001398 ) ;
  PROVIDE ( __call_bt_bb_to_index = 0x40001468 ) ;
  PROVIDE ( __call_bt_chan_pwr_interp = 0x4000147c ) ;
  PROVIDE ( __call_bt_filter_reg = 0x400013bc ) ;
  PROVIDE ( __call_bt_gain_offset = 0x40001364 ) ;
  PROVIDE ( __call_bt_get_tx_gain = 0x4000146c ) ;
  PROVIDE ( __call_bt_index_to_bb = 0x40001464 ) ;
  PROVIDE ( __call_bt_tx_pwctrl_init = 0x4000129c ) ;
  PROVIDE ( __call_bt_txdc_cal = 0x4000125c ) ;
  PROVIDE ( __call_bt_txiq_cal = 0x40001260 ) ;
  PROVIDE ( __call_bt_txpwr_freq = 0x4000115c ) ;
  PROVIDE ( __call_bzero = 0x400004d0 ) ;
  PROVIDE ( __call_cbw2040_cfg = 0x40001350 ) ;
  PROVIDE ( __call_chan_to_freq = 0x40001224 ) ;
  PROVIDE ( __call_chip761_phyrom_version = 0x4000110c ) ;
  PROVIDE ( __call_chip761_phyrom_version_num = 0x40001110 ) ;
  PROVIDE ( __call_chip_v7_set_chan_ana = 0x40001250 ) ;
  PROVIDE ( __call_chm_is_at_home_channel = 0x40000b64 ) ;
  PROVIDE ( __call_clear_super_wdt_reset_flag = 0x4000009c ) ;
  PROVIDE ( __call_cnx_node_is_existing = 0x40000b68 ) ;
  PROVIDE ( __call_cnx_node_search = 0x40000b6c ) ;
  PROVIDE ( __call_code_to_temp = 0x4000143c ) ;
  PROVIDE ( __call_coex_bt_release = 0x40000b00 ) ;
  PROVIDE ( __call_coex_bt_request = 0x40000b04 ) ;
  PROVIDE ( __call_coex_core_ble_conn_dyn_prio_get = 0x40000b08 ) ;
  PROVIDE ( __call_coex_core_event_duration_get = 0x40000b0c ) ;
  PROVIDE ( __call_coex_core_pti_get = 0x40000b10 ) ;
  PROVIDE ( __call_coex_core_release = 0x40000b14 ) ;
  PROVIDE ( __call_coex_core_request = 0x40000b18 ) ;
  PROVIDE ( __call_coex_core_status_get = 0x40000b1c ) ;
  PROVIDE ( __call_coex_core_timer_idx_get = 0x40000b20 ) ;
  PROVIDE ( __call_coex_event_duration_get = 0x40000b24 ) ;
  PROVIDE ( __call_coex_hw_timer_disable = 0x40000b28 ) ;
  PROVIDE ( __call_coex_hw_timer_enable = 0x40000b2c ) ;
  PROVIDE ( __call_coex_hw_timer_set = 0x40000b30 ) ;
  PROVIDE ( __call_coex_schm_interval_set = 0x40000b34 ) ;
  PROVIDE ( __call_coex_schm_lock = 0x40000b38 ) ;
  PROVIDE ( __call_coex_schm_unlock = 0x40000b3c ) ;
  PROVIDE ( __call_coex_status_get = 0x40000b40 ) ;
  PROVIDE ( __call_coex_wifi_release = 0x40000b44 ) ;
  PROVIDE ( __call_config_is_cache_tx_buf_enabled = 0x40000e20 ) ;
  PROVIDE ( __call_crc16_be = 0x40000768 ) ;
  PROVIDE ( __call_crc16_le = 0x4000075c ) ;
  PROVIDE ( __call_crc32_be = 0x40000764 ) ;
  PROVIDE ( __call_crc32_le = 0x40000758 ) ;
  PROVIDE ( __call_crc8_be = 0x4000076c ) ;
  PROVIDE ( __call_crc8_le = 0x40000760 ) ;
  PROVIDE ( __call_dc_iq_est = 0x400013f4 ) ;
  PROVIDE ( __call_detect_spi_flash_chip = 0x40000274 ) ;
  PROVIDE ( __call_dig_gain_check = 0x40001470 ) ;
  PROVIDE ( __call_disable_agc = 0x40001338 ) ;
  PROVIDE ( __call_disable_default_watchdog = 0x400000a0 ) ;
  PROVIDE ( __call_div = 0x4000057c ) ;
  PROVIDE ( __call_ebuf_list_remove = 0x40000be4 ) ;
  PROVIDE ( __call_enable_agc = 0x4000133c ) ;
  PROVIDE ( __call_esf_buf_alloc = 0x40000be8 ) ;
  PROVIDE ( __call_esf_buf_alloc_dynamic = 0x40000bec ) ;
  PROVIDE ( __call_esf_buf_recycle = 0x40000bf0 ) ;
  PROVIDE ( __call_esp_coex_ble_conn_dynamic_prio_get = 0x40000b48 ) ;
  PROVIDE ( __call_esp_coex_rom_version_get = 0x40000afc ) ;
  PROVIDE ( __call_esp_crc8 = 0x40000770 ) ;
  PROVIDE ( __call_esp_enable_cache_flash_wrap = 0x40000200 ) ;
  PROVIDE ( __call_esp_flash_chip_driver_initialized = 0x4000022c ) ;
  PROVIDE ( __call_esp_flash_erase_chip = 0x40000238 ) ;
  PROVIDE ( __call_esp_flash_erase_region = 0x4000023c ) ;
  PROVIDE ( __call_esp_flash_get_chip_write_protect = 0x40000240 ) ;
  PROVIDE ( __call_esp_flash_get_io_mode = 0x40000264 ) ;
  PROVIDE ( __call_esp_flash_get_protectable_regions = 0x40000248 ) ;
  PROVIDE ( __call_esp_flash_get_protected_region = 0x4000024c ) ;
  PROVIDE ( __call_esp_flash_get_size = 0x40000234 ) ;
  PROVIDE ( __call_esp_flash_read = 0x40000254 ) ;
  PROVIDE ( __call_esp_flash_read_chip_id = 0x40000270 ) ;
  PROVIDE ( __call_esp_flash_read_encrypted = 0x40000260 ) ;
  PROVIDE ( __call_esp_flash_read_id = 0x40000230 ) ;
  PROVIDE ( __call_esp_flash_set_chip_write_protect = 0x40000244 ) ;
  PROVIDE ( __call_esp_flash_set_io_mode = 0x40000268 ) ;
  PROVIDE ( __call_esp_flash_set_protected_region = 0x40000250 ) ;
  PROVIDE ( __call_esp_flash_suspend_cmd_init = 0x4000027c ) ;
  PROVIDE ( __call_esp_flash_write = 0x40000258 ) ;
  PROVIDE ( __call_esp_flash_write_encrypted = 0x4000025c ) ;
  PROVIDE ( __call_esp_net80211_rom_version_get = 0x40000b4c ) ;
  PROVIDE ( __call_esp_pp_rom_version_get = 0x40000bd8 ) ;
  PROVIDE ( __call_esp_rom_get_rtc_wake_addr = 0x400000a8 ) ;
  PROVIDE ( __call_esp_rom_newlib_init_common_mutexes = 0x400004a4 ) ;
  PROVIDE ( __call_esp_rom_set_rtc_wake_addr = 0x400000a4 ) ;
  PROVIDE ( __call_esp_rom_spi_flash_auto_sus_res = 0x4000016c ) ;
  PROVIDE ( __call_esp_rom_spi_flash_send_resume = 0x40000170 ) ;
  PROVIDE ( __call_esp_rom_spi_flash_update_id = 0x40000174 ) ;
  PROVIDE ( __call_esp_rom_spi_set_address_bit_len = 0x40000198 ) ;
  PROVIDE ( __call_esp_rom_spiflash_config_clk = 0x40000178 ) ;
  PROVIDE ( __call_esp_rom_spiflash_config_param = 0x40000160 ) ;
  PROVIDE ( __call_esp_rom_spiflash_config_readmode = 0x4000017c ) ;
  PROVIDE ( __call_esp_rom_spiflash_erase_block = 0x40000148 ) ;
  PROVIDE ( __call_esp_rom_spiflash_erase_chip = 0x40000124 ) ;
  PROVIDE ( __call_esp_rom_spiflash_erase_sector = 0x40000144 ) ;
  PROVIDE ( __call_esp_rom_spiflash_read = 0x40000150 ) ;
  PROVIDE ( __call_esp_rom_spiflash_read_status = 0x40000180 ) ;
  PROVIDE ( __call_esp_rom_spiflash_read_statushigh = 0x40000184 ) ;
  PROVIDE ( __call_esp_rom_spiflash_read_user_cmd = 0x40000164 ) ;
  PROVIDE ( __call_esp_rom_spiflash_select_qio_pins = 0x40000168 ) ;
  PROVIDE ( __call_esp_rom_spiflash_unlock = 0x40000154 ) ;
  PROVIDE ( __call_esp_rom_spiflash_wait_idle = 0x40000110 ) ;
  PROVIDE ( __call_esp_rom_spiflash_write = 0x4000014c ) ;
  PROVIDE ( __call_esp_rom_spiflash_write_disable = 0x40000278 ) ;
  PROVIDE ( __call_esp_rom_spiflash_write_encrypted = 0x40000114 ) ;
  PROVIDE ( __call_esp_rom_spiflash_write_encrypted_dest = 0x40000118 ) ;
  PROVIDE ( __call_esp_rom_spiflash_write_encrypted_disable = 0x40000120 ) ;
  PROVIDE ( __call_esp_rom_spiflash_write_encrypted_enable = 0x4000011c ) ;
  PROVIDE ( __call_esp_rom_spiflash_write_status = 0x40000188 ) ;
  PROVIDE ( __call_esp_test_clr_rx_error_occurs = 0x400010c0 ) ;
  PROVIDE ( __call_esp_test_clr_rx_mu_statistics = 0x400010f8 ) ;
  PROVIDE ( __call_esp_test_clr_rx_statistics = 0x400010ac ) ;
  PROVIDE ( __call_esp_test_clr_tx_statistics = 0x40001068 ) ;
  PROVIDE ( __call_esp_test_clr_tx_tb_statistics = 0x40001070 ) ;
  PROVIDE ( __call_esp_test_disable_rx_mu_statistics = 0x40001100 ) ;
  PROVIDE ( __call_esp_test_disable_rx_statistics = 0x400010c4 ) ;
  PROVIDE ( __call_esp_test_disable_tx_statistics = 0x40001060 ) ;
  PROVIDE ( __call_esp_test_enable_rx_mu_statistics = 0x400010fc ) ;
  PROVIDE ( __call_esp_test_enable_rx_statistics = 0x400010c8 ) ;
  PROVIDE ( __call_esp_test_enable_tx_statistics = 0x40001064 ) ;
  PROVIDE ( __call_esp_test_get_rx_error_occurs = 0x400010bc ) ;
  PROVIDE ( __call_esp_test_get_rx_mu_statistics = 0x400010f4 ) ;
  PROVIDE ( __call_esp_test_get_rx_statistics = 0x400010b0 ) ;
  PROVIDE ( __call_esp_test_get_tx_statistics = 0x4000106c ) ;
  PROVIDE ( __call_esp_test_get_tx_tb_statistics = 0x40001074 ) ;
  PROVIDE ( __call_esp_test_rx_parse_mu = 0x400010f0 ) ;
  PROVIDE ( __call_esp_test_rx_process_complete = 0x400010a8 ) ;
  PROVIDE ( __call_esp_test_set_rx_error_occurs = 0x400010b8 ) ;
  PROVIDE ( __call_esp_test_tx_count_collision = 0x40001094 ) ;
  PROVIDE ( __call_esp_test_tx_count_retry = 0x40001090 ) ;
  PROVIDE ( __call_esp_test_tx_count_timeout = 0x40001098 ) ;
  PROVIDE ( __call_esp_test_tx_enab_statistics = 0x40001088 ) ;
  PROVIDE ( __call_esp_test_tx_process_complete = 0x40001080 ) ;
  PROVIDE ( __call_esp_test_tx_process_txq_state = 0x40001084 ) ;
  PROVIDE ( __call_esp_test_tx_tb_complete = 0x4000108c ) ;
  PROVIDE ( __call_esp_tx_state_out_rom = 0x400011dc ) ;
  PROVIDE ( __call_esprv_intc_int_disable = 0x40000724 ) ;
  PROVIDE ( __call_esprv_intc_int_enable = 0x40000720 ) ;
  PROVIDE ( __call_esprv_intc_int_set_priority = 0x40000718 ) ;
  PROVIDE ( __call_esprv_intc_int_set_threshold = 0x4000071c ) ;
  PROVIDE ( __call_esprv_intc_int_set_type = 0x40000728 ) ;
  PROVIDE ( __call_ets_aes_block = 0x400007bc ) ;
  PROVIDE ( __call_ets_aes_disable = 0x400007b4 ) ;
  PROVIDE ( __call_ets_aes_enable = 0x400007b0 ) ;
  PROVIDE ( __call_ets_aes_setkey = 0x400007b8 ) ;
  PROVIDE ( __call_ets_aes_setkey_dec = 0x400007c0 ) ;
  PROVIDE ( __call_ets_aes_setkey_enc = 0x400007c4 ) ;
  PROVIDE ( __call_ets_bigint_disable = 0x400007cc ) ;
  PROVIDE ( __call_ets_bigint_enable = 0x400007c8 ) ;
  PROVIDE ( __call_ets_bigint_getz = 0x400007e0 ) ;
  PROVIDE ( __call_ets_bigint_modexp = 0x400007d8 ) ;
  PROVIDE ( __call_ets_bigint_modmult = 0x400007d4 ) ;
  PROVIDE ( __call_ets_bigint_multiply = 0x400007d0 ) ;
  PROVIDE ( __call_ets_bigint_wait_finish = 0x400007dc ) ;
  PROVIDE ( __call_ets_clk_apb_wait_ready = 0x400006cc ) ;
  PROVIDE ( __call_ets_clk_assist_debug_clock_enable = 0x40000098 ) ;
  PROVIDE ( __call_ets_clk_get_cpu_freq = 0x400006c8 ) ;
  PROVIDE ( __call_ets_clk_get_xtal_freq = 0x400006c4 ) ;
  PROVIDE ( __call_ets_clk_mspi_apb_wait_ready = 0x400006d0 ) ;
  PROVIDE ( __call_ets_delay_us = 0x40000040 ) ;
  PROVIDE ( __call_ets_ds_disable = 0x400007e8 ) ;
  PROVIDE ( __call_ets_ds_enable = 0x400007e4 ) ;
  PROVIDE ( __call_ets_ds_encrypt_params = 0x400007f8 ) ;
  PROVIDE ( __call_ets_ds_finish_sign = 0x400007f4 ) ;
  PROVIDE ( __call_ets_ds_is_busy = 0x400007f0 ) ;
  PROVIDE ( __call_ets_ds_start_sign = 0x400007ec ) ;
  PROVIDE ( __call_ets_efuse_cache_encryption_enabled = 0x40000830 ) ;
  PROVIDE ( __call_ets_efuse_clear_program_registers = 0x40000808 ) ;
  PROVIDE ( __call_ets_efuse_count_unused_key_blocks = 0x40000824 ) ;
  PROVIDE ( __call_ets_efuse_direct_boot_mode_disabled = 0x4000084c ) ;
  PROVIDE ( __call_ets_efuse_download_modes_disabled = 0x40000834 ) ;
  PROVIDE ( __call_ets_efuse_find_purpose = 0x40000838 ) ;
  PROVIDE ( __call_ets_efuse_find_unused_key_block = 0x4000081c ) ;
  PROVIDE ( __call_ets_efuse_force_send_resume = 0x4000083c ) ;
  PROVIDE ( __call_ets_efuse_get_flash_delay_us = 0x40000840 ) ;
  PROVIDE ( __call_ets_efuse_get_key_purpose = 0x40000814 ) ;
  PROVIDE ( __call_ets_efuse_get_mac = 0x40000844 ) ;
  PROVIDE ( __call_ets_efuse_get_read_register_address = 0x40000810 ) ;
  PROVIDE ( __call_ets_efuse_get_uart_print_control = 0x40000848 ) ;
  PROVIDE ( __call_ets_efuse_jtag_disabled = 0x40000858 ) ;
  PROVIDE ( __call_ets_efuse_key_block_unused = 0x40000818 ) ;
  PROVIDE ( __call_ets_efuse_program = 0x40000804 ) ;
  PROVIDE ( __call_ets_efuse_read = 0x40000800 ) ;
  PROVIDE ( __call_ets_efuse_rs_calculate = 0x40000820 ) ;
  PROVIDE ( __call_ets_efuse_secure_boot_aggressive_revoke_enabled = 0x4000082c ) ;
  PROVIDE ( __call_ets_efuse_secure_boot_enabled = 0x40000828 ) ;
  PROVIDE ( __call_ets_efuse_secure_boot_fast_wake_enabled = 0x40000868 ) ;
  PROVIDE ( __call_ets_efuse_security_download_modes_enabled = 0x40000850 ) ;
  PROVIDE ( __call_ets_efuse_set_timing = 0x40000854 ) ;
  PROVIDE ( __call_ets_efuse_usb_device_disabled = 0x40000864 ) ;
  PROVIDE ( __call_ets_efuse_usb_download_mode_disabled = 0x40000860 ) ;
  PROVIDE ( __call_ets_efuse_usb_print_is_disabled = 0x4000085c ) ;
  PROVIDE ( __call_ets_efuse_write_key = 0x4000080c ) ;
  PROVIDE ( __call_ets_emsa_pss_verify = 0x4000086c ) ;
  PROVIDE ( __call_ets_get_cpu_frequency = 0x40000044 ) ;
  PROVIDE ( __call_ets_get_printf_channel = 0x4000003c ) ;
  PROVIDE ( __call_ets_hmac_calculate_downstream = 0x400007a4 ) ;
  PROVIDE ( __call_ets_hmac_calculate_message = 0x400007a0 ) ;
  PROVIDE ( __call_ets_hmac_disable = 0x4000079c ) ;
  PROVIDE ( __call_ets_hmac_enable = 0x40000798 ) ;
  PROVIDE ( __call_ets_hmac_invalidate_downstream = 0x400007a8 ) ;
  PROVIDE ( __call_ets_install_lock = 0x4000004c ) ;
  PROVIDE ( __call_ets_install_putc1 = 0x4000002c ) ;
  PROVIDE ( __call_ets_install_putc2 = 0x40000030 ) ;
  PROVIDE ( __call_ets_install_uart_printf = 0x40000034 ) ;
  PROVIDE ( __call_ets_install_usb_printf = 0x40000038 ) ;
  PROVIDE ( __call_ets_intr_lock = 0x40000734 ) ;
  PROVIDE ( __call_ets_intr_unlock = 0x40000738 ) ;
  PROVIDE ( __call_ets_isr_attach = 0x4000073c ) ;
  PROVIDE ( __call_ets_isr_mask = 0x40000740 ) ;
  PROVIDE ( __call_ets_isr_unmask = 0x40000744 ) ;
  PROVIDE ( __call_ets_jtag_enable_temporarily = 0x400007ac ) ;
  PROVIDE ( __call_ets_mgf1_sha256 = 0x400007fc ) ;
  PROVIDE ( __call_ets_printf = 0x40000028 ) ;
  PROVIDE ( __call_ets_rsa_pss_verify = 0x40000870 ) ;
  PROVIDE ( __call_ets_secure_boot_read_key_digests = 0x4000087c ) ;
  PROVIDE ( __call_ets_secure_boot_revoke_public_key_digest = 0x40000880 ) ;
  PROVIDE ( __call_ets_secure_boot_verify_bootloader_with_keys = 0x40000874 ) ;
  PROVIDE ( __call_ets_secure_boot_verify_signature = 0x40000878 ) ;
  PROVIDE ( __call_ets_set_user_start = 0x400000c4 ) ;
  PROVIDE ( __call_ets_sha_clone = 0x40000794 ) ;
  PROVIDE ( __call_ets_sha_disable = 0x40000778 ) ;
  PROVIDE ( __call_ets_sha_enable = 0x40000774 ) ;
  PROVIDE ( __call_ets_sha_finish = 0x40000790 ) ;
  PROVIDE ( __call_ets_sha_get_state = 0x4000077c ) ;
  PROVIDE ( __call_ets_sha_init = 0x40000780 ) ;
  PROVIDE ( __call_ets_sha_process = 0x40000784 ) ;
  PROVIDE ( __call_ets_sha_starts = 0x40000788 ) ;
  PROVIDE ( __call_ets_sha_update = 0x4000078c ) ;
  PROVIDE ( __call_ets_update_cpu_frequency = 0x40000048 ) ;
  PROVIDE ( __call_ets_write_char_uart = 0x40000080 ) ;
  PROVIDE ( __call_fe_adc_on = 0x400013dc ) ;
  PROVIDE ( __call_fe_reg_init = 0x40001368 ) ;
  PROVIDE ( __call_fe_txrx_reset = 0x40001374 ) ;
  PROVIDE ( __call_fflush = 0x400005b0 ) ;
  PROVIDE ( __call_fiprintf = 0x400005e8 ) ;
  PROVIDE ( __call_fprintf = 0x400005ec ) ;
  PROVIDE ( __call_freq_chan_en_sw = 0x4000114c ) ;
  PROVIDE ( __call_freq_i2c_mem_write = 0x40001168 ) ;
  PROVIDE ( __call_freq_i2c_num_addr = 0x40001170 ) ;
  PROVIDE ( __call_freq_i2c_write_set = 0x40001174 ) ;
  PROVIDE ( __call_freq_module_resetn = 0x40001148 ) ;
  PROVIDE ( __call_freq_num_get_data = 0x4000116c ) ;
  PROVIDE ( __call_freq_set_reg = 0x40001254 ) ;
  PROVIDE ( __call_gen_rx_gain_table = 0x40001258 ) ;
  PROVIDE ( __call_get_chan_target_power = 0x40001484 ) ;
  PROVIDE ( __call_get_data_sat = 0x40001134 ) ;
  PROVIDE ( __call_get_dco_comp = 0x4000140c ) ;
  PROVIDE ( __call_get_estimated_batime = 0x40000e74 ) ;
  PROVIDE ( __call_get_fm_sar_dout = 0x400011ac ) ;
  PROVIDE ( __call_get_freq_mem_addr = 0x40001158 ) ;
  PROVIDE ( __call_get_freq_mem_param = 0x40001154 ) ;
  PROVIDE ( __call_get_pll_vol = 0x400011cc ) ;
  PROVIDE ( __call_get_power_atten = 0x4000127c ) ;
  PROVIDE ( __call_get_power_db = 0x400011b8 ) ;
  PROVIDE ( __call_get_rate_fcc_index = 0x40001480 ) ;
  PROVIDE ( __call_get_rc_dout = 0x40001114 ) ;
  PROVIDE ( __call_get_rf_freq_cap = 0x40001180 ) ;
  PROVIDE ( __call_get_rf_freq_init = 0x40001184 ) ;
  PROVIDE ( __call_get_rfcal_rxiq_data = 0x40001408 ) ;
  PROVIDE ( __call_get_sar2_vol = 0x400011c8 ) ;
  PROVIDE ( __call_get_temp_init = 0x40001458 ) ;
  PROVIDE ( __call_get_tone_sar_dout = 0x400011a8 ) ;
  PROVIDE ( __call_get_tx_gain_value = 0x40001488 ) ;
  PROVIDE ( __call_get_user_num = 0x400010d0 ) ;
  PROVIDE ( __call_gpio_bypass_matrix_in = 0x40000714 ) ;
  PROVIDE ( __call_gpio_input_get = 0x400006d4 ) ;
  PROVIDE ( __call_gpio_matrix_in = 0x400006d8 ) ;
  PROVIDE ( __call_gpio_matrix_out = 0x400006dc ) ;
  PROVIDE ( __call_gpio_output_disable = 0x400006e0 ) ;
  PROVIDE ( __call_gpio_output_enable = 0x400006e4 ) ;
  PROVIDE ( __call_gpio_output_set = 0x400006e8 ) ;
  PROVIDE ( __call_gpio_pad_hold = 0x400006ec ) ;
  PROVIDE ( __call_gpio_pad_input_disable = 0x400006f0 ) ;
  PROVIDE ( __call_gpio_pad_input_enable = 0x400006f4 ) ;
  PROVIDE ( __call_gpio_pad_pulldown = 0x400006f8 ) ;
  PROVIDE ( __call_gpio_pad_pullup = 0x400006fc ) ;
  PROVIDE ( __call_gpio_pad_select_gpio = 0x40000700 ) ;
  PROVIDE ( __call_gpio_pad_set_drv = 0x40000704 ) ;
  PROVIDE ( __call_gpio_pad_unhold = 0x40000708 ) ;
  PROVIDE ( __call_gpio_pin_wakeup_disable = 0x4000070c ) ;
  PROVIDE ( __call_gpio_pin_wakeup_enable = 0x40000710 ) ;
  PROVIDE ( __call_hal_enable_rx_statistics = 0x400010cc ) ;
  PROVIDE ( __call_hal_enable_tx_statistics = 0x4000109c ) ;
  PROVIDE ( __call_hal_get_tsf_timer = 0x40000e4c ) ;
  PROVIDE ( __call_hal_mac_clr_txq_state = 0x40000e84 ) ;
  PROVIDE ( __call_hal_mac_get_txq_complete = 0x40000e88 ) ;
  PROVIDE ( __call_hal_mac_get_txq_state = 0x40000e80 ) ;
  PROVIDE ( __call_hal_mac_is_dma_enable = 0x40000e00 ) ;
  PROVIDE ( __call_hal_mac_is_low_rate_enabled = 0x40000bf8 ) ;
  PROVIDE ( __call_hal_mac_tx_clr_mplen = 0x40000e7c ) ;
  PROVIDE ( __call_hal_mac_tx_get_blockack = 0x40000bfc ) ;
  PROVIDE ( __call_hal_mac_tx_set_ppdu = 0x40000c00 ) ;
  PROVIDE ( __call_hal_tsf_clear_soc_wakeup_request = 0x40000f58 ) ;
  PROVIDE ( __call_ht_get_min_subframe_len = 0x40000e8c ) ;
  PROVIDE ( __call_i2c_master_reset = 0x40001140 ) ;
  PROVIDE ( __call_i2c_paral_read = 0x400012dc ) ;
  PROVIDE ( __call_i2c_paral_set_mst0 = 0x400012d4 ) ;
  PROVIDE ( __call_i2c_paral_set_read = 0x400012d8 ) ;
  PROVIDE ( __call_i2c_paral_write = 0x400012e0 ) ;
  PROVIDE ( __call_i2c_paral_write_mask = 0x400012e8 ) ;
  PROVIDE ( __call_i2c_paral_write_num = 0x400012e4 ) ;
  PROVIDE ( __call_i2c_sar2_init_code = 0x400012ec ) ;
  PROVIDE ( __call_i2cmst_reg_init = 0x40001360 ) ;
  PROVIDE ( __call_ic_ebuf_alloc = 0x40000bac ) ;
  PROVIDE ( __call_ic_ebuf_recycle_rx = 0x40000b70 ) ;
  PROVIDE ( __call_ic_ebuf_recycle_tx = 0x40000b74 ) ;
  PROVIDE ( __call_ic_get_trc = 0x40000c04 ) ;
  PROVIDE ( __call_ic_interface_enabled = 0x40000c10 ) ;
  PROVIDE ( __call_ic_mac_deinit = 0x40000c08 ) ;
  PROVIDE ( __call_ic_mac_init = 0x40000c0c ) ;
  PROVIDE ( __call_ic_reset_rx_ba = 0x40000b78 ) ;
  PROVIDE ( __call_ieee80211_align_eb = 0x40000b7c ) ;
  PROVIDE ( __call_ieee80211_ampdu_reorder = 0x40000b80 ) ;
  PROVIDE ( __call_ieee80211_ampdu_start_age_timer = 0x40000b84 ) ;
  PROVIDE ( __call_ieee80211_classify = 0x40000bb0 ) ;
  PROVIDE ( __call_ieee80211_copy_eb_header = 0x40000bb4 ) ;
  PROVIDE ( __call_ieee80211_crypto_decap = 0x40000bc4 ) ;
  PROVIDE ( __call_ieee80211_crypto_encap = 0x40000bc0 ) ;
  PROVIDE ( __call_ieee80211_decap = 0x40000bc8 ) ;
  PROVIDE ( __call_ieee80211_encap_esfbuf = 0x40000b88 ) ;
  PROVIDE ( __call_ieee80211_encap_esfbuf_htc = 0x40000bd4 ) ;
  PROVIDE ( __call_ieee80211_gettid = 0x40000bd0 ) ;
  PROVIDE ( __call_ieee80211_is_tx_allowed = 0x40000b8c ) ;
  PROVIDE ( __call_ieee80211_output_pending_eb = 0x40000b90 ) ;
  PROVIDE ( __call_ieee80211_output_process = 0x40000b94 ) ;
  PROVIDE ( __call_ieee80211_recycle_cache_eb = 0x40000bb8 ) ;
  PROVIDE ( __call_ieee80211_search_node = 0x40000bbc ) ;
  PROVIDE ( __call_ieee80211_set_tx_desc = 0x40000b98 ) ;
  PROVIDE ( __call_index_to_txbbgain = 0x40001460 ) ;
  PROVIDE ( __call_intr_handler_set = 0x4000072c ) ;
  PROVIDE ( __call_intr_matrix_set = 0x40000730 ) ;
  PROVIDE ( __call_iq_corr_enable = 0x400013a4 ) ;
  PROVIDE ( __call_is_lmac_idle = 0x40000c14 ) ;
  PROVIDE ( __call_is_use_muedca = 0x40000e78 ) ;
  PROVIDE ( __call_isalnum = 0x400004dc ) ;
  PROVIDE ( __call_isalpha = 0x400004e0 ) ;
  PROVIDE ( __call_isascii = 0x400004e4 ) ;
  PROVIDE ( __call_isblank = 0x400004e8 ) ;
  PROVIDE ( __call_iscntrl = 0x400004ec ) ;
  PROVIDE ( __call_isdigit = 0x400004f0 ) ;
  PROVIDE ( __call_isgraph = 0x400004f8 ) ;
  PROVIDE ( __call_islower = 0x400004f4 ) ;
  PROVIDE ( __call_isprint = 0x400004fc ) ;
  PROVIDE ( __call_ispunct = 0x40000500 ) ;
  PROVIDE ( __call_isspace = 0x40000504 ) ;
  PROVIDE ( __call_isupper = 0x40000508 ) ;
  PROVIDE ( __call_itoa = 0x4000059c ) ;
  PROVIDE ( __call_jd_decomp = 0x4000010c ) ;
  PROVIDE ( __call_jd_prepare = 0x40000108 ) ;
  PROVIDE ( __call_labs = 0x40000580 ) ;
  PROVIDE ( __call_ldiv = 0x40000584 ) ;
  PROVIDE ( __call_linear_to_db = 0x400011b4 ) ;
  PROVIDE ( __call_lldesc_build_chain = 0x40000a90 ) ;
  PROVIDE ( __call_lmacAdjustTimestamp = 0x40000c18 ) ;
  PROVIDE ( __call_lmacDiscardAgedMSDU = 0x40000c1c ) ;
  PROVIDE ( __call_lmacDiscardFrameExchangeSequence = 0x40000e5c ) ;
  PROVIDE ( __call_lmacDiscardMSDU = 0x40000c20 ) ;
  PROVIDE ( __call_lmacEndFrameExchangeSequence = 0x40000c24 ) ;
  PROVIDE ( __call_lmacIsIdle = 0x40000c28 ) ;
  PROVIDE ( __call_lmacIsLongFrame = 0x40000c2c ) ;
  PROVIDE ( __call_lmacMSDUAged = 0x40000c30 ) ;
  PROVIDE ( __call_lmacPostTxComplete = 0x40000c34 ) ;
  PROVIDE ( __call_lmacProcessAckTimeout = 0x40000e68 ) ;
  PROVIDE ( __call_lmacProcessAllTxTimeout = 0x40000c38 ) ;
  PROVIDE ( __call_lmacProcessCollisions = 0x40000c3c ) ;
  PROVIDE ( __call_lmacProcessLongFrameSuccess = 0x40000e54 ) ;
  PROVIDE ( __call_lmacProcessRxSucData = 0x40000c40 ) ;
  PROVIDE ( __call_lmacProcessShortFrameSuccess = 0x40000e58 ) ;
  PROVIDE ( __call_lmacProcessTBSuccess = 0x40000e60 ) ;
  PROVIDE ( __call_lmacProcessTxComplete = 0x40000e6c ) ;
  PROVIDE ( __call_lmacProcessTxSuccess = 0x40000e64 ) ;
  PROVIDE ( __call_lmacReachLongLimit = 0x40000c44 ) ;
  PROVIDE ( __call_lmacReachShortLimit = 0x40000c48 ) ;
  PROVIDE ( __call_lmacRecycleMPDU = 0x40000c4c ) ;
  PROVIDE ( __call_lmacRxDone = 0x40000c50 ) ;
  PROVIDE ( __call_lmacSetTxFrame = 0x40000c54 ) ;
  PROVIDE ( __call_lmacTxDone = 0x40000c58 ) ;
  PROVIDE ( __call_lmacTxFrame = 0x40000c5c ) ;
  PROVIDE ( __call_longjmp = 0x40000570 ) ;
  PROVIDE ( __call_mac_enable_bb = 0x4000136c ) ;
  PROVIDE ( __call_mac_tx_chan_offset = 0x40001354 ) ;
  PROVIDE ( __call_mac_tx_set_duration = 0x40000c60 ) ;
  PROVIDE ( __call_mac_tx_set_hesig = 0x40000e3c ) ;
  PROVIDE ( __call_mac_tx_set_mplen = 0x40000e48 ) ;
  PROVIDE ( __call_mac_tx_set_plcp0 = 0x40000c64 ) ;
  PROVIDE ( __call_mac_tx_set_plcp1 = 0x40000c68 ) ;
  PROVIDE ( __call_mac_tx_set_plcp2 = 0x40000c6c ) ;
  PROVIDE ( __call_mac_tx_set_tb = 0x40000e44 ) ;
  PROVIDE ( __call_md5_vector = 0x40000748 ) ;
  PROVIDE ( __call_meas_tone_pwr_db = 0x400011bc ) ;
  PROVIDE ( __call_memccpy = 0x40000518 ) ;
  PROVIDE ( __call_memchr = 0x4000051c ) ;
  PROVIDE ( __call_memcmp = 0x400004b4 ) ;
  PROVIDE ( __call_memcpy = 0x400004ac ) ;
  PROVIDE ( __call_memmove = 0x400004b0 ) ;
  PROVIDE ( __call_memrchr = 0x40000520 ) ;
  PROVIDE ( __call_memset = 0x400004a8 ) ;
  PROVIDE ( __call_memspi_host_erase_block = 0x40000314 ) ;
  PROVIDE ( __call_memspi_host_erase_chip = 0x4000030c ) ;
  PROVIDE ( __call_memspi_host_erase_sector = 0x40000310 ) ;
  PROVIDE ( __call_memspi_host_flush_cache = 0x40000308 ) ;
  PROVIDE ( __call_memspi_host_program_page = 0x40000318 ) ;
  PROVIDE ( __call_memspi_host_read = 0x4000031c ) ;
  PROVIDE ( __call_memspi_host_read_data_slicer = 0x40000328 ) ;
  PROVIDE ( __call_memspi_host_read_id_hs = 0x40000300 ) ;
  PROVIDE ( __call_memspi_host_read_status_hs = 0x40000304 ) ;
  PROVIDE ( __call_memspi_host_set_max_read_len = 0x40000324 ) ;
  PROVIDE ( __call_memspi_host_set_write_protect = 0x40000320 ) ;
  PROVIDE ( __call_memspi_host_write_data_slicer = 0x4000032c ) ;
  PROVIDE ( __call_mhz2ieee = 0x40001220 ) ;
  PROVIDE ( __call_multi_heap_aligned_alloc_impl = 0x4000048c ) ;
  PROVIDE ( __call_multi_heap_aligned_alloc_impl_offs = 0x40000488 ) ;
  PROVIDE ( __call_multi_heap_check = 0x40000490 ) ;
  PROVIDE ( __call_multi_heap_dump = 0x40000494 ) ;
  PROVIDE ( __call_multi_heap_free_impl = 0x40000480 ) ;
  PROVIDE ( __call_multi_heap_free_size_impl = 0x40000498 ) ;
  PROVIDE ( __call_multi_heap_get_allocated_size_impl = 0x40000458 ) ;
  PROVIDE ( __call_multi_heap_get_block_address_impl = 0x40000454 ) ;
  PROVIDE ( __call_multi_heap_get_first_block = 0x40000470 ) ;
  PROVIDE ( __call_multi_heap_get_info_impl = 0x400004a0 ) ;
  PROVIDE ( __call_multi_heap_get_next_block = 0x40000474 ) ;
  PROVIDE ( __call_multi_heap_internal_lock = 0x40000468 ) ;
  PROVIDE ( __call_multi_heap_internal_unlock = 0x4000046c ) ;
  PROVIDE ( __call_multi_heap_is_free = 0x40000478 ) ;
  PROVIDE ( __call_multi_heap_malloc_impl = 0x4000047c ) ;
  PROVIDE ( __call_multi_heap_minimum_free_size_impl = 0x4000049c ) ;
  PROVIDE ( __call_multi_heap_mutex_init = 0x40000464 ) ;
  PROVIDE ( __call_multi_heap_realloc_impl = 0x40000484 ) ;
  PROVIDE ( __call_multi_heap_register_impl = 0x4000045c ) ;
  PROVIDE ( __call_multi_heap_set_lock = 0x40000460 ) ;
  PROVIDE ( __call_multofup = 0x4000008c ) ;
  PROVIDE ( __call_mumimo_spatial_cfg_get_nsts = 0x400010d4 ) ;
  PROVIDE ( __call_mumimo_spatial_cfg_get_nsts_tot = 0x400010d8 ) ;
  PROVIDE ( __call_mz_adler32 = 0x400000c8 ) ;
  PROVIDE ( __call_mz_free = 0x400000cc ) ;
  PROVIDE ( __call_noise_floor_auto_set = 0x4000139c ) ;
  PROVIDE ( __call_nrx_freq_set = 0x400013d8 ) ;
  PROVIDE ( __call_open_i2c_xpd = 0x40001384 ) ;
  PROVIDE ( __call_pbus_debugmode = 0x40001320 ) ;
  PROVIDE ( __call_pbus_rx_dco_cal = 0x40001410 ) ;
  PROVIDE ( __call_pbus_rx_dco_cal_1step = 0x40001418 ) ;
  PROVIDE ( __call_pbus_set_dco = 0x40001328 ) ;
  PROVIDE ( __call_pbus_workmode = 0x40001324 ) ;
  PROVIDE ( __call_phy_ant_init = 0x400013b0 ) ;
  PROVIDE ( __call_phy_bbpll_cal = 0x400013ac ) ;
  PROVIDE ( __call_phy_byte_to_word = 0x40001138 ) ;
  PROVIDE ( __call_phy_chan_dump_cfg_rom = 0x400011f4 ) ;
  PROVIDE ( __call_phy_chan_filt_set_rom = 0x40001208 ) ;
  PROVIDE ( __call_phy_close_pa = 0x400013c8 ) ;
  PROVIDE ( __call_phy_dig_reg_backup_rom = 0x40001204 ) ;
  PROVIDE ( __call_phy_dis_hw_set_freq = 0x4000118c ) ;
  PROVIDE ( __call_phy_disable_cca = 0x40001340 ) ;
  PROVIDE ( __call_phy_disable_low_rate = 0x400011fc ) ;
  PROVIDE ( __call_phy_en_hw_set_freq = 0x40001188 ) ;
  PROVIDE ( __call_phy_enable_cca = 0x40001344 ) ;
  PROVIDE ( __call_phy_enable_low_rate = 0x400011f8 ) ;
  PROVIDE ( __call_phy_force_pwr_index = 0x400013e0 ) ;
  PROVIDE ( __call_phy_freq_correct = 0x400013cc ) ;
  PROVIDE ( __call_phy_get_romfuncs = 0x40001108 ) ;
  PROVIDE ( __call_phy_is_low_rate_enabled = 0x40001200 ) ;
  PROVIDE ( __call_phy_param_addr = 0x40001104 ) ;
  PROVIDE ( __call_phy_pwdet_always_en = 0x400011d4 ) ;
  PROVIDE ( __call_phy_pwdet_onetime_en = 0x400011d8 ) ;
  PROVIDE ( __call_phy_rx11blr_cfg = 0x4000120c ) ;
  PROVIDE ( __call_phy_rx_sense_set = 0x400013c0 ) ;
  PROVIDE ( __call_phy_set_bbfreq_init = 0x400013b4 ) ;
  PROVIDE ( __call_pkdet_vol_start = 0x400011c0 ) ;
  PROVIDE ( __call_pll_cap_mem_update = 0x4000117c ) ;
  PROVIDE ( __call_pll_dac_mem_update = 0x40001178 ) ;
  PROVIDE ( __call_pm_allow_tx = 0x40000e30 ) ;
  PROVIDE ( __call_pm_check_state = 0x40000c70 ) ;
  PROVIDE ( __call_pm_disable_dream_timer = 0x40000c74 ) ;
  PROVIDE ( __call_pm_disable_sleep_delay_timer = 0x40000c78 ) ;
  PROVIDE ( __call_pm_dream = 0x40000c7c ) ;
  PROVIDE ( __call_pm_enable_active_timer = 0x40000c88 ) ;
  PROVIDE ( __call_pm_enable_sleep_delay_timer = 0x40000c8c ) ;
  PROVIDE ( __call_pm_is_in_wifi_slice_threshold = 0x40000c98 ) ;
  PROVIDE ( __call_pm_is_waked = 0x40000c9c ) ;
  PROVIDE ( __call_pm_keep_alive = 0x40000ca0 ) ;
  PROVIDE ( __call_pm_local_tsf_process = 0x40000c90 ) ;
  PROVIDE ( __call_pm_mac_sleep = 0x40000c84 ) ;
  PROVIDE ( __call_pm_mac_wakeup = 0x40000c80 ) ;
  PROVIDE ( __call_pm_on_beacon_rx = 0x40000ca4 ) ;
  PROVIDE ( __call_pm_on_data_rx = 0x40000ca8 ) ;
  PROVIDE ( __call_pm_on_tbtt = 0x40000cac ) ;
  PROVIDE ( __call_pm_parse_beacon = 0x40000cb0 ) ;
  PROVIDE ( __call_pm_process_tim = 0x40000cb4 ) ;
  PROVIDE ( __call_pm_rx_beacon_process = 0x40000cb8 ) ;
  PROVIDE ( __call_pm_rx_data_process = 0x40000cbc ) ;
  PROVIDE ( __call_pm_set_beacon_filter = 0x40000c94 ) ;
  PROVIDE ( __call_pm_sleep = 0x40000cc0 ) ;
  PROVIDE ( __call_pm_sleep_for = 0x40000cc4 ) ;
  PROVIDE ( __call_pm_tbtt_process = 0x40000cc8 ) ;
  PROVIDE ( __call_pm_tx_data_done_process = 0x40000e1c ) ;
  PROVIDE ( __call_ppAMPDU2Normal = 0x40000ccc ) ;
  PROVIDE ( __call_ppAdd2AMPDUTail = 0x4000105c ) ;
  PROVIDE ( __call_ppAssembleAMPDU = 0x40000cd0 ) ;
  PROVIDE ( __call_ppCalDeliNum = 0x40001058 ) ;
  PROVIDE ( __call_ppCalFrameTimes = 0x40000cd4 ) ;
  PROVIDE ( __call_ppCalPreFecPaddingFactor = 0x40000e40 ) ;
  PROVIDE ( __call_ppCalSubFrameLength = 0x40000cd8 ) ;
  PROVIDE ( __call_ppCalTxAMPDULength = 0x40000cdc ) ;
  PROVIDE ( __call_ppCalTxHEAMPDULength = 0x40001034 ) ;
  PROVIDE ( __call_ppCalTxHESMPDULength = 0x40001038 ) ;
  PROVIDE ( __call_ppCalTxopRTSThreshold = 0x40000bdc ) ;
  PROVIDE ( __call_ppCertSetRate = 0x4000102c ) ;
  PROVIDE ( __call_ppCheckTxAMPDUlength = 0x40000ce0 ) ;
  PROVIDE ( __call_ppCheckTxHEAMPDUlength = 0x4000104c ) ;
  PROVIDE ( __call_ppDequeueRxq_Locked = 0x40000ce4 ) ;
  PROVIDE ( __call_ppDequeueTxDone_Locked = 0x40000e14 ) ;
  PROVIDE ( __call_ppDequeueTxQ = 0x40000ce8 ) ;
  PROVIDE ( __call_ppDirectRecycleAmpdu = 0x40001048 ) ;
  PROVIDE ( __call_ppDisableQueue = 0x40000e2c ) ;
  PROVIDE ( __call_ppEmptyDelimiterLength = 0x40000cec ) ;
  PROVIDE ( __call_ppEnqueueRxq = 0x40000cf0 ) ;
  PROVIDE ( __call_ppEnqueueTxDone = 0x40000cf4 ) ;
  PROVIDE ( __call_ppGetTxframe = 0x40000cf8 ) ;
  PROVIDE ( __call_ppHEAMPDU2Normal = 0x40001030 ) ;
  PROVIDE ( __call_ppMapTxQueue = 0x40000cfc ) ;
  PROVIDE ( __call_ppMapWaitTxq = 0x40000e24 ) ;
  PROVIDE ( __call_ppProcTxCallback = 0x40000e38 ) ;
  PROVIDE ( __call_ppProcTxDone = 0x40000e18 ) ;
  PROVIDE ( __call_ppProcTxSecFrame = 0x40000d00 ) ;
  PROVIDE ( __call_ppProcessRxPktHdr = 0x40000d04 ) ;
  PROVIDE ( __call_ppProcessTxQ = 0x40000d08 ) ;
  PROVIDE ( __call_ppProcessWaitingQueue = 0x40000e28 ) ;
  PROVIDE ( __call_ppRecordBarRRC = 0x40000d0c ) ;
  PROVIDE ( __call_ppRecycleAmpdu = 0x40000d10 ) ;
  PROVIDE ( __call_ppRecycleRxPkt = 0x40000d14 ) ;
  PROVIDE ( __call_ppRegressAmpdu = 0x40001054 ) ;
  PROVIDE ( __call_ppRemoveHTC = 0x40000e70 ) ;
  PROVIDE ( __call_ppResortTxAMPDU = 0x40000d18 ) ;
  PROVIDE ( __call_ppResumeTxAMPDU = 0x40000d1c ) ;
  PROVIDE ( __call_ppRxFragmentProc = 0x40000d20 ) ;
  PROVIDE ( __call_ppRxPkt = 0x40000d24 ) ;
  PROVIDE ( __call_ppRxProtoProc = 0x40000d28 ) ;
  PROVIDE ( __call_ppSearchTxQueue = 0x40000d2c ) ;
  PROVIDE ( __call_ppSearchTxframe = 0x40000d30 ) ;
  PROVIDE ( __call_ppSelectNextQueue = 0x40000d34 ) ;
  PROVIDE ( __call_ppSelectTxFormat = 0x40001028 ) ;
  PROVIDE ( __call_ppSubFromAMPDU = 0x40000d38 ) ;
  PROVIDE ( __call_ppTask = 0x40000d3c ) ;
  PROVIDE ( __call_ppTxPkt = 0x40000d40 ) ;
  PROVIDE ( __call_ppTxPktForceWaked = 0x40000e50 ) ;
  PROVIDE ( __call_ppTxProtoProc = 0x40000d44 ) ;
  PROVIDE ( __call_ppTxqUpdateBitmap = 0x40000d48 ) ;
  PROVIDE ( __call_pp_coex_tx_request = 0x40000d4c ) ;
  PROVIDE ( __call_pp_hdrsize = 0x40000d50 ) ;
  PROVIDE ( __call_pp_post = 0x40000d54 ) ;
  PROVIDE ( __call_pp_process_hmac_waiting_txq = 0x40000d58 ) ;
  PROVIDE ( __call_printf = 0x400005f0 ) ;
  PROVIDE ( __call_pwdet_code_cal = 0x40001284 ) ;
  PROVIDE ( __call_pwdet_ref_code = 0x40001280 ) ;
  PROVIDE ( __call_pwdet_reg_init = 0x4000135c ) ;
  PROVIDE ( __call_pwr_hal_clear_intr_status = 0x40000e94 ) ;
  PROVIDE ( __call_pwr_hal_clear_mac_modem_beacon_miss_intr_filter = 0x40000e98 ) ;
  PROVIDE ( __call_pwr_hal_clear_mac_modem_rx_beacon_info = 0x40000e9c ) ;
  PROVIDE ( __call_pwr_hal_clear_mac_modem_rx_beacon_miss_counter = 0x40000ea0 ) ;
  PROVIDE ( __call_pwr_hal_clear_mac_modem_rx_beacon_sleep_counter = 0x40000ea4 ) ;
  PROVIDE ( __call_pwr_hal_clear_mac_modem_state_wakeup_protect_signal = 0x40000ea8 ) ;
  PROVIDE ( __call_pwr_hal_get_intr_raw_signal = 0x40000eac ) ;
  PROVIDE ( __call_pwr_hal_get_intr_status = 0x40000eb0 ) ;
  PROVIDE ( __call_pwr_hal_get_mac_modem_beacon_miss_limit_exceeded_status = 0x40000eb4 ) ;
  PROVIDE ( __call_pwr_hal_get_mac_modem_rx_beacon_location_state = 0x40000eb8 ) ;
  PROVIDE ( __call_pwr_hal_get_mac_modem_rx_beacon_valid_state = 0x40000ebc ) ;
  PROVIDE ( __call_pwr_hal_get_mac_modem_state_sleep_limit_exceeded_status = 0x40000ec0 ) ;
  PROVIDE ( __call_pwr_hal_set_beacon_filter_abort_disable = 0x40000ec4 ) ;
  PROVIDE ( __call_pwr_hal_set_beacon_filter_abort_enable = 0x40000ec8 ) ;
  PROVIDE ( __call_pwr_hal_set_beacon_filter_abort_length = 0x40000ecc ) ;
  PROVIDE ( __call_pwr_hal_set_beacon_filter_broadcast_wakeup_disable = 0x40000ed0 ) ;
  PROVIDE ( __call_pwr_hal_set_beacon_filter_broadcast_wakeup_enable = 0x40000ed4 ) ;
  PROVIDE ( __call_pwr_hal_set_beacon_filter_disable = 0x40000ed8 ) ;
  PROVIDE ( __call_pwr_hal_set_beacon_filter_enable = 0x40000edc ) ;
  PROVIDE ( __call_pwr_hal_set_beacon_filter_force_dump_disable = 0x40000ee0 ) ;
  PROVIDE ( __call_pwr_hal_set_beacon_filter_force_dump_enable = 0x40000ee4 ) ;
  PROVIDE ( __call_pwr_hal_set_beacon_filter_force_dump_limit = 0x40000ee8 ) ;
  PROVIDE ( __call_pwr_hal_set_beacon_filter_force_sync_disable = 0x40000eec ) ;
  PROVIDE ( __call_pwr_hal_set_beacon_filter_force_sync_enable = 0x40000ef0 ) ;
  PROVIDE ( __call_pwr_hal_set_beacon_filter_force_sync_limit = 0x40000ef4 ) ;
  PROVIDE ( __call_pwr_hal_set_beacon_filter_frame_crc_state = 0x40000ef8 ) ;
  PROVIDE ( __call_pwr_hal_set_beacon_filter_soc_wakeup_and_intr_disable = 0x40000efc ) ;
  PROVIDE ( __call_pwr_hal_set_beacon_filter_soc_wakeup_and_intr_enable = 0x40000f00 ) ;
  PROVIDE ( __call_pwr_hal_set_beacon_filter_unicast_wakeup_disable = 0x40000f04 ) ;
  PROVIDE ( __call_pwr_hal_set_beacon_filter_unicast_wakeup_enable = 0x40000f08 ) ;
  PROVIDE ( __call_pwr_hal_set_lpclk_cycle_time = 0x40000f0c ) ;
  PROVIDE ( __call_pwr_hal_set_lpclk_sync_disable = 0x40000f10 ) ;
  PROVIDE ( __call_pwr_hal_set_lpclk_sync_enable = 0x40000f14 ) ;
  PROVIDE ( __call_pwr_hal_set_mac_modem_beacon_miss_intr_disable = 0x40000f18 ) ;
  PROVIDE ( __call_pwr_hal_set_mac_modem_beacon_miss_intr_enable = 0x40000f1c ) ;
  PROVIDE ( __call_pwr_hal_set_mac_modem_beacon_miss_limit = 0x40000f20 ) ;
  PROVIDE ( __call_pwr_hal_set_mac_modem_beacon_miss_limit_exceeded_wakeup_disable = 0x40000f24 ) ;
  PROVIDE ( __call_pwr_hal_set_mac_modem_beacon_miss_limit_exceeded_wakeup_enable = 0x40000f28 ) ;
  PROVIDE ( __call_pwr_hal_set_mac_modem_beacon_miss_timeout = 0x40000f2c ) ;
  PROVIDE ( __call_pwr_hal_set_mac_modem_state_sleep_limit = 0x40000f30 ) ;
  PROVIDE ( __call_pwr_hal_set_mac_modem_state_sleep_limit_exceeded_wakeup_disable = 0x40000f34 ) ;
  PROVIDE ( __call_pwr_hal_set_mac_modem_state_sleep_limit_exceeded_wakeup_enable = 0x40000f38 ) ;
  PROVIDE ( __call_pwr_hal_set_mac_modem_state_wakeup_protect_disable = 0x40000f3c ) ;
  PROVIDE ( __call_pwr_hal_set_mac_modem_state_wakeup_protect_early_time = 0x40000f40 ) ;
  PROVIDE ( __call_pwr_hal_set_mac_modem_state_wakeup_protect_enable = 0x40000f44 ) ;
  PROVIDE ( __call_pwr_hal_set_mac_modem_tbtt_auto_period_disable = 0x40000f48 ) ;
  PROVIDE ( __call_pwr_hal_set_mac_modem_tbtt_auto_period_enable = 0x40000f4c ) ;
  PROVIDE ( __call_pwr_hal_set_mac_modem_tbtt_auto_period_interval = 0x40000f50 ) ;
  PROVIDE ( __call_pwr_hal_set_modem_state_interface = 0x40000f54 ) ;
  PROVIDE ( __call_qsort = 0x40000588 ) ;
  PROVIDE ( __call_rand = 0x40000590 ) ;
  PROVIDE ( __call_rand_r = 0x4000058c ) ;
  PROVIDE ( __call_rcAmpduLowerRate = 0x40000d6c ) ;
  PROVIDE ( __call_rcClearCurAMPDUSched = 0x40000d74 ) ;
  PROVIDE ( __call_rcClearCurSched = 0x40000d78 ) ;
  PROVIDE ( __call_rcClearCurStat = 0x40000d7c ) ;
  PROVIDE ( __call_rcGetAmpduSched = 0x40000d5c ) ;
  PROVIDE ( __call_rcGetDCMMaxRate = 0x40001040 ) ;
  PROVIDE ( __call_rcGetRate = 0x4000103c ) ;
  PROVIDE ( __call_rcGetSMPDURate = 0x40001044 ) ;
  PROVIDE ( __call_rcGetSched = 0x40000d80 ) ;
  PROVIDE ( __call_rcLowerSched = 0x40000d84 ) ;
  PROVIDE ( __call_rcSetTxAmpduLimit = 0x40000d88 ) ;
  PROVIDE ( __call_rcTxUpdatePer = 0x40000d8c ) ;
  PROVIDE ( __call_rcUpSched = 0x40000da0 ) ;
  PROVIDE ( __call_rcUpdateAckSnr = 0x40000d90 ) ;
  PROVIDE ( __call_rcUpdateRate = 0x40000d94 ) ;
  PROVIDE ( __call_rcUpdateRxDone = 0x40000d60 ) ;
  PROVIDE ( __call_rcUpdateTxDone = 0x40000d98 ) ;
  PROVIDE ( __call_rcUpdateTxDoneAmpdu2 = 0x40000d9c ) ;
  PROVIDE ( __call_rc_cal = 0x40001118 ) ;
  PROVIDE ( __call_rc_get_trc = 0x40000d64 ) ;
  PROVIDE ( __call_rc_get_trc_by_index = 0x40000d68 ) ;
  PROVIDE ( __call_rcampduuprate = 0x40000d70 ) ;
  PROVIDE ( __call_read_hw_noisefloor = 0x400013a0 ) ;
  PROVIDE ( __call_read_pll_cap = 0x4000124c ) ;
  PROVIDE ( __call_read_rf_freq_mem = 0x40001164 ) ;
  PROVIDE ( __call_read_sar2_code = 0x400011c4 ) ;
  PROVIDE ( __call_recv_packet = 0x400000b0 ) ;
  PROVIDE ( __call_restart_cal = 0x40001228 ) ;
  PROVIDE ( __call_rfcal_pwrctrl = 0x40001290 ) ;
  PROVIDE ( __call_rfcal_rxiq = 0x40001404 ) ;
  PROVIDE ( __call_rfcal_txcap = 0x40001288 ) ;
  PROVIDE ( __call_rfcal_txiq = 0x40001278 ) ;
  PROVIDE ( __call_rfpll_cap_correct = 0x40001240 ) ;
  PROVIDE ( __call_rfpll_cap_init_cal = 0x40001244 ) ;
  PROVIDE ( __call_rom_bb_bss_cbw40 = 0x4000112c ) ;
  PROVIDE ( __call_rom_bb_gain_index = 0x400013ec ) ;
  PROVIDE ( __call_rom_chip_i2c_readReg = 0x400012b8 ) ;
  PROVIDE ( __call_rom_chip_i2c_readReg_org = 0x400012b4 ) ;
  PROVIDE ( __call_rom_chip_i2c_writeReg = 0x400012c0 ) ;
  PROVIDE ( __call_rom_en_pwdet = 0x40001194 ) ;
  PROVIDE ( __call_rom_enter_critical_phy = 0x4000111c ) ;
  PROVIDE ( __call_rom_exit_critical_phy = 0x40001120 ) ;
  PROVIDE ( __call_rom_get_i2c_hostid = 0x400012b0 ) ;
  PROVIDE ( __call_rom_get_i2c_mst0_mask = 0x400012ac ) ;
  PROVIDE ( __call_rom_get_i2c_read_mask = 0x400012a8 ) ;
  PROVIDE ( __call_rom_get_sar_sig_ref = 0x40001198 ) ;
  PROVIDE ( __call_rom_i2c_enter_critical = 0x400012a0 ) ;
  PROVIDE ( __call_rom_i2c_exit_critical = 0x400012a4 ) ;
  PROVIDE ( __call_rom_i2c_readReg = 0x400012bc ) ;
  PROVIDE ( __call_rom_i2c_readReg_Mask = 0x400012c8 ) ;
  PROVIDE ( __call_rom_i2c_writeReg = 0x400012c4 ) ;
  PROVIDE ( __call_rom_i2c_writeReg_Mask = 0x400012cc ) ;
  PROVIDE ( __call_rom_iq_est_disable = 0x400013e8 ) ;
  PROVIDE ( __call_rom_iq_est_enable = 0x400013e4 ) ;
  PROVIDE ( __call_rom_loopback_mode_en = 0x40001128 ) ;
  PROVIDE ( __call_rom_pbus_force_mode = 0x400012f0 ) ;
  PROVIDE ( __call_rom_pbus_force_test = 0x400012fc ) ;
  PROVIDE ( __call_rom_pbus_rd = 0x40001300 ) ;
  PROVIDE ( __call_rom_pbus_rd_addr = 0x400012f4 ) ;
  PROVIDE ( __call_rom_pbus_rd_shift = 0x400012f8 ) ;
  PROVIDE ( __call_rom_pbus_set_rxgain = 0x40001304 ) ;
  PROVIDE ( __call_rom_pbus_xpd_rx_off = 0x40001308 ) ;
  PROVIDE ( __call_rom_pbus_xpd_rx_on = 0x4000130c ) ;
  PROVIDE ( __call_rom_pbus_xpd_tx_off = 0x40001310 ) ;
  PROVIDE ( __call_rom_pbus_xpd_tx_on = 0x40001314 ) ;
  PROVIDE ( __call_rom_pwdet_sar2_init = 0x40001190 ) ;
  PROVIDE ( __call_rom_pwdet_tone_start = 0x4000119c ) ;
  PROVIDE ( __call_rom_pwdet_wait_idle = 0x400011a0 ) ;
  PROVIDE ( __call_rom_read_sar_dout = 0x400011a4 ) ;
  PROVIDE ( __call_rom_rfpll_set_freq = 0x4000121c ) ;
  PROVIDE ( __call_rom_rfrx_gain_index = 0x400013f0 ) ;
  PROVIDE ( __call_rom_set_chan_cal_interp = 0x40001124 ) ;
  PROVIDE ( __call_rom_set_chan_freq_sw_start = 0x40001144 ) ;
  PROVIDE ( __call_rom_set_loopback_gain = 0x40001318 ) ;
  PROVIDE ( __call_rom_set_txcap_reg = 0x400012d0 ) ;
  PROVIDE ( __call_rom_start_tx_tone_step = 0x40001330 ) ;
  PROVIDE ( __call_rom_stop_tx_tone = 0x40001334 ) ;
  PROVIDE ( __call_rom_txcal_debuge_mode = 0x4000131c ) ;
  PROVIDE ( __call_roundup2 = 0x40000088 ) ;
  PROVIDE ( __call_rssi_margin = 0x40000da4 ) ;
  PROVIDE ( __call_rtc_get_reset_reason = 0x40000018 ) ;
  PROVIDE ( __call_rtc_get_wakeup_cause = 0x40000020 ) ;
  PROVIDE ( __call_rtc_unhold_all_pads = 0x40000024 ) ;
  PROVIDE ( __call_rx11ACRate2AMPDULimit = 0x40000e90 ) ;
  PROVIDE ( __call_rx11AXRate2AMPDULimit = 0x40001050 ) ;
  PROVIDE ( __call_rx11NRate2AMPDULimit = 0x40000da8 ) ;
  PROVIDE ( __call_rx_gain_force_rom = 0x40001218 ) ;
  PROVIDE ( __call_rxdc_est_min = 0x40001414 ) ;
  PROVIDE ( __call_rxiq_cover_mg_mp = 0x40001400 ) ;
  PROVIDE ( __call_rxiq_get_mis = 0x400013fc ) ;
  PROVIDE ( __call_rxiq_set_reg = 0x4000138c ) ;
  PROVIDE ( __call_sbrk = 0x400004d8 ) ;
  PROVIDE ( __call_send_packet = 0x400000ac ) ;
  PROVIDE ( __call_set_cal_rxdc = 0x400013f8 ) ;
  PROVIDE ( __call_set_cca_rom = 0x40001210 ) ;
  PROVIDE ( __call_set_chan_reg = 0x4000113c ) ;
  PROVIDE ( __call_set_channel_rfpll_freq = 0x4000123c ) ;
  PROVIDE ( __call_set_lb_txiq = 0x4000141c ) ;
  PROVIDE ( __call_set_pbus_reg = 0x400013d0 ) ;
  PROVIDE ( __call_set_rf_freq_offset = 0x40001234 ) ;
  PROVIDE ( __call_set_rfpll_freq = 0x40001238 ) ;
  PROVIDE ( __call_set_rx_comp = 0x40001378 ) ;
  PROVIDE ( __call_set_rx_gain_cal_dc = 0x40001424 ) ;
  PROVIDE ( __call_set_rx_gain_cal_iq = 0x40001420 ) ;
  PROVIDE ( __call_set_rx_sense_rom = 0x40001214 ) ;
  PROVIDE ( __call_set_rxclk_en = 0x40001394 ) ;
  PROVIDE ( __call_set_txclk_en = 0x40001390 ) ;
  PROVIDE ( __call_setjmp = 0x40000574 ) ;
  PROVIDE ( __call_sip_after_tx_complete = 0x40000a94 ) ;
  PROVIDE ( __call_sip_alloc_to_host_evt = 0x40000a98 ) ;
  PROVIDE ( __call_sip_download_begin = 0x40000a9c ) ;
  PROVIDE ( __call_sip_get_ptr = 0x40000aa0 ) ;
  PROVIDE ( __call_sip_get_state = 0x40000aa4 ) ;
  PROVIDE ( __call_sip_init_attach = 0x40000aa8 ) ;
  PROVIDE ( __call_sip_install_rx_ctrl_cb = 0x40000aac ) ;
  PROVIDE ( __call_sip_install_rx_data_cb = 0x40000ab0 ) ;
  PROVIDE ( __call_sip_is_active = 0x40000ab4 ) ;
  PROVIDE ( __call_sip_post_init = 0x40000ab8 ) ;
  PROVIDE ( __call_sip_reclaim_from_host_cmd = 0x40000abc ) ;
  PROVIDE ( __call_sip_reclaim_tx_data_pkt = 0x40000ac0 ) ;
  PROVIDE ( __call_sip_send = 0x40000ac4 ) ;
  PROVIDE ( __call_sip_to_host_chain_append = 0x40000ac8 ) ;
  PROVIDE ( __call_sip_to_host_evt_send_done = 0x40000acc ) ;
  PROVIDE ( __call_siprintf = 0x40000608 ) ;
  PROVIDE ( __call_siscanf = 0x40000624 ) ;
  PROVIDE ( __call_slc_add_credits = 0x40000ad0 ) ;
  PROVIDE ( __call_slc_enable = 0x40000ad4 ) ;
  PROVIDE ( __call_slc_from_host_chain_fetch = 0x40000ad8 ) ;
  PROVIDE ( __call_slc_from_host_chain_recycle = 0x40000adc ) ;
  PROVIDE ( __call_slc_has_pkt_to_host = 0x40000ae0 ) ;
  PROVIDE ( __call_slc_init_attach = 0x40000ae4 ) ;
  PROVIDE ( __call_slc_init_credit = 0x40000ae8 ) ;
  PROVIDE ( __call_slc_reattach = 0x40000aec ) ;
  PROVIDE ( __call_slc_send_to_host_chain = 0x40000af0 ) ;
  PROVIDE ( __call_slc_set_host_io_max_window = 0x40000af4 ) ;
  PROVIDE ( __call_slc_to_host_chain_recycle = 0x40000af8 ) ;
  PROVIDE ( __call_sniprintf = 0x4000060c ) ;
  PROVIDE ( __call_snprintf = 0x40000604 ) ;
  PROVIDE ( __call_software_reset = 0x40000090 ) ;
  PROVIDE ( __call_software_reset_cpu = 0x40000094 ) ;
  PROVIDE ( __call_spi_cache_mode_switch = 0x4000018c ) ;
  PROVIDE ( __call_spi_common_set_dummy_output = 0x40000190 ) ;
  PROVIDE ( __call_spi_common_set_flash_cs_timing = 0x40000194 ) ;
  PROVIDE ( __call_spi_dummy_len_fix = 0x400001d0 ) ;
  PROVIDE ( __call_spi_flash_attach = 0x400001dc ) ;
  PROVIDE ( __call_spi_flash_boot_attach = 0x4000026c ) ;
  PROVIDE ( __call_spi_flash_cache2phys = 0x40000224 ) ;
  PROVIDE ( __call_spi_flash_cache_enabled = 0x400001f8 ) ;
  PROVIDE ( __call_spi_flash_check_and_flush_cache = 0x4000021c ) ;
  PROVIDE ( __call_spi_flash_chip_gd_get_io_mode = 0x400002f4 ) ;
  PROVIDE ( __call_spi_flash_chip_gd_probe = 0x400002f8 ) ;
  PROVIDE ( __call_spi_flash_chip_gd_set_io_mode = 0x400002fc ) ;
  PROVIDE ( __call_spi_flash_chip_generic_config_host_io_mode = 0x400002c4 ) ;
  PROVIDE ( __call_spi_flash_chip_generic_detect_size = 0x40000284 ) ;
  PROVIDE ( __call_spi_flash_chip_generic_erase_block = 0x400002a4 ) ;
  PROVIDE ( __call_spi_flash_chip_generic_erase_chip = 0x4000029c ) ;
  PROVIDE ( __call_spi_flash_chip_generic_erase_sector = 0x400002a0 ) ;
  PROVIDE ( __call_spi_flash_chip_generic_get_caps = 0x400002ec ) ;
  PROVIDE ( __call_spi_flash_chip_generic_get_io_mode = 0x400002d0 ) ;
  PROVIDE ( __call_spi_flash_chip_generic_get_write_protect = 0x400002ac ) ;
  PROVIDE ( __call_spi_flash_chip_generic_page_program = 0x400002a8 ) ;
  PROVIDE ( __call_spi_flash_chip_generic_probe = 0x40000280 ) ;
  PROVIDE ( __call_spi_flash_chip_generic_read = 0x400002c8 ) ;
  PROVIDE ( __call_spi_flash_chip_generic_read_reg = 0x400002b4 ) ;
  PROVIDE ( __call_spi_flash_chip_generic_read_unique_id = 0x400002e8 ) ;
  PROVIDE ( __call_spi_flash_chip_generic_reset = 0x40000298 ) ;
  PROVIDE ( __call_spi_flash_chip_generic_set_io_mode = 0x400002e4 ) ;
  PROVIDE ( __call_spi_flash_chip_generic_set_write_protect = 0x40000290 ) ;
  PROVIDE ( __call_spi_flash_chip_generic_suspend_cmd_conf = 0x400002f0 ) ;
  PROVIDE ( __call_spi_flash_chip_generic_wait_idle = 0x400002c0 ) ;
  PROVIDE ( __call_spi_flash_chip_generic_write = 0x40000288 ) ;
  PROVIDE ( __call_spi_flash_chip_generic_write_encrypted = 0x4000028c ) ;
  PROVIDE ( __call_spi_flash_chip_generic_yield = 0x400002b8 ) ;
  PROVIDE ( __call_spi_flash_common_read_status_16b_rdsr_rdsr2 = 0x400002b0 ) ;
  PROVIDE ( __call_spi_flash_common_read_status_8b_rdsr = 0x400002d4 ) ;
  PROVIDE ( __call_spi_flash_common_read_status_8b_rdsr2 = 0x400002cc ) ;
  PROVIDE ( __call_spi_flash_common_set_io_mode = 0x400002e0 ) ;
  PROVIDE ( __call_spi_flash_common_write_status_16b_wrsr = 0x40000294 ) ;
  PROVIDE ( __call_spi_flash_common_write_status_8b_wrsr = 0x400002d8 ) ;
  PROVIDE ( __call_spi_flash_common_write_status_8b_wrsr2 = 0x400002dc ) ;
  PROVIDE ( __call_spi_flash_disable_cache = 0x400001f0 ) ;
  PROVIDE ( __call_spi_flash_enable_cache = 0x400001fc ) ;
  PROVIDE ( __call_spi_flash_encryption_hal_check = 0x40000390 ) ;
  PROVIDE ( __call_spi_flash_encryption_hal_destroy = 0x4000038c ) ;
  PROVIDE ( __call_spi_flash_encryption_hal_disable = 0x40000380 ) ;
  PROVIDE ( __call_spi_flash_encryption_hal_done = 0x40000388 ) ;
  PROVIDE ( __call_spi_flash_encryption_hal_enable = 0x4000037c ) ;
  PROVIDE ( __call_spi_flash_encryption_hal_prepare = 0x40000384 ) ;
  PROVIDE ( __call_spi_flash_generic_wait_host_idle = 0x400002bc ) ;
  PROVIDE ( __call_spi_flash_get_chip_size = 0x400001e0 ) ;
  PROVIDE ( __call_spi_flash_guard_get = 0x400001e8 ) ;
  PROVIDE ( __call_spi_flash_guard_set = 0x400001e4 ) ;
  PROVIDE ( __call_spi_flash_hal_check_status = 0x4000035c ) ;
  PROVIDE ( __call_spi_flash_hal_common_command = 0x4000033c ) ;
  PROVIDE ( __call_spi_flash_hal_configure_host_io_mode = 0x40000338 ) ;
  PROVIDE ( __call_spi_flash_hal_device_config = 0x40000334 ) ;
  PROVIDE ( __call_spi_flash_hal_disable_auto_resume_mode = 0x40000370 ) ;
  PROVIDE ( __call_spi_flash_hal_disable_auto_suspend_mode = 0x4000036c ) ;
  PROVIDE ( __call_spi_flash_hal_erase_block = 0x4000034c ) ;
  PROVIDE ( __call_spi_flash_hal_erase_chip = 0x40000344 ) ;
  PROVIDE ( __call_spi_flash_hal_erase_sector = 0x40000348 ) ;
  PROVIDE ( __call_spi_flash_hal_host_idle = 0x40000358 ) ;
  PROVIDE ( __call_spi_flash_hal_poll_cmd_done = 0x40000330 ) ;
  PROVIDE ( __call_spi_flash_hal_program_page = 0x40000350 ) ;
  PROVIDE ( __call_spi_flash_hal_read = 0x40000340 ) ;
  PROVIDE ( __call_spi_flash_hal_resume = 0x40000374 ) ;
  PROVIDE ( __call_spi_flash_hal_set_write_protect = 0x40000354 ) ;
  PROVIDE ( __call_spi_flash_hal_setup_auto_resume_mode = 0x40000368 ) ;
  PROVIDE ( __call_spi_flash_hal_setup_auto_suspend_mode = 0x40000364 ) ;
  PROVIDE ( __call_spi_flash_hal_setup_read_suspend = 0x40000360 ) ;
  PROVIDE ( __call_spi_flash_hal_suspend = 0x40000378 ) ;
  PROVIDE ( __call_spi_flash_mmap = 0x4000020c ) ;
  PROVIDE ( __call_spi_flash_mmap_dump = 0x40000218 ) ;
  PROVIDE ( __call_spi_flash_mmap_get_free_pages = 0x40000220 ) ;
  PROVIDE ( __call_spi_flash_mmap_os_func_set = 0x40000204 ) ;
  PROVIDE ( __call_spi_flash_mmap_page_num_init = 0x40000208 ) ;
  PROVIDE ( __call_spi_flash_mmap_pages = 0x40000210 ) ;
  PROVIDE ( __call_spi_flash_munmap = 0x40000214 ) ;
  PROVIDE ( __call_spi_flash_phys2cache = 0x40000228 ) ;
  PROVIDE ( __call_spi_flash_read_encrypted = 0x400001ec ) ;
  PROVIDE ( __call_spi_flash_restore_cache = 0x400001f4 ) ;
  PROVIDE ( __call_sprintf = 0x40000600 ) ;
  PROVIDE ( __call_spur_cal = 0x4000142c ) ;
  PROVIDE ( __call_spur_coef_cfg = 0x40001430 ) ;
  PROVIDE ( __call_spur_reg_write_one_tone = 0x40001428 ) ;
  PROVIDE ( __call_srand = 0x40000594 ) ;
  PROVIDE ( __call_sscanf = 0x40000620 ) ;
  PROVIDE ( __call_sta_input = 0x40000b9c ) ;
  PROVIDE ( __call_strcasecmp = 0x40000524 ) ;
  PROVIDE ( __call_strcasestr = 0x40000528 ) ;
  PROVIDE ( __call_strcat = 0x4000052c ) ;
  PROVIDE ( __call_strchr = 0x40000534 ) ;
  PROVIDE ( __call_strcmp = 0x400004c0 ) ;
  PROVIDE ( __call_strcoll = 0x4000053c ) ;
  PROVIDE ( __call_strcpy = 0x400004b8 ) ;
  PROVIDE ( __call_strcspn = 0x40000538 ) ;
  PROVIDE ( __call_strdup = 0x40000530 ) ;
  PROVIDE ( __call_strlcat = 0x40000540 ) ;
  PROVIDE ( __call_strlcpy = 0x40000544 ) ;
  PROVIDE ( __call_strlen = 0x400004c8 ) ;
  PROVIDE ( __call_strlwr = 0x40000548 ) ;
  PROVIDE ( __call_strncasecmp = 0x4000054c ) ;
  PROVIDE ( __call_strncat = 0x40000550 ) ;
  PROVIDE ( __call_strncmp = 0x400004c4 ) ;
  PROVIDE ( __call_strncpy = 0x400004bc ) ;
  PROVIDE ( __call_strndup = 0x40000554 ) ;
  PROVIDE ( __call_strnlen = 0x40000558 ) ;
  PROVIDE ( __call_strrchr = 0x4000055c ) ;
  PROVIDE ( __call_strsep = 0x40000560 ) ;
  PROVIDE ( __call_strspn = 0x40000564 ) ;
  PROVIDE ( __call_strstr = 0x400004cc ) ;
  PROVIDE ( __call_strtok_r = 0x40000568 ) ;
  PROVIDE ( __call_strtol = 0x400005a8 ) ;
  PROVIDE ( __call_strtoul = 0x400005ac ) ;
  PROVIDE ( __call_strupr = 0x4000056c ) ;
  PROVIDE ( __call_systimer_hal_connect_alarm_counter = 0x400003f4 ) ;
  PROVIDE ( __call_systimer_hal_counter_can_stall_by_cpu = 0x400003f8 ) ;
  PROVIDE ( __call_systimer_hal_counter_value_advance = 0x400003e8 ) ;
  PROVIDE ( __call_systimer_hal_deinit = 0x400003c4 ) ;
  PROVIDE ( __call_systimer_hal_enable_alarm_int = 0x400003e0 ) ;
  PROVIDE ( __call_systimer_hal_enable_counter = 0x400003ec ) ;
  PROVIDE ( __call_systimer_hal_get_alarm_value = 0x400003dc ) ;
  PROVIDE ( __call_systimer_hal_get_counter_value = 0x400003cc ) ;
  PROVIDE ( __call_systimer_hal_get_time = 0x400003d0 ) ;
  PROVIDE ( __call_systimer_hal_init = 0x400003c0 ) ;
  PROVIDE ( __call_systimer_hal_on_apb_freq_update = 0x400003e4 ) ;
  PROVIDE ( __call_systimer_hal_select_alarm_mode = 0x400003f0 ) ;
  PROVIDE ( __call_systimer_hal_set_alarm_period = 0x400003d8 ) ;
  PROVIDE ( __call_systimer_hal_set_alarm_target = 0x400003d4 ) ;
  PROVIDE ( __call_systimer_hal_set_tick_rate_ops = 0x400003c8 ) ;
  PROVIDE ( __call_tdefl_compress = 0x400000d0 ) ;
  PROVIDE ( __call_tdefl_compress_buffer = 0x400000d4 ) ;
  PROVIDE ( __call_tdefl_compress_mem_to_heap = 0x400000d8 ) ;
  PROVIDE ( __call_tdefl_compress_mem_to_mem = 0x400000dc ) ;
  PROVIDE ( __call_tdefl_compress_mem_to_output = 0x400000e0 ) ;
  PROVIDE ( __call_tdefl_get_adler32 = 0x400000e4 ) ;
  PROVIDE ( __call_tdefl_get_prev_return_status = 0x400000e8 ) ;
  PROVIDE ( __call_tdefl_init = 0x400000ec ) ;
  PROVIDE ( __call_tdefl_write_image_to_png_file_in_memory = 0x400000f0 ) ;
  PROVIDE ( __call_tdefl_write_image_to_png_file_in_memory_ex = 0x400000f4 ) ;
  PROVIDE ( __call_temp_to_power = 0x40001454 ) ;
  PROVIDE ( __call_test_free_rx_statistics = 0x400010b4 ) ;
  PROVIDE ( __call_test_mimo_update_user_info = 0x400010e0 ) ;
  PROVIDE ( __call_test_mumimo_get_heltf_num = 0x400010dc ) ;
  PROVIDE ( __call_test_nonmimo_update_user_info = 0x400010e8 ) ;
  PROVIDE ( __call_test_parse_rx_mu_mimo = 0x400010e4 ) ;
  PROVIDE ( __call_test_parse_rx_mu_nonmimo = 0x400010ec ) ;
  PROVIDE ( __call_test_rx_process_complete_noeb = 0x400010a0 ) ;
  PROVIDE ( __call_test_rx_process_complete_retry = 0x400010a4 ) ;
  PROVIDE ( __call_test_tx_fail_statistics = 0x40001078 ) ;
  PROVIDE ( __call_test_tx_succ_statistics = 0x4000107c ) ;
  PROVIDE ( __call_tinfl_decompress = 0x400000f8 ) ;
  PROVIDE ( __call_tinfl_decompress_mem_to_callback = 0x400000fc ) ;
  PROVIDE ( __call_tinfl_decompress_mem_to_heap = 0x40000100 ) ;
  PROVIDE ( __call_tinfl_decompress_mem_to_mem = 0x40000104 ) ;
  PROVIDE ( __call_tlsf_add_pool = 0x40000408 ) ;
  PROVIDE ( __call_tlsf_align_size = 0x4000042c ) ;
  PROVIDE ( __call_tlsf_alloc_overhead = 0x4000043c ) ;
  PROVIDE ( __call_tlsf_block_size = 0x40000424 ) ;
  PROVIDE ( __call_tlsf_block_size_max = 0x40000434 ) ;
  PROVIDE ( __call_tlsf_block_size_min = 0x40000430 ) ;
  PROVIDE ( __call_tlsf_check = 0x40000444 ) ;
  PROVIDE ( __call_tlsf_check_pool = 0x40000448 ) ;
  PROVIDE ( __call_tlsf_create = 0x400003fc ) ;
  PROVIDE ( __call_tlsf_create_with_pool = 0x40000400 ) ;
  PROVIDE ( __call_tlsf_free = 0x40000420 ) ;
  PROVIDE ( __call_tlsf_get_pool = 0x40000404 ) ;
  PROVIDE ( __call_tlsf_malloc = 0x40000410 ) ;
  PROVIDE ( __call_tlsf_memalign = 0x40000414 ) ;
  PROVIDE ( __call_tlsf_memalign_offs = 0x40000418 ) ;
  PROVIDE ( __call_tlsf_poison_check_pfunc_set = 0x40000450 ) ;
  PROVIDE ( __call_tlsf_poison_fill_pfunc_set = 0x4000044c ) ;
  PROVIDE ( __call_tlsf_pool_overhead = 0x40000438 ) ;
  PROVIDE ( __call_tlsf_realloc = 0x4000041c ) ;
  PROVIDE ( __call_tlsf_remove_pool = 0x4000040c ) ;
  PROVIDE ( __call_tlsf_size = 0x40000428 ) ;
  PROVIDE ( __call_tlsf_walk_pool = 0x40000440 ) ;
  PROVIDE ( __call_toascii = 0x40000514 ) ;
  PROVIDE ( __call_tolower = 0x40000510 ) ;
  PROVIDE ( __call_toupper = 0x4000050c ) ;
  PROVIDE ( __call_trcAmpduSetState = 0x40000dcc ) ;
  PROVIDE ( __call_trc_SetTxAmpduState = 0x40000dc4 ) ;
  PROVIDE ( __call_trc_calc_duration = 0x40000db4 ) ;
  PROVIDE ( __call_trc_isTxAmpduOperational = 0x40000db8 ) ;
  PROVIDE ( __call_trc_onAmpduOp = 0x40000dbc ) ;
  PROVIDE ( __call_trc_tid_isTxAmpduOperational = 0x40000dc8 ) ;
  PROVIDE ( __call_tsens_code_read = 0x4000144c ) ;
  PROVIDE ( __call_tsens_dac_cal = 0x40001448 ) ;
  PROVIDE ( __call_tsens_index_to_dac = 0x40001440 ) ;
  PROVIDE ( __call_tsens_index_to_offset = 0x40001444 ) ;
  PROVIDE ( __call_tsens_power_up = 0x40001434 ) ;
  PROVIDE ( __call_tsens_read_init = 0x40001438 ) ;
  PROVIDE ( __call_tsens_temp_read = 0x40001450 ) ;
  PROVIDE ( __call_tsf_hal_clear_mac_modem_rf_power_state = 0x40000f5c ) ;
  PROVIDE ( __call_tsf_hal_clear_soc_wakeup_request = 0x40000f60 ) ;
  PROVIDE ( __call_tsf_hal_get_counter_value = 0x40000f64 ) ;
  PROVIDE ( __call_tsf_hal_get_mac_modem_rf_power_state = 0x40000f68 ) ;
  PROVIDE ( __call_tsf_hal_get_tbtt_interval = 0x40000f6c ) ;
  PROVIDE ( __call_tsf_hal_get_time = 0x40000f70 ) ;
  PROVIDE ( __call_tsf_hal_get_timer_target = 0x40000f74 ) ;
  PROVIDE ( __call_tsf_hal_is_tsf_enabled = 0x40000f78 ) ;
  PROVIDE ( __call_tsf_hal_map_tbtt_target_to_rx_frame = 0x40000f7c ) ;
  PROVIDE ( __call_tsf_hal_map_tsf_to_bssid = 0x40000f80 ) ;
  PROVIDE ( __call_tsf_hal_set_counter_value = 0x40000f84 ) ;
  PROVIDE ( __call_tsf_hal_set_modem_wakeup_early_time = 0x40000f88 ) ;
  PROVIDE ( __call_tsf_hal_set_rx_beacon_abort_tsf_time_deviation_sync_disable = 0x40000f8c ) ;
  PROVIDE ( __call_tsf_hal_set_rx_beacon_abort_tsf_time_deviation_sync_enable = 0x40000f90 ) ;
  PROVIDE ( __call_tsf_hal_set_rx_beacon_fail_tsf_time_deviation_sync_disable = 0x40000f94 ) ;
  PROVIDE ( __call_tsf_hal_set_rx_beacon_fail_tsf_time_deviation_sync_enable = 0x40000f98 ) ;
  PROVIDE ( __call_tsf_hal_set_rx_beacon_success_tsf_time_deviation_sync_disable = 0x40000f9c ) ;
  PROVIDE ( __call_tsf_hal_set_rx_beacon_success_tsf_time_deviation_sync_enable = 0x40000fa0 ) ;
  PROVIDE ( __call_tsf_hal_set_tbtt_disable = 0x40000fa4 ) ;
  PROVIDE ( __call_tsf_hal_set_tbtt_early_time = 0x40000fa8 ) ;
  PROVIDE ( __call_tsf_hal_set_tbtt_enable = 0x40000fac ) ;
  PROVIDE ( __call_tsf_hal_set_tbtt_interval = 0x40000fb0 ) ;
  PROVIDE ( __call_tsf_hal_set_tbtt_intr_disable = 0x40000fb4 ) ;
  PROVIDE ( __call_tsf_hal_set_tbtt_intr_enable = 0x40000fb8 ) ;
  PROVIDE ( __call_tsf_hal_set_tbtt_modem_wakeup_disable = 0x40000fbc ) ;
  PROVIDE ( __call_tsf_hal_set_tbtt_modem_wakeup_enable = 0x40000fc0 ) ;
  PROVIDE ( __call_tsf_hal_set_tbtt_rf_ctrl_disable = 0x40000fc4 ) ;
  PROVIDE ( __call_tsf_hal_set_tbtt_rf_ctrl_enable = 0x40000fc8 ) ;
  PROVIDE ( __call_tsf_hal_set_tbtt_rf_ctrl_wait_cycles = 0x40000fcc ) ;
  PROVIDE ( __call_tsf_hal_set_tbtt_soc_wakeup_disable = 0x40000fd0 ) ;
  PROVIDE ( __call_tsf_hal_set_tbtt_soc_wakeup_enable = 0x40000fd4 ) ;
  PROVIDE ( __call_tsf_hal_set_tbtt_start_time = 0x40000fd8 ) ;
  PROVIDE ( __call_tsf_hal_set_time = 0x40000fdc ) ;
  PROVIDE ( __call_tsf_hal_set_timer_disable = 0x40000fe0 ) ;
  PROVIDE ( __call_tsf_hal_set_timer_enable = 0x40000fe4 ) ;
  PROVIDE ( __call_tsf_hal_set_timer_intr_disable = 0x40000fe8 ) ;
  PROVIDE ( __call_tsf_hal_set_timer_intr_enable = 0x40000fec ) ;
  PROVIDE ( __call_tsf_hal_set_timer_modem_wakeup_disable = 0x40000ff0 ) ;
  PROVIDE ( __call_tsf_hal_set_timer_modem_wakeup_enable = 0x40000ff4 ) ;
  PROVIDE ( __call_tsf_hal_set_timer_rf_ctrl_disable = 0x40000ff8 ) ;
  PROVIDE ( __call_tsf_hal_set_timer_rf_ctrl_enable = 0x40000ffc ) ;
  PROVIDE ( __call_tsf_hal_set_timer_rf_ctrl_wait_cycles = 0x40001000 ) ;
  PROVIDE ( __call_tsf_hal_set_timer_soc_wakeup_disable = 0x40001004 ) ;
  PROVIDE ( __call_tsf_hal_set_timer_soc_wakeup_enable = 0x40001008 ) ;
  PROVIDE ( __call_tsf_hal_set_timer_target = 0x4000100c ) ;
  PROVIDE ( __call_tsf_hal_set_tsf_disable = 0x40001010 ) ;
  PROVIDE ( __call_tsf_hal_set_tsf_enable = 0x40001014 ) ;
  PROVIDE ( __call_tsf_hal_set_tsf_time_deviation = 0x40001018 ) ;
  PROVIDE ( __call_tsf_hal_set_tsf_time_deviation_sync_disable = 0x4000101c ) ;
  PROVIDE ( __call_tsf_hal_set_tsf_time_deviation_sync_enable = 0x40001020 ) ;
  PROVIDE ( __call_tsf_hal_unmap_tbtt_target_to_rx_frame = 0x40001024 ) ;
  PROVIDE ( __call_tx_cap_init = 0x4000128c ) ;
  PROVIDE ( __call_tx_paon_set = 0x40001358 ) ;
  PROVIDE ( __call_tx_pwctrl_bg_init = 0x400011d0 ) ;
  PROVIDE ( __call_tx_pwctrl_init = 0x40001298 ) ;
  PROVIDE ( __call_tx_pwctrl_init_cal = 0x40001294 ) ;
  PROVIDE ( __call_tx_state_set = 0x400013c4 ) ;
  PROVIDE ( __call_txbbgain_to_index = 0x4000145c ) ;
  PROVIDE ( __call_txcal_work_mode = 0x4000132c ) ;
  PROVIDE ( __call_txdc_cal = 0x4000126c ) ;
  PROVIDE ( __call_txdc_cal_init = 0x40001268 ) ;
  PROVIDE ( __call_txiq_cal_init = 0x40001264 ) ;
  PROVIDE ( __call_txiq_cover = 0x40001274 ) ;
  PROVIDE ( __call_txiq_get_mis_pwr = 0x40001270 ) ;
  PROVIDE ( __call_txiq_set_reg = 0x40001388 ) ;
  PROVIDE ( __call_txtone_linear_pwr = 0x400011b0 ) ;
  PROVIDE ( __call_uartAttach = 0x40000070 ) ;
  PROVIDE ( __call_uart_div_modify = 0x4000007c ) ;
  PROVIDE ( __call_uart_rx_intr_handler = 0x40000068 ) ;
  PROVIDE ( __call_uart_rx_one_char = 0x40000060 ) ;
  PROVIDE ( __call_uart_rx_one_char_block = 0x40000064 ) ;
  PROVIDE ( __call_uart_rx_readbuff = 0x4000006c ) ;
  PROVIDE ( __call_uart_tx_flush = 0x40000074 ) ;
  PROVIDE ( __call_uart_tx_one_char = 0x40000058 ) ;
  PROVIDE ( __call_uart_tx_one_char2 = 0x4000005c ) ;
  PROVIDE ( __call_uart_tx_switch = 0x40000084 ) ;
  PROVIDE ( __call_uart_tx_wait_idle = 0x40000078 ) ;
  PROVIDE ( __call_usb_serial_device_rx_one_char = 0x40000a80 ) ;
  PROVIDE ( __call_usb_serial_device_rx_one_char_block = 0x40000a84 ) ;
  PROVIDE ( __call_usb_serial_device_tx_flush = 0x40000a88 ) ;
  PROVIDE ( __call_usb_serial_device_tx_one_char = 0x40000a8c ) ;
  PROVIDE ( __call_utoa = 0x40000598 ) ;
  PROVIDE ( __call_vfiprintf = 0x400005f4 ) ;
  PROVIDE ( __call_vfprintf = 0x400005f8 ) ;
  PROVIDE ( __call_viprintf = 0x40000614 ) ;
  PROVIDE ( __call_vprintf = 0x40000610 ) ;
  PROVIDE ( __call_vsniprintf = 0x4000061c ) ;
  PROVIDE ( __call_vsnprintf = 0x40000618 ) ;
  PROVIDE ( __call_wDevCheckBlockError = 0x40000dd0 ) ;
  PROVIDE ( __call_wDev_AppendRxBlocks = 0x40000dd4 ) ;
  PROVIDE ( __call_wDev_DiscardFrame = 0x40000dd8 ) ;
  PROVIDE ( __call_wDev_GetNoiseFloor = 0x40000ddc ) ;
  PROVIDE ( __call_wDev_IndicateAmpdu = 0x40000de0 ) ;
  PROVIDE ( __call_wDev_IndicateFrame = 0x40000de4 ) ;
  PROVIDE ( __call_wDev_ProcessFiq = 0x40000e04 ) ;
  PROVIDE ( __call_wDev_ProcessRxSucData = 0x40000e08 ) ;
  PROVIDE ( __call_wait_rfpll_cal_end = 0x40001230 ) ;
  PROVIDE ( __call_wdevProcessRxSucDataAll = 0x40000e0c ) ;
  PROVIDE ( __call_wdev_csi_len_align = 0x40000e10 ) ;
  PROVIDE ( __call_wdev_is_data_in_rxlist = 0x40000e34 ) ;
  PROVIDE ( __call_wdev_mac_reg_load = 0x40000de8 ) ;
  PROVIDE ( __call_wdev_mac_reg_store = 0x40000dec ) ;
  PROVIDE ( __call_wdev_mac_sleep = 0x40000dfc ) ;
  PROVIDE ( __call_wdev_mac_special_reg_load = 0x40000df0 ) ;
  PROVIDE ( __call_wdev_mac_special_reg_store = 0x40000df4 ) ;
  PROVIDE ( __call_wdev_mac_wakeup = 0x40000df8 ) ;
  PROVIDE ( __call_wdt_hal_config_stage = 0x4000039c ) ;
  PROVIDE ( __call_wdt_hal_deinit = 0x40000398 ) ;
  PROVIDE ( __call_wdt_hal_disable = 0x400003ac ) ;
  PROVIDE ( __call_wdt_hal_enable = 0x400003a8 ) ;
  PROVIDE ( __call_wdt_hal_feed = 0x400003b4 ) ;
  PROVIDE ( __call_wdt_hal_handle_intr = 0x400003b0 ) ;
  PROVIDE ( __call_wdt_hal_init = 0x40000394 ) ;
  PROVIDE ( __call_wdt_hal_is_enabled = 0x400003bc ) ;
  PROVIDE ( __call_wdt_hal_set_flashboot_en = 0x400003b8 ) ;
  PROVIDE ( __call_wdt_hal_write_protect_disable = 0x400003a0 ) ;
  PROVIDE ( __call_wdt_hal_write_protect_enable = 0x400003a4 ) ;
  PROVIDE ( __call_wifi_11g_rate_chg = 0x40001478 ) ;
  PROVIDE ( __call_wifi_agc_sat_gain = 0x400013a8 ) ;
  PROVIDE ( __call_wifi_fbw_sel = 0x400013b8 ) ;
  PROVIDE ( __call_wifi_get_macaddr = 0x40000ba0 ) ;
  PROVIDE ( __call_wifi_get_target_power = 0x4000148c ) ;
  PROVIDE ( __call_wifi_get_tx_gain = 0x40001474 ) ;
  PROVIDE ( __call_wifi_is_started = 0x40000bcc ) ;
  PROVIDE ( __call_wifi_rf_phy_disable = 0x40000ba4 ) ;
  PROVIDE ( __call_wifi_rf_phy_enable = 0x40000ba8 ) ;
  PROVIDE ( __call_wifi_rifs_mode_en = 0x400013d4 ) ;
  PROVIDE ( __call_wr_rf_freq_mem = 0x40001160 ) ;
  PROVIDE ( __call_write_chan_freq = 0x40001150 ) ;
  PROVIDE ( __call_write_gain_mem = 0x40001348 ) ;
  PROVIDE ( __call_write_pll_cap = 0x40001248 ) ;
  PROVIDE ( __call_write_rfpll_sdm = 0x4000122c ) ;
  PROVIDE ( __chclass = 0x400488fc ) ;
  PROVIDE ( __clear_cache = 0x40029758 ) ;
  PROVIDE ( __clrsbdi2 = 0x4002ada6 ) ;
  PROVIDE ( __clrsbsi2 = 0x4002ad5c ) ;
  PROVIDE ( __clz_tab = 0x40048470 ) ;
  PROVIDE ( __clzdi2 = 0x40029a6e ) ;
  PROVIDE ( __clzsi2 = 0x40029a32 ) ;
  PROVIDE ( __cmpdi2 = 0x40029720 ) ;
  PROVIDE ( __copybits = 0x40040288 ) ;
  PROVIDE ( __ctzdi2 = 0x40029af4 ) ;
  PROVIDE ( __ctzsi2 = 0x40029ab8 ) ;
  PROVIDE ( __d2b = 0x400400d8 ) ;
  PROVIDE ( __default_global_locale = 0x400495d0 ) ;
  PROVIDE ( __divdc3 = 0x4002a842 ) ;
  PROVIDE ( __divdf3 = 0x4002c5f8 ) ;
  PROVIDE ( __divdi3 = 0x4002ae30 ) ;
  PROVIDE ( __divsc3 = 0x4002a4ec ) ;
  PROVIDE ( __divsf3 = 0x4002e008 ) ;
  PROVIDE ( __divsi3 = 0x4002f4e0 ) ;
  PROVIDE ( __eqdf2 = 0x4002cb3e ) ;
  PROVIDE ( __eqsf2 = 0x4002e266 ) ;
  PROVIDE ( __errno = 0x4003f3bc ) ;
  PROVIDE ( __extenddftf2 = 0x4002ef46 ) ;
  PROVIDE ( __extendsfdf2 = 0x4002ee92 ) ;
  PROVIDE ( __ffsdi2 = 0x400299e6 ) ;
  PROVIDE ( __ffssi2 = 0x400299a6 ) ;
  PROVIDE ( __fixdfdi = 0x4002d946 ) ;
  PROVIDE ( __fixdfsi = 0x4002d79e ) ;
  PROVIDE ( __fixsfdi = 0x4002eb8a ) ;
  PROVIDE ( __fixsfsi = 0x4002e950 ) ;
  PROVIDE ( __fixunsdfsi = 0x4002d802 ) ;
  PROVIDE ( __fixunssfdi = 0x4002ec12 ) ;
  PROVIDE ( __fixunssfsi = 0x4002e9b0 ) ;
  PROVIDE ( __floatdidf = 0x4002d9ea ) ;
  PROVIDE ( __floatdisf = 0x4002ec72 ) ;
  PROVIDE ( __floatsidf = 0x4002d85e ) ;
  PROVIDE ( __floatsisf = 0x4002ea04 ) ;
  PROVIDE ( __floatundidf = 0x4002db86 ) ;
  PROVIDE ( __floatundisf = 0x4002ed9a ) ;
  PROVIDE ( __floatunsidf = 0x4002d8e0 ) ;
  PROVIDE ( __floatunsisf = 0x4002ead6 ) ;
  PROVIDE ( __func__.3444 = 0x4004cfbc ) ;
  PROVIDE ( __func__.3455 = 0x4004cfc8 ) ;
  PROVIDE ( __func__.3484 = 0x4004cfd4 ) ;
  PROVIDE ( __func__.3493 = 0x4004cfec ) ;
  PROVIDE ( __func__.3501 = 0x4004d000 ) ;
  PROVIDE ( __func__.3524 = 0x4004d014 ) ;
  PROVIDE ( __func__.3537 = 0x4004d020 ) ;
  PROVIDE ( __func__.3543 = 0x4004d030 ) ;
  PROVIDE ( __func__.3549 = 0x4004d044 ) ;
  PROVIDE ( __func__.3555 = 0x4004d058 ) ;
  PROVIDE ( __func__.3562 = 0x4004d068 ) ;
  PROVIDE ( __func__.3577 = 0x4004d078 ) ;
  PROVIDE ( __func__.3706 = 0x4004d08c ) ;
  PROVIDE ( __func__.3738 = 0x4004d0a0 ) ;
  PROVIDE ( __func__.3756 = 0x4004d0b4 ) ;
  PROVIDE ( __func__.3769 = 0x4004d0c0 ) ;
  PROVIDE ( __func__.3776 = 0x4004d644 ) ;
  PROVIDE ( __func__.3794 = 0x4004d660 ) ;
  PROVIDE ( __func__.3801 = 0x4004d67c ) ;
  PROVIDE ( __func__.3820 = 0x4004d698 ) ;
  PROVIDE ( __func__.3840 = 0x4004d6b0 ) ;
  PROVIDE ( __func__.3850 = 0x4004d6c4 ) ;
  PROVIDE ( __func__.3896 = 0x4004d914 ) ;
  PROVIDE ( __func__.4654 = 0x4004d998 ) ;
  PROVIDE ( __func__.4687 = 0x4004d9b0 ) ;
  PROVIDE ( __func__.4698 = 0x4004d9c0 ) ;
  PROVIDE ( __func__.5678 = 0x4004d8b0 ) ;
  PROVIDE ( __gcc_bcmp = 0x4002ae0a ) ;
  PROVIDE ( __gedf2 = 0x4002cba8 ) ;
  PROVIDE ( __gesf2 = 0x4002e2bc ) ;
  PROVIDE ( __gethex = 0x400417e8 ) ;
  PROVIDE ( __getreent = 0x400283be ) ;
  PROVIDE ( __global_locale_ptr = 0x4087faac ) ;
  PROVIDE ( __gtdf2 = 0x4002cba8 ) ;
  PROVIDE ( __gtsf2 = 0x4002e2bc ) ;
  PROVIDE ( __hexdig_fun = 0x400417a8 ) ;
  PROVIDE ( __hexnan = 0x40041d32 ) ;
  PROVIDE ( __hi0bits = 0x4003fa9a ) ;
  PROVIDE ( __i2b = 0x4003fb4a ) ;
  PROVIDE ( __init_end = 0x400017ec ) ;
  PROVIDE ( __init_start = 0x40001580 ) ;
  PROVIDE ( __itoa = 0x40030a54 ) ;
  PROVIDE ( __ledf2 = 0x4002cc4c ) ;
  PROVIDE ( __lesf2 = 0x4002e334 ) ;
  PROVIDE ( __lo0bits = 0x4003fae0 ) ;
  PROVIDE ( __locale_mb_cur_max = 0x4003f720 ) ;
  PROVIDE ( __localeconv_l = 0x4003f748 ) ;
  PROVIDE ( __lock___arc4random_mutex = 0x4087faa4 ) ;
  PROVIDE ( __lock___at_quick_exit_mutex = 0x4087faa4 ) ;
  PROVIDE ( __lock___atexit_recursive_mutex = 0x4087faa8 ) ;
  PROVIDE ( __lock___dd_hash_mutex = 0x4087faa4 ) ;
  PROVIDE ( __lock___env_recursive_mutex = 0x4087faa8 ) ;
  PROVIDE ( __lock___malloc_recursive_mutex = 0x4087faa8 ) ;
  PROVIDE ( __lock___sfp_recursive_mutex = 0x4087faa8 ) ;
  PROVIDE ( __lock___sinit_recursive_mutex = 0x4087faa8 ) ;
  PROVIDE ( __lock___tz_mutex = 0x4087faa4 ) ;
  PROVIDE ( __lshift = 0x4003fdae ) ;
  PROVIDE ( __lshrdi3 = 0x400296a0 ) ;
  PROVIDE ( __ltdf2 = 0x4002cc4c ) ;
  PROVIDE ( __ltsf2 = 0x4002e334 ) ;
  PROVIDE ( __match = 0x40041d02 ) ;
  PROVIDE ( __mcmp = 0x4003fe94 ) ;
  PROVIDE ( __mdiff = 0x4003fec6 ) ;
  PROVIDE ( __moddi3 = 0x4002b1cc ) ;
  PROVIDE ( __modsi3 = 0x4002f538 ) ;
  PROVIDE ( __mprec_bigtens = 0x40049840 ) ;
  PROVIDE ( __mprec_tens = 0x40049750 ) ;
  PROVIDE ( __mprec_tinytens = 0x40049818 ) ;
  PROVIDE ( __mtvec_base = 0x40001500 ) ;
  PROVIDE ( __muldc3 = 0x4002a05c ) ;
  PROVIDE ( __muldf3 = 0x4002ccf0 ) ;
  PROVIDE ( __muldi3 = 0x4002f492 ) ;
  PROVIDE ( __mulsc3 = 0x40029d04 ) ;
  PROVIDE ( __mulsf3 = 0x4002e3ac ) ;
  PROVIDE ( __mulsi3 = 0x4002f47c ) ;
  PROVIDE ( __multadd = 0x4003f922 ) ;
  PROVIDE ( __multiply = 0x4003fb80 ) ;
  PROVIDE ( __mulvdi3 = 0x40029866 ) ;
  PROVIDE ( __mulvsi3 = 0x4002984a ) ;
  PROVIDE ( __nedf2 = 0x4002cb3e ) ;
  PROVIDE ( __negdf2 = 0x4002d13c ) ;
  PROVIDE ( __negdi2 = 0x4002968e ) ;
  PROVIDE ( __negsf2 = 0x4002e5dc ) ;
  PROVIDE ( __negvdi2 = 0x40029970 ) ;
  PROVIDE ( __negvsi2 = 0x40029952 ) ;
  PROVIDE ( __nesf2 = 0x4002e266 ) ;
  PROVIDE ( __paritysi2 = 0x40029bde ) ;
  PROVIDE ( __popcountdi2 = 0x40029b80 ) ;
  PROVIDE ( __popcountsi2 = 0x40029b3e ) ;
  PROVIDE ( __pow5mult = 0x4003fcde ) ;
  PROVIDE ( __powidf2 = 0x40029c70 ) ;
  PROVIDE ( __powisf2 = 0x40029c02 ) ;
  PROVIDE ( __ratio = 0x400401c2 ) ;
  PROVIDE ( __retarget_lock_acquire = 0x40028128 ) ;
  PROVIDE ( __retarget_lock_acquire_recursive = 0x4002813c ) ;
  PROVIDE ( __retarget_lock_close = 0x40028100 ) ;
  PROVIDE ( __retarget_lock_close_recursive = 0x40028114 ) ;
  PROVIDE ( __retarget_lock_init = 0x400280d8 ) ;
  PROVIDE ( __retarget_lock_init_recursive = 0x400280ec ) ;
  PROVIDE ( __retarget_lock_release = 0x40028178 ) ;
  PROVIDE ( __retarget_lock_release_recursive = 0x4002818e ) ;
  PROVIDE ( __retarget_lock_try_acquire = 0x40028150 ) ;
  PROVIDE ( __retarget_lock_try_acquire_recursive = 0x40028164 ) ;
  PROVIDE ( __riscv_restore_0 = 0x4002f46e ) ;
  PROVIDE ( __riscv_restore_1 = 0x4002f46e ) ;
  PROVIDE ( __riscv_restore_10 = 0x4002f45a ) ;
  PROVIDE ( __riscv_restore_11 = 0x4002f45a ) ;
  PROVIDE ( __riscv_restore_12 = 0x4002f456 ) ;
  PROVIDE ( __riscv_restore_2 = 0x4002f46e ) ;
  PROVIDE ( __riscv_restore_3 = 0x4002f46e ) ;
  PROVIDE ( __riscv_restore_4 = 0x4002f464 ) ;
  PROVIDE ( __riscv_restore_5 = 0x4002f464 ) ;
  PROVIDE ( __riscv_restore_6 = 0x4002f464 ) ;
  PROVIDE ( __riscv_restore_7 = 0x4002f464 ) ;
  PROVIDE ( __riscv_restore_8 = 0x4002f45a ) ;
  PROVIDE ( __riscv_restore_9 = 0x4002f45a ) ;
  PROVIDE ( __riscv_save_0 = 0x4002f44a ) ;
  PROVIDE ( __riscv_save_1 = 0x4002f44a ) ;
  PROVIDE ( __riscv_save_10 = 0x4002f422 ) ;
  PROVIDE ( __riscv_save_11 = 0x4002f422 ) ;
  PROVIDE ( __riscv_save_12 = 0x4002f41a ) ;
  PROVIDE ( __riscv_save_2 = 0x4002f44a ) ;
  PROVIDE ( __riscv_save_3 = 0x4002f44a ) ;
  PROVIDE ( __riscv_save_4 = 0x4002f430 ) ;
  PROVIDE ( __riscv_save_5 = 0x4002f430 ) ;
  PROVIDE ( __riscv_save_6 = 0x4002f430 ) ;
  PROVIDE ( __riscv_save_7 = 0x4002f430 ) ;
  PROVIDE ( __riscv_save_8 = 0x4002f422 ) ;
  PROVIDE ( __riscv_save_9 = 0x4002f422 ) ;
  PROVIDE ( __s2b = 0x4003f9de ) ;
  PROVIDE ( __sbprintf = 0x4003b9f4 ) ;
  PROVIDE ( __sbprintf = 0x4003e1d0 ) ;
  PROVIDE ( __sccl = 0x40040382 ) ;
  PROVIDE ( __sclose = 0x400318c6 ) ;
  PROVIDE ( __seofread = 0x40031838 ) ;
  PROVIDE ( __sf_fake_stderr = 0x4004db7c ) ;
  PROVIDE ( __sf_fake_stdin = 0x4004db9c ) ;
  PROVIDE ( __sf_fake_stdout = 0x4004dbbc ) ;
  PROVIDE ( __sflush_r = 0x400305ce ) ;
  PROVIDE ( __sfvwrite_r = 0x4003f3ca ) ;
  PROVIDE ( __sinit = 0x40028486 ) ;
  PROVIDE ( __smakebuf_r = 0x40030b4c ) ;
  PROVIDE ( __sprint_r = 0x4003a47e ) ;
  PROVIDE ( __sread = 0x40031806 ) ;
  PROVIDE ( __sseek = 0x4003188e ) ;
  PROVIDE ( __ssprint_r = 0x40032626 ) ;
  PROVIDE ( __ssrefill_r = 0x40033c72 ) ;
  PROVIDE ( __ssvfiscanf_r = 0x40033d4e ) ;
  PROVIDE ( __ssvfscanf_r = 0x40037e18 ) ;
  PROVIDE ( __stack = 0x4087e610 ) ;
  PROVIDE ( __state_table = 0x400489fc ) ;
  PROVIDE ( __strtok_r = 0x40031ee0 ) ;
  PROVIDE ( __subdf3 = 0x4002d14a ) ;
  PROVIDE ( __submore = 0x40039dd0 ) ;
  PROVIDE ( __subsf3 = 0x4002e5f4 ) ;
  PROVIDE ( __subvdi3 = 0x4002980a ) ;
  PROVIDE ( __subvsi3 = 0x400297ec ) ;
  PROVIDE ( __swbuf = 0x4003e500 ) ;
  PROVIDE ( __swbuf_r = 0x4003e43a ) ;
  PROVIDE ( __swhatbuf_r = 0x40030ad0 ) ;
  PROVIDE ( __swrite = 0x4003183c ) ;
  PROVIDE ( __swsetup_r = 0x4003e51a ) ;
  PROVIDE ( __truncdfsf2 = 0x4002f0a4 ) ;
  PROVIDE ( __trunctfdf2 = 0x4002f1d4 ) ;
  PROVIDE ( __ucmpdi2 = 0x4002973c ) ;
  PROVIDE ( __udiv_w_sdiv = 0x4002bfec ) ;
  PROVIDE ( __udivdi3 = 0x4002b55e ) ;
  PROVIDE ( __udivmoddi4 = 0x4002bc0e ) ;
  PROVIDE ( __udivsi3 = 0x4002f4e8 ) ;
  PROVIDE ( __ulp = 0x4003ffe0 ) ;
  PROVIDE ( __umoddi3 = 0x4002b8bc ) ;
  PROVIDE ( __umodsi3 = 0x4002f514 ) ;
  PROVIDE ( __unorddf2 = 0x4002d766 ) ;
  PROVIDE ( __unordsf2 = 0x4002e91c ) ;
  PROVIDE ( __utoa = 0x40039ff8 ) ;
  PROVIDE ( _asprintf_r = 0x400304e8 ) ;
  PROVIDE ( _at_text = 0x400425a0 ) ;
  PROVIDE ( _atoi_r = 0x40030582 ) ;
  PROVIDE ( _atol_r = 0x40030592 ) ;
  PROVIDE ( _bss_end = 0x40042184 ) ;
  PROVIDE ( _bss_end_all_pro = 0x4087fab0 ) ;
  PROVIDE ( _bss_end_btbbrom = 0x4087fa08 ) ;
  PROVIDE ( _bss_end_btdm = 0x4087fa08 ) ;
  PROVIDE ( _bss_end_c = 0x4087fab0 ) ;
  PROVIDE ( _bss_end_cache = 0x4087fa8c ) ;
  PROVIDE ( _bss_end_coexist_rom = 0x4087f5a4 ) ;
  PROVIDE ( _bss_end_ets = 0x4087f02c ) ;
  PROVIDE ( _bss_end_ets_apb_backup = 0x4087faa4 ) ;
  PROVIDE ( _bss_end_ets_delay = 0x4087faa4 ) ;
  PROVIDE ( _bss_end_ets_printf = 0x4087faa0 ) ;
  PROVIDE ( _bss_end_ets_rtc = 0x4087faa4 ) ;
  PROVIDE ( _bss_end_fft_table = 0x4087faa4 ) ;
  PROVIDE ( _bss_end_hal = 0x4087f464 ) ;
  PROVIDE ( _bss_end_heap = 0x4087fa84 ) ;
  PROVIDE ( _bss_end_interface_cache = 0x4087ffd0 ) ;
  PROVIDE ( _bss_end_interface_common = 0x40880000 ) ;
  PROVIDE ( _bss_end_interface_crypto = 0x4087ffc8 ) ;
  PROVIDE ( _bss_end_interface_esp_flash = 0x4087ffec ) ;
  PROVIDE ( _bss_end_interface_heap = 0x4087ffdc ) ;
  PROVIDE ( _bss_end_interface_newlib = 0x4087ffd8 ) ;
  PROVIDE ( _bss_end_interface_rom_coexist = 0x4087ffc8 ) ;
  PROVIDE ( _bss_end_interface_rom_net80211 = 0x4087ffb0 ) ;
  PROVIDE ( _bss_end_interface_rom_phy = 0x4087fcec ) ;
  PROVIDE ( _bss_end_interface_rom_pp = 0x4087ff84 ) ;
  PROVIDE ( _bss_end_interface_spi_flash_chips = 0x4087ffe4 ) ;
  PROVIDE ( _bss_end_interface_spiflash_legacy = 0x4087fff8 ) ;
  PROVIDE ( _bss_end_mbedtls = 0x4087fa08 ) ;
  PROVIDE ( _bss_end_net80211_rom = 0x4087f5a8 ) ;
  PROVIDE ( _bss_end_newlib = 0x4087faac ) ;
  PROVIDE ( _bss_end_opi_flash = 0x4087fa8c ) ;
  PROVIDE ( _bss_end_phyrom = 0x4087fa08 ) ;
  PROVIDE ( _bss_end_pp_rom = 0x4087f954 ) ;
  PROVIDE ( _bss_end_riscv = 0x4087f564 ) ;
  PROVIDE ( _bss_end_shared_bufs = 0x4087c608 ) ;
  PROVIDE ( _bss_end_sip = 0x4087f318 ) ;
  PROVIDE ( _bss_end_slc = 0x4087f464 ) ;
  PROVIDE ( _bss_end_spi_flash = 0x4087fa78 ) ;
  PROVIDE ( _bss_end_spi_slave = 0x4087f02c ) ;
  PROVIDE ( _bss_end_uart = 0x4087f5a0 ) ;
  PROVIDE ( _bss_end_usbdev = 0x4087f564 ) ;
  PROVIDE ( _bss_start = 0x40042064 ) ;
  PROVIDE ( _bss_start_all_pro = 0x4087fab0 ) ;
  PROVIDE ( _bss_start_btbbrom = 0x4087fa08 ) ;
  PROVIDE ( _bss_start_btdm = 0x4087fa08 ) ;
  PROVIDE ( _bss_start_c = 0x4087fab0 ) ;
  PROVIDE ( _bss_start_cache = 0x4087fa8c ) ;
  PROVIDE ( _bss_start_coexist_rom = 0x4087f5a4 ) ;
  PROVIDE ( _bss_start_ets = 0x4087e614 ) ;
  PROVIDE ( _bss_start_ets_apb_backup = 0x4087faa4 ) ;
  PROVIDE ( _bss_start_ets_delay = 0x4087faa4 ) ;
  PROVIDE ( _bss_start_ets_printf = 0x4087fa8c ) ;
  PROVIDE ( _bss_start_ets_rtc = 0x4087faa4 ) ;
  PROVIDE ( _bss_start_fft_table = 0x4087faa4 ) ;
  PROVIDE ( _bss_start_hal = 0x4087f464 ) ;
  PROVIDE ( _bss_start_heap = 0x4087fa78 ) ;
  PROVIDE ( _bss_start_interface_cache = 0x4087ffcc ) ;
  PROVIDE ( _bss_start_interface_common = 0x4087fffc ) ;
  PROVIDE ( _bss_start_interface_crypto = 0x4087ffc8 ) ;
  PROVIDE ( _bss_start_interface_esp_flash = 0x4087ffe8 ) ;
  PROVIDE ( _bss_start_interface_heap = 0x4087ffdc ) ;
  PROVIDE ( _bss_start_interface_newlib = 0x4087ffd0 ) ;
  PROVIDE ( _bss_start_interface_rom_coexist = 0x4087ffb0 ) ;
  PROVIDE ( _bss_start_interface_rom_net80211 = 0x4087ff88 ) ;
  PROVIDE ( _bss_start_interface_rom_phy = 0x4087fce8 ) ;
  PROVIDE ( _bss_start_interface_rom_pp = 0x4087fd0c ) ;
  PROVIDE ( _bss_start_interface_spi_flash_chips = 0x4087ffe4 ) ;
  PROVIDE ( _bss_start_interface_spiflash_legacy = 0x4087fff4 ) ;
  PROVIDE ( _bss_start_mbedtls = 0x4087fa08 ) ;
  PROVIDE ( _bss_start_net80211_rom = 0x4087f5a8 ) ;
  PROVIDE ( _bss_start_newlib = 0x4087faa4 ) ;
  PROVIDE ( _bss_start_opi_flash = 0x4087fa8c ) ;
  PROVIDE ( _bss_start_phyrom = 0x4087fa08 ) ;
  PROVIDE ( _bss_start_pp_rom = 0x4087f840 ) ;
  PROVIDE ( _bss_start_riscv = 0x4087f464 ) ;
  PROVIDE ( _bss_start_shared_bufs = 0x4086ad08 ) ;
  PROVIDE ( _bss_start_sip = 0x4087f02c ) ;
  PROVIDE ( _bss_start_slc = 0x4087f318 ) ;
  PROVIDE ( _bss_start_spi_flash = 0x4087fa60 ) ;
  PROVIDE ( _bss_start_spi_slave = 0x4087f02c ) ;
  PROVIDE ( _bss_start_uart = 0x4087f568 ) ;
  PROVIDE ( _bss_start_usbdev = 0x4087f564 ) ;
  PROVIDE ( _bss_table_end = 0x40042184 ) ;
  PROVIDE ( _bss_table_start = 0x40042064 ) ;
  PROVIDE ( _calloc_r = 0x400281f8 ) ;
  PROVIDE ( _cleanup_r = 0x4002849c ) ;
  PROVIDE ( _close_r = 0x40028310 ) ;
  PROVIDE ( _ctype_ = 0x400494cc ) ;
  PROVIDE ( _cvt = 0x40018f06 ) ;
  PROVIDE ( _data_end_all_pro = 0x4087fab0 ) ;
  PROVIDE ( _data_end_btbbrom = 0x4087fa08 ) ;
  PROVIDE ( _data_end_btdm = 0x4087fa08 ) ;
  PROVIDE ( _data_end_c = 0x4087fab0 ) ;
  PROVIDE ( _data_end_cache = 0x4087fa8c ) ;
  PROVIDE ( _data_end_coexist_rom = 0x4087f5a4 ) ;
  PROVIDE ( _data_end_ets = 0x4087e614 ) ;
  PROVIDE ( _data_end_ets_apb_backup = 0x4087faa4 ) ;
  PROVIDE ( _data_end_ets_delay = 0x4087faa4 ) ;
  PROVIDE ( _data_end_ets_printf = 0x4087fa8c ) ;
  PROVIDE ( _data_end_ets_rtc = 0x4087faa4 ) ;
  PROVIDE ( _data_end_fft_table = 0x4087faa4 ) ;
  PROVIDE ( _data_end_hal = 0x4087f464 ) ;
  PROVIDE ( _data_end_heap = 0x4087fa78 ) ;
  PROVIDE ( _data_end_interface = 0x40880000 ) ;
  PROVIDE ( _data_end_interface_cache = 0x4087ffcc ) ;
  PROVIDE ( _data_end_interface_common = 0x4087fffc ) ;
  PROVIDE ( _data_end_interface_crypto = 0x4087ffc8 ) ;
  PROVIDE ( _data_end_interface_esp_flash = 0x4087ffe8 ) ;
  PROVIDE ( _data_end_interface_heap = 0x4087ffdc ) ;
  PROVIDE ( _data_end_interface_newlib = 0x4087ffd0 ) ;
  PROVIDE ( _data_end_interface_rom_coexist = 0x4087ffb0 ) ;
  PROVIDE ( _data_end_interface_rom_net80211 = 0x4087ff88 ) ;
  PROVIDE ( _data_end_interface_rom_phy = 0x4087fce8 ) ;
  PROVIDE ( _data_end_interface_rom_pp = 0x4087fd0c ) ;
  PROVIDE ( _data_end_interface_spi_flash_chips = 0x4087ffe4 ) ;
  PROVIDE ( _data_end_interface_spiflash_legacy = 0x4087fff4 ) ;
  PROVIDE ( _data_end_mbedtls = 0x4087fa08 ) ;
  PROVIDE ( _data_end_net80211_rom = 0x4087f5a8 ) ;
  PROVIDE ( _data_end_newlib = 0x4087faa4 ) ;
  PROVIDE ( _data_end_opi_flash = 0x4087fa8c ) ;
  PROVIDE ( _data_end_phyrom = 0x4087fa08 ) ;
  PROVIDE ( _data_end_pp_rom = 0x4087f840 ) ;
  PROVIDE ( _data_end_riscv = 0x4087f464 ) ;
  PROVIDE ( _data_end_sip = 0x4087f02c ) ;
  PROVIDE ( _data_end_slc = 0x4087f318 ) ;
  PROVIDE ( _data_end_spi_flash = 0x4087fa60 ) ;
  PROVIDE ( _data_end_spi_slave = 0x4087f02c ) ;
  PROVIDE ( _data_end_uart = 0x4087f568 ) ;
  PROVIDE ( _data_end_usbdev = 0x4087f564 ) ;
  PROVIDE ( _data_start_all_pro = 0x4087fab0 ) ;
  PROVIDE ( _data_start_btbbrom = 0x4087fa08 ) ;
  PROVIDE ( _data_start_btdm = 0x4087fa08 ) ;
  PROVIDE ( _data_start_btdm_rom = 0x40041ea4 ) ;
  PROVIDE ( _data_start_c = 0x4087faac ) ;
  PROVIDE ( _data_start_cache = 0x4087fa84 ) ;
  PROVIDE ( _data_start_coexist_rom = 0x4087f5a0 ) ;
  PROVIDE ( _data_start_ets = 0x4087e610 ) ;
  PROVIDE ( _data_start_ets_apb_backup = 0x4087faa4 ) ;
  PROVIDE ( _data_start_ets_delay = 0x4087faa0 ) ;
  PROVIDE ( _data_start_ets_printf = 0x4087fa8c ) ;
  PROVIDE ( _data_start_ets_rtc = 0x4087faa4 ) ;
  PROVIDE ( _data_start_fft_table = 0x4087faa4 ) ;
  PROVIDE ( _data_start_hal = 0x4087f464 ) ;
  PROVIDE ( _data_start_heap = 0x4087fa78 ) ;
  PROVIDE ( _data_start_interface = 0x4087fce8 ) ;
  PROVIDE ( _data_start_interface_cache = 0x4087ffc8 ) ;
  PROVIDE ( _data_start_interface_common = 0x4087fff8 ) ;
  PROVIDE ( _data_start_interface_crypto = 0x4087ffc8 ) ;
  PROVIDE ( _data_start_interface_esp_flash = 0x4087ffe4 ) ;
  PROVIDE ( _data_start_interface_heap = 0x4087ffd8 ) ;
  PROVIDE ( _data_start_interface_newlib = 0x4087ffd0 ) ;
  PROVIDE ( _data_start_interface_rom_coexist = 0x4087ffb0 ) ;
  PROVIDE ( _data_start_interface_rom_net80211 = 0x4087ff84 ) ;
  PROVIDE ( _data_start_interface_rom_phy = 0x4087fce8 ) ;
  PROVIDE ( _data_start_interface_rom_pp = 0x4087fcec ) ;
  PROVIDE ( _data_start_interface_spi_flash_chips = 0x4087ffdc ) ;
  PROVIDE ( _data_start_interface_spiflash_legacy = 0x4087ffec ) ;
  PROVIDE ( _data_start_mbedtls = 0x4087fa08 ) ;
  PROVIDE ( _data_start_net80211_rom = 0x4087f5a4 ) ;
  PROVIDE ( _data_start_newlib = 0x4087faa4 ) ;
  PROVIDE ( _data_start_opi_flash = 0x4087fa8c ) ;
  PROVIDE ( _data_start_phyrom = 0x4087f954 ) ;
  PROVIDE ( _data_start_pp_rom = 0x4087f5a8 ) ;
  PROVIDE ( _data_start_riscv = 0x4087f464 ) ;
  PROVIDE ( _data_start_sip = 0x4087f02c ) ;
  PROVIDE ( _data_start_slc = 0x4087f318 ) ;
  PROVIDE ( _data_start_spi_flash = 0x4087fa08 ) ;
  PROVIDE ( _data_start_spi_slave = 0x4087f02c ) ;
  PROVIDE ( _data_start_uart = 0x4087f564 ) ;
  PROVIDE ( _data_start_usbdev = 0x4087f564 ) ;
  PROVIDE ( _data_table_end = 0x40042064 ) ;
  PROVIDE ( _data_table_start = 0x40041ea8 ) ;
  PROVIDE ( _dram0_0_end = 0x4087fab0 ) ;
  PROVIDE ( _dram0_0_start = 0x4086ad08 ) ;
  PROVIDE ( _dram0_rtos_reserved_end = 0x4087fab0 ) ;
  PROVIDE ( _dram0_rtos_reserved_start = 0x4087f564 ) ;
  PROVIDE ( _dram0_stack_shared_mem_reserved_start = 0x4087c608 ) ;
  PROVIDE ( _dram_end_btbbrom = 0x4087fa08 ) ;
  PROVIDE ( _dram_end_coexist_rom = 0x4087f5a4 ) ;
  PROVIDE ( _dram_end_mbedtls_rom = 0x4087fa08 ) ;
  PROVIDE ( _dram_end_net80211_rom = 0x4087f5a8 ) ;
  PROVIDE ( _dram_end_phyrom = 0x4087fa08 ) ;
  PROVIDE ( _dram_end_pp_rom = 0x4087f954 ) ;
  PROVIDE ( _dram_end_uart_rom = 0x4087f5a0 ) ;
  PROVIDE ( _dram_end_usbdev_rom = 0x4087f564 ) ;
  PROVIDE ( _dram_start_btbbrom = 0x4087fa08 ) ;
  PROVIDE ( _dram_start_coexist_rom = 0x4087f5a0 ) ;
  PROVIDE ( _dram_start_mbedtls_rom = 0x4087fa08 ) ;
  PROVIDE ( _dram_start_net80211_rom = 0x4087f5a4 ) ;
  PROVIDE ( _dram_start_phyrom = 0x4087f954 ) ;
  PROVIDE ( _dram_start_pp_rom = 0x4087f5a8 ) ;
  PROVIDE ( _dram_start_uart_rom = 0x4087f564 ) ;
  PROVIDE ( _dram_start_usbdev_rom = 0x4087f564 ) ;
  PROVIDE ( _dtoa_r = 0x4003e764 ) ;
  PROVIDE ( _esp_rom_spiflash_erase_block = 0x40024ddc ) ;
  PROVIDE ( _esp_rom_spiflash_erase_sector = 0x40024e54 ) ;
  PROVIDE ( _esp_rom_spiflash_read = 0x40024faa ) ;
  PROVIDE ( _esp_rom_spiflash_unlock = 0x40024ba4 ) ;
  PROVIDE ( _esp_rom_spiflash_write = 0x40024ecc ) ;
  PROVIDE ( _etext = 0x40042184 ) ;
  PROVIDE ( _exit_r = 0x400282fc ) ;
  PROVIDE ( _fflush_r = 0x4003073a ) ;
  PROVIDE ( _fiprintf_r = 0x40030802 ) ;
  PROVIDE ( _fprintf_r = 0x40030850 ) ;
  PROVIDE ( _free_r = 0x400281d0 ) ;
  PROVIDE ( _fstat_r = 0x400282ac ) ;
  PROVIDE ( _fwalk = 0x4003089e ) ;
  PROVIDE ( _fwalk_reent = 0x40030900 ) ;
  PROVIDE ( _getpid_r = 0x400282d4 ) ;
  PROVIDE ( _gettimeofday_r = 0x40028248 ) ;
  PROVIDE ( _global_impure_ptr = 0x4087ffd0 ) ;
  PROVIDE ( _global_interrupt_handler = 0x4002912c ) ;
  PROVIDE ( _init = 0x40001680 ) ;
  PROVIDE ( _interrupt_exit = 0x40001628 ) ;
  PROVIDE ( _interrupt_handler = 0x40001580 ) ;
  PROVIDE ( _isatty_r = 0x4002809c ) ;
  PROVIDE ( _kill_r = 0x400282e8 ) ;
  PROVIDE ( _link_r = 0x40028284 ) ;
  PROVIDE ( _localeconv_r = 0x4003f74e ) ;
  PROVIDE ( _lseek_r = 0x4002834c ) ;
  PROVIDE ( _malloc_r = 0x400281bc ) ;
  PROVIDE ( _mbrtowc_r = 0x4003f76a ) ;
  PROVIDE ( _mbtowc_r = 0x4003f7d2 ) ;
  PROVIDE ( _mprec_log10 = 0x40040232 ) ;
  PROVIDE ( _open_r = 0x40028324 ) ;
  PROVIDE ( _panic_handler = 0x40001580 ) ;
  PROVIDE ( _printf_float = 0x4002845a ) ;
  PROVIDE ( _printf_r = 0x40030e42 ) ;
  PROVIDE ( _putc1 = 0x4087fa8c ) ;
  PROVIDE ( _putc2 = 0x4087fa90 ) ;
  PROVIDE ( _raise_r = 0x4002825c ) ;
  PROVIDE ( _read_r = 0x40028360 ) ;
  PROVIDE ( _realloc_r = 0x400281e4 ) ;
  PROVIDE ( _rename_r = 0x40028220 ) ;
  PROVIDE ( _rodata_end = 0x4004e3a8 ) ;
  PROVIDE ( _rodata_end_interface = 0x40050000 ) ;
  PROVIDE ( _rodata_end_interface_cache = 0x4004fffc ) ;
  PROVIDE ( _rodata_end_interface_common = 0x40050000 ) ;
  PROVIDE ( _rodata_end_interface_crypto = 0x4004fffc ) ;
  PROVIDE ( _rodata_end_interface_esp_flash = 0x4004fffc ) ;
  PROVIDE ( _rodata_end_interface_heap = 0x4004fffc ) ;
  PROVIDE ( _rodata_end_interface_newlib = 0x4004fffc ) ;
  PROVIDE ( _rodata_end_interface_rom_coexist = 0x4004ffe4 ) ;
  PROVIDE ( _rodata_end_interface_rom_net80211 = 0x4004ffe4 ) ;
  PROVIDE ( _rodata_end_interface_rom_phy = 0x4004fd40 ) ;
  PROVIDE ( _rodata_end_interface_rom_pp = 0x4004ffe4 ) ;
  PROVIDE ( _rodata_end_interface_spi_flash_chips = 0x4004fffc ) ;
  PROVIDE ( _rodata_end_interface_spiflash_legacy = 0x4004fffc ) ;
  PROVIDE ( _rodata_start = 0x40048400 ) ;
  PROVIDE ( _rodata_start_interface = 0x4004fd40 ) ;
  PROVIDE ( _rodata_start_interface_cache = 0x4004fffc ) ;
  PROVIDE ( _rodata_start_interface_common = 0x4004fffc ) ;
  PROVIDE ( _rodata_start_interface_crypto = 0x4004ffe4 ) ;
  PROVIDE ( _rodata_start_interface_esp_flash = 0x4004fffc ) ;
  PROVIDE ( _rodata_start_interface_heap = 0x4004fffc ) ;
  PROVIDE ( _rodata_start_interface_newlib = 0x4004fffc ) ;
  PROVIDE ( _rodata_start_interface_rom_coexist = 0x4004ffe4 ) ;
  PROVIDE ( _rodata_start_interface_rom_net80211 = 0x4004ffe4 ) ;
  PROVIDE ( _rodata_start_interface_rom_phy = 0x4004fd40 ) ;
  PROVIDE ( _rodata_start_interface_rom_pp = 0x4004fd40 ) ;
  PROVIDE ( _rodata_start_interface_spi_flash_chips = 0x4004fffc ) ;
  PROVIDE ( _rodata_start_interface_spiflash_legacy = 0x4004fffc ) ;
  PROVIDE ( _rom_chip_id = 0x40000010 ) ;
  PROVIDE ( _rom_eco_version = 0x40000014 ) ;
  PROVIDE ( _rom_eh_frame_end = 0x4200c204 ) ;
  PROVIDE ( _rom_eh_frame_hdr_end = 0x4200f07c ) ;
  PROVIDE ( _rom_eh_frame_hdr_start = 0x4200c208 ) ;
  PROVIDE ( _rom_eh_frame_start = 0x42000000 ) ;
  PROVIDE ( _rom_wrapper_functions_end = 0x40001490 ) ;
  PROVIDE ( _rom_wrapper_functions_start = 0x40000010 ) ;
  PROVIDE ( _rvfp__adddf3 = 0x4002fd70 ) ;
  PROVIDE ( _rvfp__addsf3 = 0x4002f734 ) ;
  PROVIDE ( _rvfp__eqdf2 = 0x40030406 ) ;
  PROVIDE ( _rvfp__eqsf2 = 0x4002fce6 ) ;
  PROVIDE ( _rvfp__extendsfdf2 = 0x4002f874 ) ;
  PROVIDE ( _rvfp__fixdfdi = 0x40030286 ) ;
  PROVIDE ( _rvfp__fixdfsi = 0x4003019e ) ;
  PROVIDE ( _rvfp__fixsfdi = 0x4002f6b6 ) ;
  PROVIDE ( _rvfp__fixsfsi = 0x4002fcac ) ;
  PROVIDE ( _rvfp__fixunsdfsi = 0x4003008c ) ;
  PROVIDE ( _rvfp__fixunssfdi = 0x400301dc ) ;
  PROVIDE ( _rvfp__fixunssfsi = 0x4002f55e ) ;
  PROVIDE ( _rvfp__floatdidf = 0x400300c2 ) ;
  PROVIDE ( _rvfp__floatdisf = 0x40030134 ) ;
  PROVIDE ( _rvfp__floatsidf = 0x40030344 ) ;
  PROVIDE ( _rvfp__floatsisf = 0x40030370 ) ;
  PROVIDE ( _rvfp__floatundidf = 0x4003022c ) ;
  PROVIDE ( _rvfp__floatundisf = 0x4002f92a ) ;
  PROVIDE ( _rvfp__floatunsidf = 0x4002f590 ) ;
  PROVIDE ( _rvfp__floatunsisf = 0x4002f64e ) ;
  PROVIDE ( _rvfp__gedf2 = 0x40030442 ) ;
  PROVIDE ( _rvfp__gesf2 = 0x40030308 ) ;
  PROVIDE ( _rvfp__gtdf2 = 0x400303ac ) ;
  PROVIDE ( _rvfp__gtsf2 = 0x400304aa ) ;
  PROVIDE ( _rvfp__ledf2 = 0x4002fd0a ) ;
  PROVIDE ( _rvfp__lesf2 = 0x40030050 ) ;
  PROVIDE ( _rvfp__ltdf2 = 0x4002f8cc ) ;
  PROVIDE ( _rvfp__ltsf2 = 0x4002f67e ) ;
  PROVIDE ( _rvfp__muldf3 = 0x4002fab2 ) ;
  PROVIDE ( _rvfp__mulsf3 = 0x4002f97c ) ;
  PROVIDE ( _rvfp__nedf2 = 0x40030406 ) ;
  PROVIDE ( _rvfp__nesf2 = 0x4002fce6 ) ;
  PROVIDE ( _rvfp__subdf3 = 0x4002fd6a ) ;
  PROVIDE ( _rvfp__subsf3 = 0x4002f72e ) ;
  PROVIDE ( _rvfp__truncdfsf2 = 0x4002f5b0 ) ;
  PROVIDE ( _sbrk_r = 0x400282c0 ) ;
  PROVIDE ( _scanf_float = 0x40028470 ) ;
  PROVIDE ( _setlocale_r = 0x4003f6d2 ) ;
  PROVIDE ( _sfread_r = 0x40033cba ) ;
  PROVIDE ( _sip_from_host_isr = 0x4087f02c ) ;
  PROVIDE ( _sip_init_evt_desc_space = 0x4087f298 ) ;
  PROVIDE ( _sip_init_evt_mblk_space = 0x4087f098 ) ;
  PROVIDE ( _sip_proc_ctrl_pkt = 0x4087f034 ) ;
  PROVIDE ( _sip_proc_data_pkt = 0x4087f030 ) ;
  PROVIDE ( _siprintf_r = 0x400313e6 ) ;
  PROVIDE ( _siscanf_r = 0x400314c0 ) ;
  PROVIDE ( _slc_init_cmd_desc_space = 0x4087f458 ) ;
  PROVIDE ( _slc_init_cmd_mblk_space = 0x4087f34c ) ;
  PROVIDE ( _sniprintf_r = 0x40031514 ) ;
  PROVIDE ( _snprintf_r = 0x400315f8 ) ;
  PROVIDE ( _sprintf_r = 0x400316dc ) ;
  PROVIDE ( _sscanf_r = 0x400317b4 ) ;
  PROVIDE ( _stack_sentry = 0x4087c610 ) ;
  PROVIDE ( _stat_r = 0x40028298 ) ;
  PROVIDE ( _stext = 0x400017ec ) ;
  PROVIDE ( _strdup_r = 0x40031b98 ) ;
  PROVIDE ( _strndup_r = 0x40031de8 ) ;
  PROVIDE ( _strtod_l = 0x40040468 ) ;
  PROVIDE ( _strtod_r = 0x4004110a ) ;
  PROVIDE ( _strtol_l.isra.0 = 0x40031f40 ) ;
  PROVIDE ( _strtol_r = 0x40032082 ) ;
  PROVIDE ( _strtoll_l.isra.0 = 0x4004131e ) ;
  PROVIDE ( _strtoll_r = 0x400414d8 ) ;
  PROVIDE ( _strtoul_l.isra.0 = 0x400320c4 ) ;
  PROVIDE ( _strtoul_r = 0x400321e0 ) ;
  PROVIDE ( _strtoull_l.isra.0 = 0x4004151a ) ;
  PROVIDE ( _strtoull_r = 0x400416c2 ) ;
  PROVIDE ( _sungetc_r = 0x40033bd8 ) ;
  PROVIDE ( _svfiprintf_r = 0x4003275a ) ;
  PROVIDE ( _svfprintf_r = 0x40035b8e ) ;
  PROVIDE ( _system_r = 0x4002820c ) ;
  PROVIDE ( _text_end = 0x40042184 ) ;
  PROVIDE ( _text_end_btdm_rom = 0x40041e9c ) ;
  PROVIDE ( _text_start = 0x400017ec ) ;
  PROVIDE ( _text_start_btdm_rom = 0x40041e9c ) ;
  PROVIDE ( _times_r = 0x40028234 ) ;
  PROVIDE ( _ungetc_r = 0x40039e5c ) ;
  PROVIDE ( _unlink_r = 0x40028270 ) ;
  PROVIDE ( _vector_table = 0x40001500 ) ;
  PROVIDE ( _vfiprintf_r = 0x4003a4a6 ) ;
  PROVIDE ( _vfprintf_r = 0x4003be82 ) ;
  PROVIDE ( _viprintf_r = 0x4003e2a2 ) ;
  PROVIDE ( _vprintf_r = 0x4003e302 ) ;
  PROVIDE ( _vsniprintf_r = 0x4003e32e ) ;
  PROVIDE ( _vsnprintf_r = 0x4003e3b4 ) ;
  PROVIDE ( _wctomb_r = 0x40041704 ) ;
  PROVIDE ( _write_r = 0x40028338 ) ;
  PROVIDE ( abs = 0x400304de ) ;
  PROVIDE ( abs_temp = 0x40002e24 ) ;
  PROVIDE ( adjust = 0x4002f7b6 ) ;
  PROVIDE ( agc_reg_init = 0x40005044 ) ;
  PROVIDE ( alloc_pool = 0x4001ecc4 ) ;
  PROVIDE ( amdpu_delay_time_ms = 0x4087fd08 ) ;
  PROVIDE ( ampdu_delay = 0x4087fe51 ) ;
  PROVIDE ( ampdu_delay_packet = 0x4087fd04 ) ;
  PROVIDE ( ampdu_dispatch = 0x400164dc ) ;
  PROVIDE ( ampdu_dispatch_all = 0x400165c8 ) ;
  PROVIDE ( ampdu_dispatch_as_many_as_possible = 0x40016514 ) ;
  PROVIDE ( ampdu_dispatch_movement = 0x40016590 ) ;
  PROVIDE ( ampdu_dispatch_upto = 0x40016640 ) ;
  PROVIDE ( analog_super_wdt_reset_happened = 0x4001965a ) ;
  PROVIDE ( ant_btrx_cfg_rom = 0x40003100 ) ;
  PROVIDE ( ant_bttx_cfg_rom = 0x400030d6 ) ;
  PROVIDE ( ant_dft_cfg_rom = 0x4000301e ) ;
  PROVIDE ( ant_wifirx_cfg_rom = 0x4000306e ) ;
  PROVIDE ( ant_wifitx_cfg_rom = 0x40003040 ) ;
  PROVIDE ( ap_no_lr_ptr = 0x4087ff2c ) ;
  PROVIDE ( asprintf = 0x4003052a ) ;
  PROVIDE ( assert_valid_block = 0x40022386 ) ;
  PROVIDE ( basefix.4624 = 0x40048af4 ) ;
  PROVIDE ( basefix.5111 = 0x40048f30 ) ;
  PROVIDE ( bb_bss_cbw40_dig = 0x40004d8e ) ;
  PROVIDE ( bb_reg_init = 0x40005154 ) ;
  PROVIDE ( bb_wdg_cfg = 0x40004fcc ) ;
  PROVIDE ( bb_wdg_test_en = 0x40005392 ) ;
  PROVIDE ( bitext = 0x4001ece0 ) ;
  PROVIDE ( blanks.5056 = 0x40048ad4 ) ;
  PROVIDE ( blanks.5060 = 0x400491f0 ) ;
  PROVIDE ( blanks.5077 = 0x40048db4 ) ;
  PROVIDE ( blanks.5092 = 0x400494ac ) ;
  PROVIDE ( both_denormal = 0x4002f810 ) ;
  PROVIDE ( both_denormal_zero = 0x4002f81e ) ;
  PROVIDE ( bt_bb_to_index = 0x4000893c ) ;
  PROVIDE ( bt_chan_pwr_interp = 0x400089ee ) ;
  PROVIDE ( bt_filter_reg = 0x40005500 ) ;
  PROVIDE ( bt_gain_offset = 0x40004ec6 ) ;
  PROVIDE ( bt_get_tx_gain = 0x40008bbe ) ;
  PROVIDE ( bt_index_to_bb = 0x40008920 ) ;
  PROVIDE ( bt_tx_pwctrl_init = 0x400086fa ) ;
  PROVIDE ( bt_txdc_cal = 0x40007800 ) ;
  PROVIDE ( bt_txiq_cal = 0x40007f1c ) ;
  PROVIDE ( bt_txpwr_freq = 0x40003774 ) ;
  PROVIDE ( bzero = 0x4003059a ) ;
  PROVIDE ( cbw2040_cfg = 0x40004da4 ) ;
  PROVIDE ( chan_to_freq = 0x40005858 ) ;
  PROVIDE ( check_bss_queue = 0x40015eb6 ) ;
  PROVIDE ( check_chip_pointer_default = 0x40025830 ) ;
  PROVIDE ( check_condCOUNTER.2752 = 0x400291a6 ) ;
  PROVIDE ( check_condCOUNTER.3617 = 0x400197ba ) ;
  PROVIDE ( check_condCOUNTER.3620 = 0x400197dc ) ;
  PROVIDE ( check_condCOUNTER.3640 = 0x40019800 ) ;
  PROVIDE ( check_condCOUNTER.3653 = 0x4001993a ) ;
  PROVIDE ( check_condCOUNTER.3661 = 0x4001983a ) ;
  PROVIDE ( check_condCOUNTER.3707 = 0x40019860 ) ;
  PROVIDE ( check_condCOUNTER.3712 = 0x40019898 ) ;
  PROVIDE ( check_condCOUNTER.3715 = 0x400198c4 ) ;
  PROVIDE ( check_condCOUNTER.3718 = 0x400198e8 ) ;
  PROVIDE ( check_condCOUNTER.3736 = 0x4001990c ) ;
  PROVIDE ( check_condCOUNTER.4703 = 0x4001a918 ) ;
  PROVIDE ( check_condCOUNTER.4723 = 0x4001a8d6 ) ;
  PROVIDE ( check_condCOUNTER.4739 = 0x4001a93a ) ;
  PROVIDE ( check_condCOUNTER.5232 = 0x40023366 ) ;
  PROVIDE ( check_condCOUNTER.5256 = 0x40023366 ) ;
  PROVIDE ( check_condCOUNTER.5339 = 0x40023366 ) ;
  PROVIDE ( check_condCOUNTER.5351 = 0x40023366 ) ;
  PROVIDE ( check_condCOUNTER.6530 = 0x4001889c ) ;
  PROVIDE ( check_condCOUNTER.6536 = 0x400187b4 ) ;
  PROVIDE ( check_condCOUNTER.6545 = 0x40018758 ) ;
  PROVIDE ( check_condCOUNTER.6549 = 0x4001879a ) ;
  PROVIDE ( check_condCOUNTER.6559 = 0x400187b4 ) ;
  PROVIDE ( check_condCOUNTER.6562 = 0x40018758 ) ;
  PROVIDE ( check_condCOUNTER.6568 = 0x400187b4 ) ;
  PROVIDE ( check_condCOUNTER.6576 = 0x40018758 ) ;
  PROVIDE ( chip761_phyrom_version = 0x40005d20 ) ;
  PROVIDE ( chip761_phyrom_version_num = 0x40005d44 ) ;
  PROVIDE ( chip_v7_set_chan_ana = 0x40005cdc ) ;
  PROVIDE ( chm_is_at_home_channel = 0x40014f58 ) ;
  PROVIDE ( clear_super_wdt_reset_flag = 0x40019720 ) ;
  PROVIDE ( clearloop = 0x400017c6 ) ;
  PROVIDE ( clr_sdio_pin_pu_done = 0x40001708 ) ;
  PROVIDE ( clz_loop = 0x4002f7ec ) ;
  PROVIDE ( clz_loop = 0x4002f8b6 ) ;
  PROVIDE ( cnx_node_is_existing = 0x40014e8c ) ;
  PROVIDE ( cnx_node_search = 0x40014ee4 ) ;
  PROVIDE ( code_to_temp = 0x40007440 ) ;
  PROVIDE ( coex_bt_release = 0x40016ffc ) ;
  PROVIDE ( coex_bt_request = 0x40016fe6 ) ;
  PROVIDE ( coex_core_ble_conn_dyn_prio_get = 0x4001710c ) ;
  PROVIDE ( coex_core_event_duration_get = 0x40017110 ) ;
  PROVIDE ( coex_core_pti_get = 0x4001701c ) ;
  PROVIDE ( coex_core_release = 0x400170d8 ) ;
  PROVIDE ( coex_core_request = 0x4001705c ) ;
  PROVIDE ( coex_core_status_get = 0x40017154 ) ;
  PROVIDE ( coex_core_timer_idx_get = 0x4001703a ) ;
  PROVIDE ( coex_env_ptr = 0x4087ffc4 ) ;
  PROVIDE ( coex_event_duration_get = 0x40016fc6 ) ;
  PROVIDE ( coex_hw_timer_disable = 0x4001721c ) ;
  PROVIDE ( coex_hw_timer_enable = 0x400171fa ) ;
  PROVIDE ( coex_hw_timer_set = 0x40017160 ) ;
  PROVIDE ( coex_pti_tab_ptr = 0x4087ffc0 ) ;
  PROVIDE ( coex_schm_env_ptr = 0x4087ffbc ) ;
  PROVIDE ( coex_schm_interval_set = 0x400172a8 ) ;
  PROVIDE ( coex_schm_lock = 0x4001723e ) ;
  PROVIDE ( coex_schm_unlock = 0x40017274 ) ;
  PROVIDE ( coex_status_get = 0x4001700e ) ;
  PROVIDE ( coex_wifi_release = 0x40016fd4 ) ;
  PROVIDE ( coexist_funcs = 0x4087ffb8 ) ;
  PROVIDE ( coexist_rom_version = 0x4087f5a0 ) ;
  PROVIDE ( common_mutex = 0x4087faa4 ) ;
  PROVIDE ( common_recursive_mutex = 0x4087faa8 ) ;
  PROVIDE ( complete_ena_tb_count = 0x4087fe44 ) ;
  PROVIDE ( complete_ena_tb_final = 0x4087fe48 ) ;
  PROVIDE ( complete_ena_tb_seqno = 0x4087fe4c ) ;
  PROVIDE ( complete_sum = 0x4002fecc ) ;
  PROVIDE ( config_is_cache_tx_buf_enabled = 0x40013120 ) ;
  PROVIDE ( copy_to_hardware = 0x40028866 ) ;
  PROVIDE ( crc16_be = 0x4001b2d4 ) ;
  PROVIDE ( crc16_be_table = 0x4004b0d8 ) ;
  PROVIDE ( crc16_be_table_ptr = 0x4004ffe8 ) ;
  PROVIDE ( crc16_le = 0x4001b296 ) ;
  PROVIDE ( crc16_le_table = 0x4004b2d8 ) ;
  PROVIDE ( crc16_le_table_ptr = 0x4004fff4 ) ;
  PROVIDE ( crc32_be = 0x4001b260 ) ;
  PROVIDE ( crc32_be_table = 0x4004b4d8 ) ;
  PROVIDE ( crc32_be_table_ptr = 0x4004ffec ) ;
  PROVIDE ( crc32_le = 0x4001b1c4 ) ;
  PROVIDE ( crc32_le_table = 0x4004b8d8 ) ;
  PROVIDE ( crc32_le_table_ptr = 0x4004fff8 ) ;
  PROVIDE ( crc8_be = 0x4001b34c ) ;
  PROVIDE ( crc8_be_table = 0x4004bcd8 ) ;
  PROVIDE ( crc8_be_table_ptr = 0x4004ffe4 ) ;
  PROVIDE ( crc8_le = 0x4001b318 ) ;
  PROVIDE ( crc8_le_table = 0x4004bdd8 ) ;
  PROVIDE ( crc8_le_table_ptr = 0x4004fff0 ) ;
  PROVIDE ( curve_secp192r1 = 0x4004dbdc ) ;
  PROVIDE ( curve_secp256r1 = 0x4004dc84 ) ;
  PROVIDE ( dc_iq_est = 0x40005dfa ) ;
  PROVIDE ( default_walker = 0x40021044 ) ;
  PROVIDE ( denormal = 0x4002f8ae ) ;
  PROVIDE ( denormal = 0x4002fa3c ) ;
  PROVIDE ( denormal = 0x4002fbec ) ;
  PROVIDE ( denormal = 0x4002ffb4 ) ;
  PROVIDE ( denormal_canc = 0x4002ff84 ) ;
  PROVIDE ( denormal_cancellation = 0x4002f7fa ) ;
  PROVIDE ( denormal_end = 0x4002fa0e ) ;
  PROVIDE ( denormal_end = 0x4002fbac ) ;
  PROVIDE ( denormal_or_str_canc = 0x4002fef2 ) ;
  PROVIDE ( denormal_or_strong_cancellation = 0x4002f7f0 ) ;
  PROVIDE ( detect_spi_flash_chip = 0x40025954 ) ;
  PROVIDE ( detect_uart_usb_spi_sdio_boot_mode = 0x400187d6 ) ;
  PROVIDE ( diff_sign = 0x4002f7d4 ) ;
  PROVIDE ( dig_gain_check = 0x40008958 ) ;
  PROVIDE ( digest_matches = 0x4001977e ) ;
  PROVIDE ( disable_agc = 0x40004cfe ) ;
  PROVIDE ( disable_default_watchdog = 0x40020fb2 ) ;
  PROVIDE ( div = 0x400305a2 ) ;
  PROVIDE ( do_sleep_wake = 0x400016a0 ) ;
  PROVIDE ( ds_wait_idle = 0x40017620 ) ;
  PROVIDE ( ebuf_list_remove = 0x4000f72c ) ;
  PROVIDE ( enable_agc = 0x40004d0e ) ;
  PROVIDE ( end = 0x4002f90a ) ;
  PROVIDE ( end = 0x4002fd04 ) ;
  PROVIDE ( end = 0x400303ea ) ;
  PROVIDE ( eq_63_end = 0x40030228 ) ;
  PROVIDE ( equal = 0x4002f82a ) ;
  PROVIDE ( equal = 0x4002ffd6 ) ;
  PROVIDE ( equal_nodenormal = 0x4002f846 ) ;
  PROVIDE ( equal_nodenormal = 0x4002fffc ) ;
  PROVIDE ( equal_samesign = 0x4002f834 ) ;
  PROVIDE ( equal_samesign = 0x4002ffe0 ) ;
  PROVIDE ( esf_buf_alloc = 0x4000f93a ) ;
  PROVIDE ( esf_buf_alloc_dynamic = 0x4000f73a ) ;
  PROVIDE ( esf_buf_recycle = 0x4000f5ea ) ;
  PROVIDE ( esp_coex_ble_conn_dynamic_prio_get = 0x40016fc2 ) ;
  PROVIDE ( esp_coex_rom_version_get = 0x40016fb8 ) ;
  PROVIDE ( esp_crc8 = 0x4001b380 ) ;
  PROVIDE ( esp_enable_cache_flash_wrap = 0x40025314 ) ;
  PROVIDE ( esp_flash_api_funcs = 0x4087ffe4 ) ;
  PROVIDE ( esp_flash_chip_driver_initialized = 0x40025902 ) ;
  PROVIDE ( esp_flash_default_api_funcs = 0x4004d8cc ) ;
  PROVIDE ( esp_flash_default_chip = 0x4087ffe8 ) ;
  PROVIDE ( esp_flash_erase_chip = 0x40025a18 ) ;
  PROVIDE ( esp_flash_erase_region = 0x40025aa8 ) ;
  PROVIDE ( esp_flash_get_chip_write_protect = 0x40025c5c ) ;
  PROVIDE ( esp_flash_get_io_mode = 0x400261da ) ;
  PROVIDE ( esp_flash_get_protectable_regions = 0x40025cfe ) ;
  PROVIDE ( esp_flash_get_protected_region = 0x40025d4c ) ;
  PROVIDE ( esp_flash_get_size = 0x400259b0 ) ;
  PROVIDE ( esp_flash_read = 0x40025e80 ) ;
  PROVIDE ( esp_flash_read_chip_id = 0x40025946 ) ;
  PROVIDE ( esp_flash_read_encrypted = 0x400261b0 ) ;
  PROVIDE ( esp_flash_read_id = 0x4002590a ) ;
  PROVIDE ( esp_flash_set_chip_write_protect = 0x40025cb2 ) ;
  PROVIDE ( esp_flash_set_io_mode = 0x40026234 ) ;
  PROVIDE ( esp_flash_set_protected_region = 0x40025de0 ) ;
  PROVIDE ( esp_flash_suspend_cmd_init = 0x40026288 ) ;
  PROVIDE ( esp_flash_write = 0x40025f70 ) ;
  PROVIDE ( esp_flash_write_encrypted = 0x40026090 ) ;
  PROVIDE ( esp_net80211_rom_version_get = 0x40014e82 ) ;
  PROVIDE ( esp_pp_rom_version_get = 0x4001223c ) ;
  PROVIDE ( esp_rom_get_rtc_wake_addr = 0x400196e8 ) ;
  PROVIDE ( esp_rom_newlib_init_common_mutexes = 0x400280c2 ) ;
  PROVIDE ( esp_rom_set_rtc_wake_addr = 0x400196a8 ) ;
  PROVIDE ( esp_rom_spi_flash_auto_sus_res = 0x40025202 ) ;
  PROVIDE ( esp_rom_spi_flash_send_resume = 0x400251c4 ) ;
  PROVIDE ( esp_rom_spi_flash_update_id = 0x40024b36 ) ;
  PROVIDE ( esp_rom_spi_set_address_bit_len = 0x40023e9a ) ;
  PROVIDE ( esp_rom_spi_set_rd_cmd_bit_len = 0x40023ee0 ) ;
  PROVIDE ( esp_rom_spiflash_config_clk = 0x40024d6a ) ;
  PROVIDE ( esp_rom_spiflash_config_param = 0x400251a0 ) ;
  PROVIDE ( esp_rom_spiflash_config_readmode = 0x40024c54 ) ;
  PROVIDE ( esp_rom_spiflash_erase_block = 0x40024e38 ) ;
  PROVIDE ( esp_rom_spiflash_erase_chip = 0x40024db6 ) ;
  PROVIDE ( esp_rom_spiflash_erase_sector = 0x40024eb0 ) ;
  PROVIDE ( esp_rom_spiflash_read = 0x400250c0 ) ;
  PROVIDE ( esp_rom_spiflash_read_status = 0x40024228 ) ;
  PROVIDE ( esp_rom_spiflash_read_statushigh = 0x400243ca ) ;
  PROVIDE ( esp_rom_spiflash_read_user_cmd = 0x400241b2 ) ;
  PROVIDE ( esp_rom_spiflash_select_qio_pins = 0x40023f58 ) ;
  PROVIDE ( esp_rom_spiflash_unlock = 0x40024bf0 ) ;
  PROVIDE ( esp_rom_spiflash_wait_idle = 0x400247b0 ) ;
  PROVIDE ( esp_rom_spiflash_write = 0x40024f8e ) ;
  PROVIDE ( esp_rom_spiflash_write_disable = 0x4002429c ) ;
  PROVIDE ( esp_rom_spiflash_write_encrypted = 0x400254f2 ) ;
  PROVIDE ( esp_rom_spiflash_write_encrypted_dest = 0x4002535e ) ;
  PROVIDE ( esp_rom_spiflash_write_encrypted_disable = 0x40025352 ) ;
  PROVIDE ( esp_rom_spiflash_write_encrypted_enable = 0x4002533a ) ;
  PROVIDE ( esp_rom_spiflash_write_status = 0x400243f0 ) ;
  PROVIDE ( esp_test_clr_rx_error_occurs = 0x40014444 ) ;
  PROVIDE ( esp_test_clr_rx_mu_statistics = 0x40013fb6 ) ;
  PROVIDE ( esp_test_clr_rx_statistics = 0x400142d0 ) ;
  PROVIDE ( esp_test_clr_tx_statistics = 0x400146e4 ) ;
  PROVIDE ( esp_test_clr_tx_tb_statistics = 0x400147aa ) ;
  PROVIDE ( esp_test_disable_rx_mu_statistics = 0x40013fe0 ) ;
  PROVIDE ( esp_test_disable_rx_statistics = 0x4001446a ) ;
  PROVIDE ( esp_test_disable_tx_statistics = 0x40014532 ) ;
  PROVIDE ( esp_test_enable_rx_mu_statistics = 0x4001400c ) ;
  PROVIDE ( esp_test_enable_rx_statistics = 0x40014498 ) ;
  PROVIDE ( esp_test_enable_tx_statistics = 0x400145e6 ) ;
  PROVIDE ( esp_test_get_rx_error_occurs = 0x40014424 ) ;
  PROVIDE ( esp_test_get_rx_mu_statistics = 0x40013f50 ) ;
  PROVIDE ( esp_test_get_rx_statistics = 0x40014346 ) ;
  PROVIDE ( esp_test_get_tx_statistics = 0x40014740 ) ;
  PROVIDE ( esp_test_get_tx_tb_statistics = 0x400147e2 ) ;
  PROVIDE ( esp_test_mu_print_ru_allocation = 0x4087fd14 ) ;
  PROVIDE ( esp_test_rx_error_occurs = 0x4087fd10 ) ;
  PROVIDE ( esp_test_rx_mu_statistics = 0x4087fd18 ) ;
  PROVIDE ( esp_test_rx_parse_mu = 0x40013a14 ) ;
  PROVIDE ( esp_test_rx_process_complete = 0x40014204 ) ;
  PROVIDE ( esp_test_rx_statistics = 0x4087fd1c ) ;
  PROVIDE ( esp_test_set_rx_error_occurs = 0x400143ea ) ;
  PROVIDE ( esp_test_tx_addba_request = 0x4087ff84 ) ;
  PROVIDE ( esp_test_tx_count_collision = 0x40014dee ) ;
  PROVIDE ( esp_test_tx_count_retry = 0x40014dcc ) ;
  PROVIDE ( esp_test_tx_count_timeout = 0x40014e06 ) ;
  PROVIDE ( esp_test_tx_enab_statistics = 0x40014bea ) ;
  PROVIDE ( esp_test_tx_fail_statistics = 0x4087fd24 ) ;
  PROVIDE ( esp_test_tx_process_complete = 0x40014a70 ) ;
  PROVIDE ( esp_test_tx_process_txq_state = 0x40014b68 ) ;
  PROVIDE ( esp_test_tx_statistics = 0x4087fd94 ) ;
  PROVIDE ( esp_test_tx_statistics_aci_bitmap = 0x4087fda4 ) ;
  PROVIDE ( esp_test_tx_tb_complete = 0x40014d12 ) ;
  PROVIDE ( esp_test_tx_tb_statistics = 0x4087fd84 ) ;
  PROVIDE ( esp_tx_state_out_rom = 0x40003018 ) ;
  PROVIDE ( esp_wifi_cert_tx_bcc = 0x4087fcf8 ) ;
  PROVIDE ( esp_wifi_cert_tx_gi = 0x4087fcf0 ) ;
  PROVIDE ( esp_wifi_cert_tx_ltf = 0x4087fcf4 ) ;
  PROVIDE ( esp_wifi_cert_tx_mcs = 0x4087fcfc ) ;
  PROVIDE ( esp_wifi_cert_tx_nss = 0x4087fcec ) ;
  PROVIDE ( esprv_intc_int_disable = 0x4002915c ) ;
  PROVIDE ( esprv_intc_int_enable = 0x4002914c ) ;
  PROVIDE ( esprv_intc_int_set_priority = 0x4002918c ) ;
  PROVIDE ( esprv_intc_int_set_threshold = 0x4002919c ) ;
  PROVIDE ( esprv_intc_int_set_type = 0x40029170 ) ;
  PROVIDE ( ets_aes_block = 0x40017392 ) ;
  PROVIDE ( ets_aes_disable = 0x4001730e ) ;
  PROVIDE ( ets_aes_enable = 0x400172e8 ) ;
  PROVIDE ( ets_aes_setkey = 0x4001732a ) ;
  PROVIDE ( ets_aes_setkey_dec = 0x40017380 ) ;
  PROVIDE ( ets_aes_setkey_enc = 0x4001736e ) ;
  PROVIDE ( ets_bigint_disable = 0x400174c4 ) ;
  PROVIDE ( ets_bigint_enable = 0x40017486 ) ;
  PROVIDE ( ets_bigint_getz = 0x400175ba ) ;
  PROVIDE ( ets_bigint_modcommon = 0x400173c0 ) ;
  PROVIDE ( ets_bigint_modexp = 0x40017584 ) ;
  PROVIDE ( ets_bigint_modmult = 0x40017562 ) ;
  PROVIDE ( ets_bigint_multiply = 0x400174ec ) ;
  PROVIDE ( ets_bigint_wait_finish = 0x400175a6 ) ;
  PROVIDE ( ets_clk_apb_wait_ready = 0x4001a62a ) ;
  PROVIDE ( ets_clk_assist_debug_clock_enable = 0x4001a602 ) ;
  PROVIDE ( ets_clk_get_cpu_freq = 0x4001a56e ) ;
  PROVIDE ( ets_clk_get_xtal_freq = 0x4001a552 ) ;
  PROVIDE ( ets_clk_mspi_apb_wait_ready = 0x4001a63e ) ;
  PROVIDE ( ets_common_command = 0x4001a980 ) ;
  PROVIDE ( ets_config_flash_by_image_hdr = 0x4001ab1a ) ;
  PROVIDE ( ets_delay_us = 0x400175f0 ) ;
  PROVIDE ( ets_ds_disable = 0x40017662 ) ;
  PROVIDE ( ets_ds_enable = 0x4001763a ) ;
  PROVIDE ( ets_ds_encrypt_params = 0x400177b4 ) ;
  PROVIDE ( ets_ds_finish_sign = 0x4001774c ) ;
  PROVIDE ( ets_ds_is_busy = 0x4001767e ) ;
  PROVIDE ( ets_ds_start_sign = 0x4001768c ) ;
  PROVIDE ( ets_ecdsa_verify = 0x4001a824 ) ;
  PROVIDE ( ets_efuse_cache_encryption_enabled = 0x4001ff82 ) ;
  PROVIDE ( ets_efuse_clear_program_registers = 0x4001fa68 ) ;
  PROVIDE ( ets_efuse_count_unused_key_blocks = 0x4001fc34 ) ;
  PROVIDE ( ets_efuse_direct_boot_mode_disabled = 0x4001feae ) ;
  PROVIDE ( ets_efuse_download_modes_disabled = 0x4001fea0 ) ;
  PROVIDE ( ets_efuse_find_purpose = 0x4001fb78 ) ;
  PROVIDE ( ets_efuse_find_unused_key_block = 0x4001fc16 ) ;
  PROVIDE ( ets_efuse_force_send_resume = 0x4001ff22 ) ;
  PROVIDE ( ets_efuse_get_flash_delay_us = 0x4001ffa0 ) ;
  PROVIDE ( ets_efuse_get_key_purpose = 0x4001fb30 ) ;
  PROVIDE ( ets_efuse_get_mac = 0x4001ffbe ) ;
  PROVIDE ( ets_efuse_get_read_register_address = 0x4001fb14 ) ;
  PROVIDE ( ets_efuse_get_uart_print_control = 0x4001febe ) ;
  PROVIDE ( ets_efuse_jtag_disabled = 0x4001fe12 ) ;
  PROVIDE ( ets_efuse_key_block_unused = 0x4001fbaa ) ;
  PROVIDE ( ets_efuse_program = 0x4001faa2 ) ;
  PROVIDE ( ets_efuse_read = 0x4001fa28 ) ;
  PROVIDE ( ets_efuse_rs_calculate = 0x40017a3e ) ;
  PROVIDE ( ets_efuse_secure_boot_aggressive_revoke_enabled = 0x4001ff5e ) ;
  PROVIDE ( ets_efuse_secure_boot_enabled = 0x4001ff4e ) ;
  PROVIDE ( ets_efuse_secure_boot_fast_wake_enabled = 0x4001ff6e ) ;
  PROVIDE ( ets_efuse_security_download_modes_enabled = 0x4001ff32 ) ;
  PROVIDE ( ets_efuse_set_timing = 0x4001fa24 ) ;
  PROVIDE ( ets_efuse_usb_device_disabled = 0x4001ff12 ) ;
  PROVIDE ( ets_efuse_usb_download_mode_disabled = 0x4001fee8 ) ;
  PROVIDE ( ets_efuse_usb_print_is_disabled = 0x4001fece ) ;
  PROVIDE ( ets_efuse_write_key = 0x4001fc54 ) ;
  PROVIDE ( ets_emsa_pss_verify = 0x40019446 ) ;
  PROVIDE ( ets_fatal_exception_handler = 0x400291c2 ) ;
  PROVIDE ( ets_get_cpu_frequency = 0x40017616 ) ;
  PROVIDE ( ets_get_printf_channel = 0x400193c6 ) ;
  PROVIDE ( ets_get_secure_boot_version = 0x4001a21e ) ;
  PROVIDE ( ets_hmac_calculate_downstream = 0x40018698 ) ;
  PROVIDE ( ets_hmac_calculate_message = 0x4001856a ) ;
  PROVIDE ( ets_hmac_disable = 0x4001854e ) ;
  PROVIDE ( ets_hmac_enable = 0x4001851c ) ;
  PROVIDE ( ets_hmac_invalidate_downstream = 0x400186b8 ) ;
  PROVIDE ( ets_idle_arg = 0x4087ee20 ) ;
  PROVIDE ( ets_idle_cb = 0x4087ee24 ) ;
  PROVIDE ( ets_install_lock = 0x4001930e ) ;
  PROVIDE ( ets_install_putc1 = 0x40019320 ) ;
  PROVIDE ( ets_install_putc2 = 0x4001932a ) ;
  PROVIDE ( ets_install_uart_printf = 0x40019334 ) ;
  PROVIDE ( ets_install_usb_printf = 0x40019346 ) ;
  PROVIDE ( ets_intr_count = 0x4087e614 ) ;
  PROVIDE ( ets_intr_lock = 0x400186ee ) ;
  PROVIDE ( ets_intr_unlock = 0x40018702 ) ;
  PROVIDE ( ets_isr_attach = 0x40018728 ) ;
  PROVIDE ( ets_isr_mask = 0x40018734 ) ;
  PROVIDE ( ets_isr_unmask = 0x40018740 ) ;
  PROVIDE ( ets_jtag_enable_temporarily = 0x4001fe4a ) ;
  PROVIDE ( ets_loader_is_direct_boot_jump = 0x4001abd8 ) ;
  PROVIDE ( ets_loader_map_range = 0x4001a9ac ) ;
  PROVIDE ( ets_mgf1_sha256 = 0x400193d0 ) ;
  PROVIDE ( ets_ops_default_table = 0x4004a680 ) ;
  PROVIDE ( ets_ops_table_ptr = 0x4087fff8 ) ;
  PROVIDE ( ets_post = 0x4001a790 ) ;
  PROVIDE ( ets_printf = 0x40019358 ) ;
  PROVIDE ( ets_printf_lock = 0x4087fa94 ) ;
  PROVIDE ( ets_printf_uart = 0x4087fa98 ) ;
  PROVIDE ( ets_printf_unlock = 0x4087fa9c ) ;
  PROVIDE ( ets_readySet_ = 0x4087ee28 ) ;
  PROVIDE ( ets_rom_layout = 0x4004ad74 ) ;
  PROVIDE ( ets_rom_layout_p = 0x4004fffc ) ;
  PROVIDE ( ets_rsa_pss_verify = 0x4001959a ) ;
  PROVIDE ( ets_run = 0x4001a6e8 ) ;
  PROVIDE ( ets_run_direct_boot = 0x4001abfc ) ;
  PROVIDE ( ets_run_flash_bootloader = 0x4001ac7e ) ;
  PROVIDE ( ets_secure_boot_read_key_digests = 0x40019982 ) ;
  PROVIDE ( ets_secure_boot_revoke_public_key_digest = 0x40019a56 ) ;
  PROVIDE ( ets_secure_boot_verify_bootloader_with_keys = 0x40019db4 ) ;
  PROVIDE ( ets_secure_boot_verify_signature = 0x40019d38 ) ;
  PROVIDE ( ets_secure_boot_verify_stage_bootloader = 0x4001a108 ) ;
  PROVIDE ( ets_set_printf_channel = 0x400193bc ) ;
  PROVIDE ( ets_set_user_start = 0x400188c6 ) ;
  PROVIDE ( ets_sha_clone = 0x4001a2f2 ) ;
  PROVIDE ( ets_sha_disable = 0x4001a258 ) ;
  PROVIDE ( ets_sha_enable = 0x4001a228 ) ;
  PROVIDE ( ets_sha_finish = 0x4001a492 ) ;
  PROVIDE ( ets_sha_get_state = 0x4001a2b2 ) ;
  PROVIDE ( ets_sha_init = 0x4001a274 ) ;
  PROVIDE ( ets_sha_process = 0x4001a316 ) ;
  PROVIDE ( ets_sha_starts = 0x4001a2a2 ) ;
  PROVIDE ( ets_sha_update = 0x4001a3b8 ) ;
  PROVIDE ( ets_spi_download_disabled = 0x40018772 ) ;
  PROVIDE ( ets_startup_callback = 0x4087e618 ) ;
  PROVIDE ( ets_task = 0x4001a6be ) ;
  PROVIDE ( ets_uart_download = 0x40018862 ) ;
  PROVIDE ( ets_update_cpu_frequency = 0x4001760c ) ;
  PROVIDE ( ets_vprintf = 0x40018f8c ) ;
  PROVIDE ( ets_waiti0 = 0x40018718 ) ;
  PROVIDE ( ets_write_char = 0x40018e9e ) ;
  PROVIDE ( ets_write_char_uart = 0x40018ec2 ) ;
  PROVIDE ( ets_write_char_usb = 0x40018ee4 ) ;
  PROVIDE ( exc_cause_table.2749 = 0x4004ddf0 ) ;
  PROVIDE ( exp_sign_and_exit = 0x4002f7cc ) ;
  PROVIDE ( explicit_bzero = 0x400305ca ) ;
  PROVIDE ( fatal_handlers_attach = 0x400291c0 ) ;
  PROVIDE ( fe_adc_on = 0x40005784 ) ;
  PROVIDE ( fe_reg_init = 0x40004f20 ) ;
  PROVIDE ( fe_txrx_reset = 0x40004ff8 ) ;
  PROVIDE ( fflush = 0x400307dc ) ;
  PROVIDE ( find_region.isra.0 = 0x400258ba ) ;
  PROVIDE ( fiprintf = 0x4003081e ) ;
  PROVIDE ( first_ampdu = 0x4087fe50 ) ;
  PROVIDE ( flash_end_flush_cache = 0x400257e2 ) ;
  PROVIDE ( flash_mmap_free_internal_cb = 0x4087fa60 ) ;
  PROVIDE ( flash_mmap_malloc_internal_cb = 0x4087fa64 ) ;
  PROVIDE ( fpi.3573 = 0x40049880 ) ;
  PROVIDE ( fpinan.3609 = 0x40049894 ) ;
  PROVIDE ( fprintf = 0x4003086c ) ;
  PROVIDE ( freq_chan_en_sw = 0x4000364e ) ;
  PROVIDE ( freq_i2c_mem_write = 0x40003748 ) ;
  PROVIDE ( freq_i2c_num_addr = 0x4000384a ) ;
  PROVIDE ( freq_i2c_write_set = 0x400038b8 ) ;
  PROVIDE ( freq_module_resetn = 0x4000362a ) ;
  PROVIDE ( freq_num_get_data = 0x40003826 ) ;
  PROVIDE ( freq_set_reg = 0x40005d08 ) ;
  PROVIDE ( frexp = 0x40040304 ) ;
  PROVIDE ( g_chm = 0x4087ffa4 ) ;
  PROVIDE ( g_coa_funcs_p = 0x4087ffb4 ) ;
  PROVIDE ( g_coex_param_ptr = 0x4087ffb0 ) ;
  PROVIDE ( g_config_func = 0x4087feec ) ;
  PROVIDE ( g_dbg_closrf_blk = 0x4087fe2c ) ;
  PROVIDE ( g_dbg_closrf_idx = 0x4087fe30 ) ;
  PROVIDE ( g_dbg_closrf_tsf = 0x4087fe34 ) ;
  PROVIDE ( g_dbg_interp_tsf = 0x4087fe3c ) ;
  PROVIDE ( g_dbg_interp_tsf_end = 0x4087fe38 ) ;
  PROVIDE ( g_eb_list_desc_ptr = 0x4087ff58 ) ;
  PROVIDE ( g_esp_mesh_quick_funcs_ptr = 0x4087ff08 ) ;
  PROVIDE ( g_flash_guard_ops = 0x4087fff4 ) ;
  PROVIDE ( g_hmac_cnt_ptr = 0x4087ff9c ) ;
  PROVIDE ( g_ic_ptr = 0x4087ffa0 ) ;
  PROVIDE ( g_intr_lock_mux = 0x4087ff4c ) ;
  PROVIDE ( g_itwt_fid = 0x4087ff88 ) ;
  PROVIDE ( g_lmac_cnt_ptr = 0x4087ff60 ) ;
  PROVIDE ( g_mac_sleep_en_ptr = 0x4087ff00 ) ;
  PROVIDE ( g_mesh_init_ps_type_ptr = 0x4087fef4 ) ;
  PROVIDE ( g_mesh_is_root_ptr = 0x4087fefc ) ;
  PROVIDE ( g_mesh_is_started_ptr = 0x4087fef0 ) ;
  PROVIDE ( g_mesh_topology_ptr = 0x4087fef8 ) ;
  PROVIDE ( g_net80211_tx_func = 0x4087fee8 ) ;
  PROVIDE ( g_osi_funcs_p = 0x4087ff6c ) ;
  PROVIDE ( g_per_conn_trc = 0x4087fe8c ) ;
  PROVIDE ( g_phyFuns_instance = 0x4087f954 ) ;
  PROVIDE ( g_pm_cfg_ptr = 0x4087ff0c ) ;
  PROVIDE ( g_pm_cnt_ptr = 0x4087ff14 ) ;
  PROVIDE ( g_pm_ptr = 0x4087ff10 ) ;
  PROVIDE ( g_pp_tx_pkt_num = 0x4087fd0c ) ;
  PROVIDE ( g_saved_pc = 0x4087fffc ) ;
  PROVIDE ( g_scan = 0x4087ffa8 ) ;
  PROVIDE ( g_shared_buffers = 0x4086ad08 ) ;
  PROVIDE ( g_sip = 0x4087f038 ) ;
  PROVIDE ( g_timer_func = 0x4087fee4 ) ;
  PROVIDE ( g_tx_cacheq_ptr = 0x4087ff98 ) ;
  PROVIDE ( g_tx_done_cb_func = 0x4087fed8 ) ;
  PROVIDE ( g_txop_queue_status_ptr = 0x4087ff04 ) ;
  PROVIDE ( g_wdev_last_desc_reset = 0x4087f950 ) ;
  PROVIDE ( g_wdev_last_desc_reset_ptr = 0x4004ffdc ) ;
  PROVIDE ( g_wifi_global_lock = 0x4087ff48 ) ;
  PROVIDE ( g_wifi_menuconfig_ptr = 0x4087ff34 ) ;
  PROVIDE ( ge_32 = 0x4002f6f2 ) ;
  PROVIDE ( ge_32 = 0x40030208 ) ;
  PROVIDE ( ge_32 = 0x400302ca ) ;
  PROVIDE ( gen_rx_gain_table = 0x40007234 ) ;
  PROVIDE ( get_arg = 0x40033bac ) ;
  PROVIDE ( get_arg = 0x40037dec ) ;
  PROVIDE ( get_arg.isra.0 = 0x4003224e ) ;
  PROVIDE ( get_arg.isra.0 = 0x4003579e ) ;
  PROVIDE ( get_arg.isra.0 = 0x4003a08e ) ;
  PROVIDE ( get_arg.isra.0 = 0x4003ba92 ) ;
  PROVIDE ( get_chan_target_power = 0x40008abc ) ;
  PROVIDE ( get_data_sat = 0x40002eaa ) ;
  PROVIDE ( get_dco_comp = 0x4000623c ) ;
  PROVIDE ( get_estimated_batime = 0x4000e696 ) ;
  PROVIDE ( get_fm_sar_dout = 0x4000496c ) ;
  PROVIDE ( get_freq_mem_addr = 0x400036f4 ) ;
  PROVIDE ( get_freq_mem_param = 0x400036b2 ) ;
  PROVIDE ( get_pll_vol = 0x40004c0c ) ;
  PROVIDE ( get_power_atten = 0x40007c88 ) ;
  PROVIDE ( get_power_db = 0x40004a74 ) ;
  PROVIDE ( get_rate_fcc_index = 0x40008a3e ) ;
  PROVIDE ( get_rc_dout = 0x40002c58 ) ;
  PROVIDE ( get_rf_freq_cap = 0x40003ab8 ) ;
  PROVIDE ( get_rf_freq_init = 0x40003b38 ) ;
  PROVIDE ( get_rfcal_rxiq_data = 0x4000613a ) ;
  PROVIDE ( get_sar2_vol = 0x40004bc0 ) ;
  PROVIDE ( get_temp_init = 0x400075e0 ) ;
  PROVIDE ( get_tone_sar_dout = 0x4000491c ) ;
  PROVIDE ( get_tx_gain_value = 0x40008b52 ) ;
  PROVIDE ( get_user_num = 0x40013130 ) ;
  PROVIDE ( gpio_bypass_matrix_in = 0x40027eb8 ) ;
  PROVIDE ( gpio_input_get = 0x40027e56 ) ;
  PROVIDE ( gpio_matrix_in = 0x40027ece ) ;
  PROVIDE ( gpio_matrix_out = 0x40027ef2 ) ;
  PROVIDE ( gpio_output_disable = 0x40027f68 ) ;
  PROVIDE ( gpio_output_enable = 0x40027f38 ) ;
  PROVIDE ( gpio_output_set = 0x40027e48 ) ;
  PROVIDE ( gpio_pad_hold = 0x40028084 ) ;
  PROVIDE ( gpio_pad_input_disable = 0x4002804e ) ;
  PROVIDE ( gpio_pad_input_enable = 0x40028034 ) ;
  PROVIDE ( gpio_pad_pulldown = 0x40028012 ) ;
  PROVIDE ( gpio_pad_pullup = 0x40027ff0 ) ;
  PROVIDE ( gpio_pad_select_gpio = 0x40027fa6 ) ;
  PROVIDE ( gpio_pad_set_drv = 0x40027fc6 ) ;
  PROVIDE ( gpio_pad_unhold = 0x40028068 ) ;
  PROVIDE ( gpio_pin_wakeup_disable = 0x40027e96 ) ;
  PROVIDE ( gpio_pin_wakeup_enable = 0x40027e5e ) ;
  PROVIDE ( hal_agreement_clr_rx_ba = 0x40016764 ) ;
  PROVIDE ( hal_ba_session_restore = 0x400122c0 ) ;
  PROVIDE ( hal_ba_session_store = 0x40012272 ) ;
  PROVIDE ( hal_clear_rx_beacon_pti = 0x4000c84c ) ;
  PROVIDE ( hal_disable_sta_beacon_filter = 0x4000c1ce ) ;
  PROVIDE ( hal_enable_rx_statistics = 0x400144f8 ) ;
  PROVIDE ( hal_enable_sta_beacon_filter = 0x4000c19e ) ;
  PROVIDE ( hal_enable_tx_statistics = 0x40014e22 ) ;
  PROVIDE ( hal_get_sta_tsf = 0x4000c20c ) ;
  PROVIDE ( hal_get_tsf_timer = 0x4000c24c ) ;
  PROVIDE ( hal_he_set_tx_protection = 0x4000a2bc ) ;
  PROVIDE ( hal_mac_clr_txq_state = 0x4000bc66 ) ;
  PROVIDE ( hal_mac_deinit = 0x4000c264 ) ;
  PROVIDE ( hal_mac_get_txq_complete = 0x4000bcac ) ;
  PROVIDE ( hal_mac_get_txq_state = 0x4000bc04 ) ;
  PROVIDE ( hal_mac_init = 0x4000c234 ) ;
  PROVIDE ( hal_mac_interrupt_clr_bsscolor = 0x40042184 ) ;
  PROVIDE ( hal_mac_is_dma_enable = 0x40012326 ) ;
  PROVIDE ( hal_mac_is_low_rate_enabled = 0x40011088 ) ;
  PROVIDE ( hal_mac_rx_disable = 0x4001225a ) ;
  PROVIDE ( hal_mac_rx_enable = 0x40012246 ) ;
  PROVIDE ( hal_mac_rx_is_dscr_reload = 0x40012530 ) ;
  PROVIDE ( hal_mac_rx_set_dscr_reload = 0x4001251e ) ;
  PROVIDE ( hal_mac_tx_clr_mplen = 0x4000bb42 ) ;
  PROVIDE ( hal_mac_tx_get_blockack = 0x4000b504 ) ;
  PROVIDE ( hal_mac_tx_set_ppdu = 0x4000abfc ) ;
  PROVIDE ( hal_mac_txq_enable = 0x40009f3c ) ;
  PROVIDE ( hal_now = 0x40009d44 ) ;
  PROVIDE ( hal_random = 0x4000a032 ) ;
  PROVIDE ( hal_set_sta_beacon_filter = 0x4000c1f0 ) ;
  PROVIDE ( hal_set_tx_pti = 0x4000a55e ) ;
  PROVIDE ( hal_tsf_clear_soc_wakeup_request = 0x400091aa ) ;
  PROVIDE ( he_coded_bits_per_subcarrier = 0x4087f5a8 ) ;
  PROVIDE ( he_coding_rate = 0x4087f5d0 ) ;
  PROVIDE ( he_data_bits_per_sym = 0x4087f5f8 ) ;
  PROVIDE ( he_max_apep_length = 0x4004fd40 ) ;
  PROVIDE ( he_num_data_subcarriers_short = 0x4087f698 ) ;
  PROVIDE ( he_num_data_subcarriers_short_dcm = 0x4087f6a8 ) ;
  PROVIDE ( he_preamble_ersu = 0x4087f6b8 ) ;
  PROVIDE ( he_preamble_su = 0x4087f6c8 ) ;
  PROVIDE ( he_time_per_sym = 0x4087f6d8 ) ;
  PROVIDE ( heap_tlsf_table_ptr = 0x4087ffd8 ) ;
  PROVIDE ( hmac_start = 0x400184d0 ) ;
  PROVIDE ( hmac_wait_idle = 0x40018496 ) ;
  PROVIDE ( hmac_write_block = 0x400184a0 ) ;
  PROVIDE ( ht_get_min_subframe_len = 0x4000e2f4 ) ;
  PROVIDE ( huffext = 0x4001ed64 ) ;
  PROVIDE ( i2c_master_reset = 0x40002fa4 ) ;
  PROVIDE ( i2c_paral_read = 0x40003e9c ) ;
  PROVIDE ( i2c_paral_set_mst0 = 0x40003e14 ) ;
  PROVIDE ( i2c_paral_set_read = 0x40003e60 ) ;
  PROVIDE ( i2c_paral_write = 0x40003ef2 ) ;
  PROVIDE ( i2c_paral_write_mask = 0x40003fd6 ) ;
  PROVIDE ( i2c_paral_write_num = 0x40003f42 ) ;
  PROVIDE ( i2c_sar2_init_code = 0x4000424a ) ;
  PROVIDE ( i2cmst_reg_init = 0x40004ea4 ) ;
  PROVIDE ( ic_ebuf_alloc = 0x4001522e ) ;
  PROVIDE ( ic_ebuf_recycle_rx = 0x40015ef0 ) ;
  PROVIDE ( ic_ebuf_recycle_tx = 0x4001523c ) ;
  PROVIDE ( ic_get_trc = 0x400120a8 ) ;
  PROVIDE ( ic_interface_enabled = 0x40012c34 ) ;
  PROVIDE ( ic_mac_deinit = 0x4000c2b6 ) ;
  PROVIDE ( ic_mac_init = 0x4000c2a8 ) ;
  PROVIDE ( ic_reset_rx_ba = 0x400167f6 ) ;
  PROVIDE ( ieee80211_align_eb = 0x40015572 ) ;
  PROVIDE ( ieee80211_ampdu_enable = 0x400155fa ) ;
  PROVIDE ( ieee80211_ampdu_reorder = 0x400167fa ) ;
  PROVIDE ( ieee80211_ampdu_start_age_timer = 0x40016726 ) ;
  PROVIDE ( ieee80211_classify = 0x40015118 ) ;
  PROVIDE ( ieee80211_copy_eb_header = 0x4001524a ) ;
  PROVIDE ( ieee80211_crypto_decap = 0x40016bea ) ;
  PROVIDE ( ieee80211_crypto_encap = 0x40016b7e ) ;
  PROVIDE ( ieee80211_decap = 0x40016c78 ) ;
  PROVIDE ( ieee80211_encap_esfbuf = 0x40015600 ) ;
  PROVIDE ( ieee80211_encap_esfbuf_htc = 0x40016e78 ) ;
  PROVIDE ( ieee80211_gettid = 0x40015e7e ) ;
  PROVIDE ( ieee80211_hdrsize = 0x40014e50 ) ;
  PROVIDE ( ieee80211_is_tx_allowed = 0x4001551c ) ;
  PROVIDE ( ieee80211_output_pending_eb = 0x40014f70 ) ;
  PROVIDE ( ieee80211_output_process = 0x400152cc ) ;
  PROVIDE ( ieee80211_recycle_cache_eb = 0x40014fda ) ;
  PROVIDE ( ieee80211_search_node = 0x40015024 ) ;
  PROVIDE ( ieee80211_set_tx_desc = 0x40015c88 ) ;
  PROVIDE ( ieee80211_set_tx_pti = 0x40016e40 ) ;
  PROVIDE ( if_ctrl_ptr = 0x4087ff50 ) ;
  PROVIDE ( index_to_txbbgain = 0x40008900 ) ;
  PROVIDE ( inf = 0x4002f85c ) ;
  PROVIDE ( inf = 0x4002faa0 ) ;
  PROVIDE ( inf = 0x4002fc8e ) ;
  PROVIDE ( inf = 0x40030018 ) ;
  PROVIDE ( inf_inf = 0x4002f86a ) ;
  PROVIDE ( inf_nan = 0x4002f5ee ) ;
  PROVIDE ( inf_nan = 0x4002f89c ) ;
  PROVIDE ( inf_nan = 0x4002fa82 ) ;
  PROVIDE ( inf_nan = 0x4002fc5a ) ;
  PROVIDE ( infnan = 0x4002f862 ) ;
  PROVIDE ( infnan = 0x4003002c ) ;
  PROVIDE ( infnan_B_only = 0x40030024 ) ;
  PROVIDE ( infnan_end = 0x40030034 ) ;
  PROVIDE ( integrity_walker = 0x40021016 ) ;
  PROVIDE ( intr_handler_set = 0x40029118 ) ;
  PROVIDE ( intr_matrix_set = 0x4001874c ) ;
  PROVIDE ( iq_corr_enable = 0x40005408 ) ;
  PROVIDE ( is_lmac_idle = 0x40009de2 ) ;
  PROVIDE ( is_use_muedca = 0x4000a040 ) ;
  PROVIDE ( isalnum = 0x4003096c ) ;
  PROVIDE ( isalpha = 0x4003097e ) ;
  PROVIDE ( isascii = 0x40030990 ) ;
  PROVIDE ( isblank = 0x40030996 ) ;
  PROVIDE ( iscntrl = 0x400309b4 ) ;
  PROVIDE ( isdigit = 0x400309c8 ) ;
  PROVIDE ( isgraph = 0x400309f2 ) ;
  PROVIDE ( islower = 0x400309da ) ;
  PROVIDE ( isprint = 0x40030a04 ) ;
  PROVIDE ( ispunct = 0x40030a18 ) ;
  PROVIDE ( isspace = 0x40030a2a ) ;
  PROVIDE ( isupper = 0x40030a3c ) ;
  PROVIDE ( iswspace = 0x4003f6b0 ) ;
  PROVIDE ( iswspace_l = 0x4003f6b4 ) ;
  PROVIDE ( itoa = 0x40030a9c ) ;
  PROVIDE ( jd_decomp = 0x4001f26e ) ;
  PROVIDE ( jd_prepare = 0x4001ee0c ) ;
  PROVIDE ( l_taskCB = 0x4087ee2c ) ;
  PROVIDE ( labs = 0x40030a9e ) ;
  PROVIDE ( ldiv = 0x40030aa8 ) ;
  PROVIDE ( linear_to_db = 0x400049f8 ) ;
  PROVIDE ( lldesc_build_chain = 0x400017ec ) ;
  PROVIDE ( lldesc_num2link = 0x40001906 ) ;
  PROVIDE ( lldesc_set_owner = 0x40001936 ) ;
  PROVIDE ( lmacAdjustTimestamp = 0x40009d7c ) ;
  PROVIDE ( lmacConfMib_ptr = 0x4087ff7c ) ;
  PROVIDE ( lmacDiscardAgedMSDU = 0x4000b35e ) ;
  PROVIDE ( lmacDiscardFrameExchangeSequence = 0x4000b89a ) ;
  PROVIDE ( lmacDiscardMSDU = 0x4000b370 ) ;
  PROVIDE ( lmacEndFrameExchangeSequence = 0x4000b594 ) ;
  PROVIDE ( lmacIsIdle = 0x40009dc6 ) ;
  PROVIDE ( lmacIsLongFrame = 0x4000a008 ) ;
  PROVIDE ( lmacMSDUAged = 0x40009d4c ) ;
  PROVIDE ( lmacPostTxComplete = 0x40012346 ) ;
  PROVIDE ( lmacProcessAckTimeout = 0x4000ba60 ) ;
  PROVIDE ( lmacProcessAllTxTimeout = 0x40012358 ) ;
  PROVIDE ( lmacProcessCollisions = 0x4001236a ) ;
  PROVIDE ( lmacProcessLongFrameSuccess = 0x4000b86e ) ;
  PROVIDE ( lmacProcessModemStateRxBeacon = 0x4001233c ) ;
  PROVIDE ( lmacProcessRxSucData = 0x4001232a ) ;
  PROVIDE ( lmacProcessShortFrameSuccess = 0x4000b842 ) ;
  PROVIDE ( lmacProcessTBSuccess = 0x4000b946 ) ;
  PROVIDE ( lmacProcessTxComplete = 0x4000be9a ) ;
  PROVIDE ( lmacProcessTxSuccess = 0x4000b970 ) ;
  PROVIDE ( lmacReachLongLimit = 0x4000b558 ) ;
  PROVIDE ( lmacReachShortLimit = 0x4000b542 ) ;
  PROVIDE ( lmacRecycleMPDU = 0x40009d22 ) ;
  PROVIDE ( lmacRxDone = 0x4000b81a ) ;
  PROVIDE ( lmacSetTxFrame = 0x4000b092 ) ;
  PROVIDE ( lmacTxDone = 0x40009e4a ) ;
  PROVIDE ( lmacTxFrame = 0x4000a06a ) ;
  PROVIDE ( localeconv = 0x4003f75c ) ;
  PROVIDE ( longjmp = 0x400313aa ) ;
  PROVIDE ( lower_denormal = 0x4002f804 ) ;
  PROVIDE ( mac_enable_bb = 0x40004fa2 ) ;
  PROVIDE ( mac_tx_chan_offset = 0x40004dbe ) ;
  PROVIDE ( mac_tx_get_rts_rate = 0x4000a4ea ) ;
  PROVIDE ( mac_tx_set_duration = 0x4000a4b0 ) ;
  PROVIDE ( mac_tx_set_hesig = 0x4000a91a ) ;
  PROVIDE ( mac_tx_set_mplen = 0x4000a5fc ) ;
  PROVIDE ( mac_tx_set_plcp0 = 0x4000a304 ) ;
  PROVIDE ( mac_tx_set_plcp1 = 0x4000a3e6 ) ;
  PROVIDE ( mac_tx_set_plcp2 = 0x4000a478 ) ;
  PROVIDE ( mac_tx_set_tb = 0x4000a7fe ) ;
  PROVIDE ( mbrtowc = 0x4003f7ac ) ;
  PROVIDE ( md5_vector = 0x4001be14 ) ;
  PROVIDE ( meas_tone_pwr_db = 0x40004aac ) ;
  PROVIDE ( med3.isra.1 = 0x40030efe ) ;
  PROVIDE ( memccpy = 0x40030bec ) ;
  PROVIDE ( memchr = 0x40030c0c ) ;
  PROVIDE ( memrchr = 0x40030d76 ) ;
  PROVIDE ( memspi_host_erase_block = 0x40025640 ) ;
  PROVIDE ( memspi_host_erase_chip = 0x400255e2 ) ;
  PROVIDE ( memspi_host_erase_sector = 0x4002560c ) ;
  PROVIDE ( memspi_host_flush_cache = 0x400255bc ) ;
  PROVIDE ( memspi_host_program_page = 0x40025674 ) ;
  PROVIDE ( memspi_host_read = 0x400256b2 ) ;
  PROVIDE ( memspi_host_read_data_slicer = 0x40025762 ) ;
  PROVIDE ( memspi_host_read_id_hs = 0x40025518 ) ;
  PROVIDE ( memspi_host_read_status_hs = 0x4002557e ) ;
  PROVIDE ( memspi_host_set_max_read_len = 0x40025722 ) ;
  PROVIDE ( memspi_host_set_write_protect = 0x400256f2 ) ;
  PROVIDE ( memspi_host_write_data_slicer = 0x4002572c ) ;
  PROVIDE ( mesh_rxcb = 0x4087ff90 ) ;
  PROVIDE ( mhz2ieee = 0x4000581c ) ;
  PROVIDE ( mu_mimo_special_cfg_user_num_2 = 0x4004fee8 ) ;
  PROVIDE ( mu_mimo_special_cfg_user_num_3 = 0x4004fe80 ) ;
  PROVIDE ( mu_mimo_special_cfg_user_num_4 = 0x4004fe28 ) ;
  PROVIDE ( mu_mimo_special_cfg_user_num_5 = 0x4004fdf0 ) ;
  PROVIDE ( mu_mimo_special_cfg_user_num_6 = 0x4004fdd0 ) ;
  PROVIDE ( mu_mimo_special_cfg_user_num_7 = 0x4004fdc0 ) ;
  PROVIDE ( mu_mimo_special_cfg_user_num_8 = 0x4004fdb8 ) ;
  PROVIDE ( multi_heap_aligned_alloc_impl = 0x400226da ) ;
  PROVIDE ( multi_heap_aligned_alloc_impl_offs = 0x40022664 ) ;
  PROVIDE ( multi_heap_check = 0x400226e8 ) ;
  PROVIDE ( multi_heap_dump = 0x40022748 ) ;
  PROVIDE ( multi_heap_dump_tlsf = 0x4002235a ) ;
  PROVIDE ( multi_heap_free_impl = 0x4002257e ) ;
  PROVIDE ( multi_heap_free_size_impl = 0x400227a8 ) ;
  PROVIDE ( multi_heap_get_allocated_size_impl = 0x400223ce ) ;
  PROVIDE ( multi_heap_get_block_address_impl = 0x400223ca ) ;
  PROVIDE ( multi_heap_get_first_block = 0x4002249e ) ;
  PROVIDE ( multi_heap_get_info_impl = 0x400227bc ) ;
  PROVIDE ( multi_heap_get_info_tlsf = 0x4002233a ) ;
  PROVIDE ( multi_heap_get_next_block = 0x400224d8 ) ;
  PROVIDE ( multi_heap_internal_lock = 0x40022466 ) ;
  PROVIDE ( multi_heap_internal_unlock = 0x40022482 ) ;
  PROVIDE ( multi_heap_is_free = 0x40022518 ) ;
  PROVIDE ( multi_heap_malloc_impl = 0x4002251e ) ;
  PROVIDE ( multi_heap_minimum_free_size_impl = 0x400227b2 ) ;
  PROVIDE ( multi_heap_mutex_init = 0x4002245c ) ;
  PROVIDE ( multi_heap_realloc_impl = 0x400225d0 ) ;
  PROVIDE ( multi_heap_register_impl = 0x400223e4 ) ;
  PROVIDE ( multi_heap_set_lock = 0x40022458 ) ;
  PROVIDE ( multofup = 0x40001ca0 ) ;
  PROVIDE ( mumimo_spatial_cfg_get_nsts = 0x40013434 ) ;
  PROVIDE ( mumimo_spatial_cfg_get_nsts_tot = 0x40013586 ) ;
  PROVIDE ( mz_adler32 = 0x4001d1a6 ) ;
  PROVIDE ( mz_bitmasks = 0x4004bfb0 ) ;
  PROVIDE ( mz_free = 0x4001d25a ) ;
  PROVIDE ( nan = 0x4002f604 ) ;
  PROVIDE ( nan = 0x4002faac ) ;
  PROVIDE ( nan = 0x4002fca4 ) ;
  PROVIDE ( nan = 0x4002fd62 ) ;
  PROVIDE ( nan = 0x4003043c ) ;
  PROVIDE ( nan = 0x400304a0 ) ;
  PROVIDE ( nan = 0x40041e8e ) ;
  PROVIDE ( nanf = 0x40040410 ) ;
  PROVIDE ( net80211_funcs = 0x4087ffac ) ;
  PROVIDE ( net80211_rom_version = 0x4087f5a4 ) ;
  PROVIDE ( nn = 0x4002f6ae ) ;
  PROVIDE ( nn = 0x40030086 ) ;
  PROVIDE ( nn = 0x4003033c ) ;
  PROVIDE ( nn = 0x400304d8 ) ;
  PROVIDE ( noise_floor_auto_set = 0x400053b8 ) ;
  PROVIDE ( normal_boot = 0x400016ca ) ;
  PROVIDE ( normal_case = 0x4002f9a0 ) ;
  PROVIDE ( normal_case = 0x4002fad4 ) ;
  PROVIDE ( normal_end = 0x4003043c ) ;
  PROVIDE ( nrx_freq_set = 0x40005752 ) ;
  PROVIDE ( num_canc = 0x4002f7e0 ) ;
  PROVIDE ( num_canc = 0x4002fed2 ) ;
  PROVIDE ( numempty = 0x4004e2d8 ) ;
  PROVIDE ( open_i2c_xpd = 0x40005176 ) ;
  PROVIDE ( our_controls = 0x4087f6e4 ) ;
  PROVIDE ( our_controls_ptr = 0x4004ffd8 ) ;
  PROVIDE ( our_instances = 0x4087f840 ) ;
  PROVIDE ( our_instances_ptr = 0x4004ffe0 ) ;
  PROVIDE ( our_tx_eb = 0x4087ff74 ) ;
  PROVIDE ( our_wait_eb = 0x4087ff78 ) ;
  PROVIDE ( ovf = 0x4002faa2 ) ;
  PROVIDE ( ovf = 0x4002fc96 ) ;
  PROVIDE ( ovflow = 0x4002f588 ) ;
  PROVIDE ( ovflow = 0x4002f71c ) ;
  PROVIDE ( ovflow = 0x4002fcda ) ;
  PROVIDE ( ovflow = 0x400300ba ) ;
  PROVIDE ( ovflow = 0x400301d0 ) ;
  PROVIDE ( ovflow = 0x40030220 ) ;
  PROVIDE ( ovflow = 0x400302f6 ) ;
  PROVIDE ( p05.3503 = 0x40049740 ) ;
  PROVIDE ( pTxRx = 0x4087ff80 ) ;
  PROVIDE ( pbus_debugmode = 0x40004464 ) ;
  PROVIDE ( pbus_rx_dco_cal = 0x400062a2 ) ;
  PROVIDE ( pbus_rx_dco_cal_1step = 0x40006598 ) ;
  PROVIDE ( pbus_set_dco = 0x400045fa ) ;
  PROVIDE ( pbus_workmode = 0x40004474 ) ;
  PROVIDE ( phy_ant_init = 0x40005444 ) ;
  PROVIDE ( phy_bbpll_cal = 0x40005428 ) ;
  PROVIDE ( phy_byte_to_word = 0x40002eba ) ;
  PROVIDE ( phy_chan_dump_cfg_rom = 0x40003154 ) ;
  PROVIDE ( phy_chan_filt_set_rom = 0x400032ce ) ;
  PROVIDE ( phy_close_pa = 0x400055b6 ) ;
  PROVIDE ( phy_dig_reg_backup_rom = 0x400031e2 ) ;
  PROVIDE ( phy_dis_hw_set_freq = 0x40003cbc ) ;
  PROVIDE ( phy_disable_cca = 0x40004d36 ) ;
  PROVIDE ( phy_disable_low_rate = 0x400031b6 ) ;
  PROVIDE ( phy_en_hw_set_freq = 0x40003ca6 ) ;
  PROVIDE ( phy_enable_cca = 0x40004d52 ) ;
  PROVIDE ( phy_enable_low_rate = 0x40003196 ) ;
  PROVIDE ( phy_force_pwr_index = 0x400057e2 ) ;
  PROVIDE ( phy_freq_correct = 0x40005614 ) ;
  PROVIDE ( phy_get_romfuncs = 0x40005d16 ) ;
  PROVIDE ( phy_is_low_rate_enabled = 0x400031d6 ) ;
  PROVIDE ( phy_param_addr = 0x40005d0c ) ;
  PROVIDE ( phy_param_rom = 0x4087fce8 ) ;
  PROVIDE ( phy_pwdet_always_en = 0x40004c8a ) ;
  PROVIDE ( phy_pwdet_onetime_en = 0x40004cc8 ) ;
  PROVIDE ( phy_rx11blr_cfg = 0x40003322 ) ;
  PROVIDE ( phy_rx_sense_set = 0x4000552a ) ;
  PROVIDE ( phy_set_bbfreq_init = 0x40005488 ) ;
  PROVIDE ( pkdet_vol_start = 0x40004b24 ) ;
  PROVIDE ( pll_cap_mem_update = 0x40003a34 ) ;
  PROVIDE ( pll_dac_mem_update = 0x400039e8 ) ;
  PROVIDE ( pm_allow_tx = 0x4000d1b6 ) ;
  PROVIDE ( pm_check_state = 0x4000c626 ) ;
  PROVIDE ( pm_disable_dream_timer = 0x4000c19c ) ;
  PROVIDE ( pm_disable_sleep_delay_timer = 0x4000c3f0 ) ;
  PROVIDE ( pm_dream = 0x4000c2e0 ) ;
  PROVIDE ( pm_enable_active_timer = 0x4000c0e2 ) ;
  PROVIDE ( pm_enable_sleep_delay_timer = 0x4000cea2 ) ;
  PROVIDE ( pm_get_state = 0x4000c040 ) ;
  PROVIDE ( pm_is_dream = 0x4000e12c ) ;
  PROVIDE ( pm_is_in_wifi_slice_threshold = 0x4000c90e ) ;
  PROVIDE ( pm_is_sleeping = 0x4000e102 ) ;
  PROVIDE ( pm_is_waked = 0x4000c04e ) ;
  PROVIDE ( pm_keep_alive = 0x4000cb1e ) ;
  PROVIDE ( pm_local_tsf_process = 0x4000c85e ) ;
  PROVIDE ( pm_mac_sleep = 0x4000c2d2 ) ;
  PROVIDE ( pm_mac_wakeup = 0x4000c2c4 ) ;
  PROVIDE ( pm_on_beacon_rx = 0x4000cf2a ) ;
  PROVIDE ( pm_on_data_rx = 0x4000d06a ) ;
  PROVIDE ( pm_on_tbtt = 0x4000cef2 ) ;
  PROVIDE ( pm_parse_beacon = 0x4000c96a ) ;
  PROVIDE ( pm_process_tim = 0x4000cbb4 ) ;
  PROVIDE ( pm_rx_beacon_process = 0x4000cd62 ) ;
  PROVIDE ( pm_rx_data_process = 0x4000ce22 ) ;
  PROVIDE ( pm_set_beacon_filter = 0x4000c8ac ) ;
  PROVIDE ( pm_sleep = 0x4000c40e ) ;
  PROVIDE ( pm_sleep_for = 0x4000c060 ) ;
  PROVIDE ( pm_tbtt_process = 0x4000c676 ) ;
  PROVIDE ( pm_tx_data_done_process = 0x4000d0d0 ) ;
  PROVIDE ( pm_tx_done_itwt_is_idle = 0x4000d0ac ) ;
  PROVIDE ( pn_np = 0x4002f922 ) ;
  PROVIDE ( pn_np = 0x4002fd64 ) ;
  PROVIDE ( pn_np = 0x40030400 ) ;
  PROVIDE ( pn_np = 0x400304a2 ) ;
  PROVIDE ( pos_or_zero = 0x4002f7a2 ) ;
  PROVIDE ( pos_or_zero = 0x4002fe82 ) ;
  PROVIDE ( ppAMPDU2Normal = 0x4000e03a ) ;
  PROVIDE ( ppAdd2AMPDUTail = 0x4000e51a ) ;
  PROVIDE ( ppAssembleAMPDU = 0x4000e5ac ) ;
  PROVIDE ( ppCalDeliNum = 0x4000e364 ) ;
  PROVIDE ( ppCalFrameTimes = 0x4000d624 ) ;
  PROVIDE ( ppCalPreFecPaddingFactor = 0x4000e828 ) ;
  PROVIDE ( ppCalSubFrameLength = 0x4000d626 ) ;
  PROVIDE ( ppCalTxAMPDULength = 0x4000eb10 ) ;
  PROVIDE ( ppCalTxHEAMPDULength = 0x40010c86 ) ;
  PROVIDE ( ppCalTxHESMPDULength = 0x40010c12 ) ;
  PROVIDE ( ppCalTxopDur = 0x4000d4de ) ;
  PROVIDE ( ppCalTxopRTSThreshold = 0x4000e6ae ) ;
  PROVIDE ( ppCertSetRate = 0x400109ba ) ;
  PROVIDE ( ppCheckTxAMPDUlength = 0x4000e46a ) ;
  PROVIDE ( ppCheckTxHEAMPDUlength = 0x40010aa0 ) ;
  PROVIDE ( ppDequeueRxq_Locked = 0x40010114 ) ;
  PROVIDE ( ppDequeueTxDone_Locked = 0x40010248 ) ;
  PROVIDE ( ppDequeueTxQ = 0x4000b4ce ) ;
  PROVIDE ( ppDirectRecycleAmpdu = 0x400107e2 ) ;
  PROVIDE ( ppDisableQueue = 0x400104ec ) ;
  PROVIDE ( ppEmptyDelimiterLength = 0x4000d87a ) ;
  PROVIDE ( ppEnqueueRxq = 0x400100f8 ) ;
  PROVIDE ( ppEnqueueTxDone = 0x40009e16 ) ;
  PROVIDE ( ppGetTxframe = 0x4000da9a ) ;
  PROVIDE ( ppHEAMPDU2Normal = 0x40010906 ) ;
  PROVIDE ( ppMapTxQueue = 0x4000ded4 ) ;
  PROVIDE ( ppMapWaitTxq = 0x40010596 ) ;
  PROVIDE ( ppProcTxCallback = 0x4001026c ) ;
  PROVIDE ( ppProcTxDone = 0x400102e0 ) ;
  PROVIDE ( ppProcTxSecFrame = 0x4000d658 ) ;
  PROVIDE ( ppProcessRxPktHdr = 0x4000fab6 ) ;
  PROVIDE ( ppProcessTxQ = 0x4000e140 ) ;
  PROVIDE ( ppProcessWaitingQueue = 0x4001051c ) ;
  PROVIDE ( ppRecordBarRRC = 0x4000b2ac ) ;
  PROVIDE ( ppRecycleAmpdu = 0x4000b2c4 ) ;
  PROVIDE ( ppRecycleRxPkt = 0x400100e4 ) ;
  PROVIDE ( ppRegressAmpdu = 0x40010858 ) ;
  PROVIDE ( ppRemoveHTC = 0x400106a0 ) ;
  PROVIDE ( ppResortTxAMPDU = 0x4000ee36 ) ;
  PROVIDE ( ppResumeTxAMPDU = 0x4000e2dc ) ;
  PROVIDE ( ppRxFragmentProc = 0x4000fc50 ) ;
  PROVIDE ( ppRxPkt = 0x40010138 ) ;
  PROVIDE ( ppRxProtoProc = 0x4000fb1e ) ;
  PROVIDE ( ppSearchTxQueue = 0x4000dd38 ) ;
  PROVIDE ( ppSearchTxframe = 0x4000db36 ) ;
  PROVIDE ( ppSelectNextQueue = 0x4000dc8a ) ;
  PROVIDE ( ppSelectTxFormat = 0x40010a30 ) ;
  PROVIDE ( ppSubFromAMPDU = 0x4000e2c6 ) ;
  PROVIDE ( ppTask = 0x4000f3a0 ) ;
  PROVIDE ( ppTxPkt = 0x4000d898 ) ;
  PROVIDE ( ppTxPktForceWaked = 0x4000da1c ) ;
  PROVIDE ( ppTxProtoProc = 0x4000d7e2 ) ;
  PROVIDE ( ppTxqUpdateBitmap = 0x4000b56e ) ;
  PROVIDE ( pp_coex_tx_request = 0x4000e048 ) ;
  PROVIDE ( pp_hdrsize = 0x4000faf8 ) ;
  PROVIDE ( pp_nn_h_eq = 0x4002f914 ) ;
  PROVIDE ( pp_nn_h_eq = 0x4002fd50 ) ;
  PROVIDE ( pp_nn_h_eq = 0x400303f2 ) ;
  PROVIDE ( pp_nn_h_eq = 0x4003048a ) ;
  PROVIDE ( pp_post = 0x4000d212 ) ;
  PROVIDE ( pp_process_hmac_waiting_txq = 0x4000f378 ) ;
  PROVIDE ( pp_rom_version = 0x4087f83c ) ;
  PROVIDE ( pp_sig_cnt_ptr = 0x4087ff5c ) ;
  PROVIDE ( pp_task_hdl = 0x4087ff40 ) ;
  PROVIDE ( pp_wdev_funcs = 0x4087ff70 ) ;
  PROVIDE ( pre_ovf = 0x4002fc92 ) ;
  PROVIDE ( print_hash = 0x4001a892 ) ;
  PROVIDE ( produce_nan = 0x4002f86e ) ;
  PROVIDE ( produce_nan = 0x40030048 ) ;
  PROVIDE ( pthread_setcancelstate = 0x400281a4 ) ;
  PROVIDE ( pwdet_code_cal = 0x400080ec ) ;
  PROVIDE ( pwdet_ref_code = 0x4000807c ) ;
  PROVIDE ( pwdet_reg_init = 0x40004e58 ) ;
  PROVIDE ( pwr_hal_clear_intr_status = 0x40008e7a ) ;
  PROVIDE ( pwr_hal_clear_mac_modem_beacon_miss_intr_filter = 0x40008f20 ) ;
  PROVIDE ( pwr_hal_clear_mac_modem_rx_beacon_info = 0x40008f7c ) ;
  PROVIDE ( pwr_hal_clear_mac_modem_rx_beacon_miss_counter = 0x40008f8c ) ;
  PROVIDE ( pwr_hal_clear_mac_modem_rx_beacon_sleep_counter = 0x40008f9c ) ;
  PROVIDE ( pwr_hal_clear_mac_modem_state_wakeup_protect_signal = 0x4000915c ) ;
  PROVIDE ( pwr_hal_get_intr_raw_signal = 0x40008e84 ) ;
  PROVIDE ( pwr_hal_get_intr_status = 0x40008e70 ) ;
  PROVIDE ( pwr_hal_get_mac_modem_beacon_miss_limit_exceeded_status = 0x40008f14 ) ;
  PROVIDE ( pwr_hal_get_mac_modem_rx_beacon_location_state = 0x4000911e ) ;
  PROVIDE ( pwr_hal_get_mac_modem_rx_beacon_valid_state = 0x40009112 ) ;
  PROVIDE ( pwr_hal_get_mac_modem_state_sleep_limit_exceeded_status = 0x40008f70 ) ;
  PROVIDE ( pwr_hal_set_beacon_filter_abort_disable = 0x40009098 ) ;
  PROVIDE ( pwr_hal_set_beacon_filter_abort_enable = 0x40009086 ) ;
  PROVIDE ( pwr_hal_set_beacon_filter_abort_length = 0x400090a8 ) ;
  PROVIDE ( pwr_hal_set_beacon_filter_broadcast_wakeup_disable = 0x40009054 ) ;
  PROVIDE ( pwr_hal_set_beacon_filter_broadcast_wakeup_enable = 0x40009042 ) ;
  PROVIDE ( pwr_hal_set_beacon_filter_disable = 0x40009032 ) ;
  PROVIDE ( pwr_hal_set_beacon_filter_enable = 0x40009020 ) ;
  PROVIDE ( pwr_hal_set_beacon_filter_force_dump_disable = 0x40008fde ) ;
  PROVIDE ( pwr_hal_set_beacon_filter_force_dump_enable = 0x40008fce ) ;
  PROVIDE ( pwr_hal_set_beacon_filter_force_dump_limit = 0x40008fac ) ;
  PROVIDE ( pwr_hal_set_beacon_filter_force_sync_disable = 0x40009012 ) ;
  PROVIDE ( pwr_hal_set_beacon_filter_force_sync_enable = 0x40009004 ) ;
  PROVIDE ( pwr_hal_set_beacon_filter_force_sync_limit = 0x40008ff0 ) ;
  PROVIDE ( pwr_hal_set_beacon_filter_frame_crc_state = 0x400090c6 ) ;
  PROVIDE ( pwr_hal_set_beacon_filter_soc_wakeup_and_intr_disable = 0x400090fe ) ;
  PROVIDE ( pwr_hal_set_beacon_filter_soc_wakeup_and_intr_enable = 0x400090e0 ) ;
  PROVIDE ( pwr_hal_set_beacon_filter_unicast_wakeup_disable = 0x40009076 ) ;
  PROVIDE ( pwr_hal_set_beacon_filter_unicast_wakeup_enable = 0x40009064 ) ;
  PROVIDE ( pwr_hal_set_lpclk_cycle_time = 0x40008e56 ) ;
  PROVIDE ( pwr_hal_set_lpclk_sync_disable = 0x40008e28 ) ;
  PROVIDE ( pwr_hal_set_lpclk_sync_enable = 0x40008e18 ) ;
  PROVIDE ( pwr_hal_set_mac_modem_beacon_miss_intr_disable = 0x40008edc ) ;
  PROVIDE ( pwr_hal_set_mac_modem_beacon_miss_intr_enable = 0x40008ebe ) ;
  PROVIDE ( pwr_hal_set_mac_modem_beacon_miss_limit = 0x40008ea2 ) ;
  PROVIDE ( pwr_hal_set_mac_modem_beacon_miss_limit_exceeded_wakeup_disable = 0x40008f02 ) ;
  PROVIDE ( pwr_hal_set_mac_modem_beacon_miss_limit_exceeded_wakeup_enable = 0x40008ef2 ) ;
  PROVIDE ( pwr_hal_set_mac_modem_beacon_miss_timeout = 0x40008e8e ) ;
  PROVIDE ( pwr_hal_set_mac_modem_state_sleep_limit = 0x40008f30 ) ;
  PROVIDE ( pwr_hal_set_mac_modem_state_sleep_limit_exceeded_wakeup_disable = 0x40008f5c ) ;
  PROVIDE ( pwr_hal_set_mac_modem_state_sleep_limit_exceeded_wakeup_enable = 0x40008f4c ) ;
  PROVIDE ( pwr_hal_set_mac_modem_state_wakeup_protect_disable = 0x40009138 ) ;
  PROVIDE ( pwr_hal_set_mac_modem_state_wakeup_protect_early_time = 0x40009148 ) ;
  PROVIDE ( pwr_hal_set_mac_modem_state_wakeup_protect_enable = 0x40009128 ) ;
  PROVIDE ( pwr_hal_set_mac_modem_tbtt_auto_period_disable = 0x4000917a ) ;
  PROVIDE ( pwr_hal_set_mac_modem_tbtt_auto_period_enable = 0x4000916a ) ;
  PROVIDE ( pwr_hal_set_mac_modem_tbtt_auto_period_interval = 0x4000918e ) ;
  PROVIDE ( pwr_hal_set_modem_state_interface = 0x40008e3a ) ;
  PROVIDE ( quorem = 0x4003e62a ) ;
  PROVIDE ( rand = 0x40031274 ) ;
  PROVIDE ( rand_r = 0x4003131e ) ;
  PROVIDE ( rc11BSchedTbl_ptr = 0x4087ff28 ) ;
  PROVIDE ( rc11NSchedTbl_ptr = 0x4087ff24 ) ;
  PROVIDE ( rcAmpduLowerRate = 0x40011b0a ) ;
  PROVIDE ( rcClearCurAMPDUSched = 0x40011a96 ) ;
  PROVIDE ( rcClearCurSched = 0x40011284 ) ;
  PROVIDE ( rcClearCurStat = 0x40011276 ) ;
  PROVIDE ( rcGetAmpduSched = 0x4000e528 ) ;
  PROVIDE ( rcGetDCMMaxRate = 0x4001213c ) ;
  PROVIDE ( rcGetRate = 0x400120b6 ) ;
  PROVIDE ( rcGetSMPDURate = 0x4001218e ) ;
  PROVIDE ( rcGetSched = 0x40011142 ) ;
  PROVIDE ( rcLoRaSchedTbl_ptr = 0x4087ff20 ) ;
  PROVIDE ( rcLowerSched = 0x400112bc ) ;
  PROVIDE ( rcSetTxAmpduLimit = 0x40011ac4 ) ;
  PROVIDE ( rcTxUpdatePer = 0x4001130e ) ;
  PROVIDE ( rcUpSched = 0x400110fe ) ;
  PROVIDE ( rcUpdateAckSnr = 0x40011234 ) ;
  PROVIDE ( rcUpdateRate = 0x40011608 ) ;
  PROVIDE ( rcUpdateRxDone = 0x4001143c ) ;
  PROVIDE ( rcUpdateTxDone = 0x4001138e ) ;
  PROVIDE ( rcUpdateTxDoneAmpdu2 = 0x40011d48 ) ;
  PROVIDE ( rc_cal = 0x40002d1e ) ;
  PROVIDE ( rc_get_trc = 0x40011ffa ) ;
  PROVIDE ( rc_get_trc_by_index = 0x40012068 ) ;
  PROVIDE ( rcampduuprate = 0x40011ce6 ) ;
  PROVIDE ( read_hw_noisefloor = 0x400053ee ) ;
  PROVIDE ( read_id_core = 0x4002584e ) ;
  PROVIDE ( read_pll_cap = 0x40005a96 ) ;
  PROVIDE ( read_rf_freq_mem = 0x40003702 ) ;
  PROVIDE ( read_sar2_code = 0x40004ba2 ) ;
  PROVIDE ( recv_packet = 0x40022f70 ) ;
  PROVIDE ( reset_reasons = 0x4004a8e8 ) ;
  PROVIDE ( restart_cal = 0x4000587e ) ;
  PROVIDE ( ret_0 = 0x4002f6aa ) ;
  PROVIDE ( ret_0 = 0x4002f91e ) ;
  PROVIDE ( ret_0 = 0x4002fd5e ) ;
  PROVIDE ( ret_0 = 0x40030082 ) ;
  PROVIDE ( ret_0 = 0x40030334 ) ;
  PROVIDE ( ret_0 = 0x400303fc ) ;
  PROVIDE ( ret_0 = 0x4003049c ) ;
  PROVIDE ( ret_0 = 0x400304d4 ) ;
  PROVIDE ( ret_1 = 0x4003007e ) ;
  PROVIDE ( ret_m1 = 0x40030338 ) ;
  PROVIDE ( return_a0 = 0x4002f7be ) ;
  PROVIDE ( return_greater = 0x4002f824 ) ;
  PROVIDE ( rfcal_pwrctrl = 0x4000833c ) ;
  PROVIDE ( rfcal_rxiq = 0x400060b8 ) ;
  PROVIDE ( rfcal_txcap = 0x40008138 ) ;
  PROVIDE ( rfcal_txiq = 0x40007dac ) ;
  PROVIDE ( rfpll_cap_correct = 0x40005ada ) ;
  PROVIDE ( rfpll_cap_init_cal = 0x40005b52 ) ;
  PROVIDE ( rom_bb_bss_cbw40 = 0x40002ed8 ) ;
  PROVIDE ( rom_bb_gain_index = 0x400071c0 ) ;
  PROVIDE ( rom_cache_internal_table_ptr = 0x4087ffc8 ) ;
  PROVIDE ( rom_cache_op_cb = 0x4087ffcc ) ;
  PROVIDE ( rom_chip_i2c_readReg = 0x40003dc0 ) ;
  PROVIDE ( rom_chip_i2c_readReg_org = 0x40003d88 ) ;
  PROVIDE ( rom_chip_i2c_writeReg = 0x400040b4 ) ;
  PROVIDE ( rom_default_cache_internal_table = 0x4004db10 ) ;
  PROVIDE ( rom_default_heap_tlsf_table = 0x4004d0d0 ) ;
  PROVIDE ( rom_default_spiflash_legacy_data = 0x4087fa08 ) ;
  PROVIDE ( rom_default_spiflash_legacy_funcs = 0x4087fa24 ) ;
  PROVIDE ( rom_en_pwdet = 0x40004846 ) ;
  PROVIDE ( rom_enter_critical_phy = 0x40002e1e ) ;
  PROVIDE ( rom_exit_critical_phy = 0x40002e22 ) ;
  PROVIDE ( rom_get_i2c_hostid = 0x40003d4a ) ;
  PROVIDE ( rom_get_i2c_mst0_mask = 0x40003d28 ) ;
  PROVIDE ( rom_get_i2c_read_mask = 0x40003d06 ) ;
  PROVIDE ( rom_get_mmu_region.part.1 = 0x40026cc8 ) ;
  PROVIDE ( rom_get_sar_sig_ref = 0x40004876 ) ;
  PROVIDE ( rom_i2c_enter_critical = 0x40003d02 ) ;
  PROVIDE ( rom_i2c_exit_critical = 0x40003d04 ) ;
  PROVIDE ( rom_i2c_readReg = 0x400040a6 ) ;
  PROVIDE ( rom_i2c_readReg_Mask = 0x4000412c ) ;
  PROVIDE ( rom_i2c_writeReg = 0x4000411e ) ;
  PROVIDE ( rom_i2c_writeReg_Mask = 0x40004160 ) ;
  PROVIDE ( rom_iq_est_disable = 0x40005dce ) ;
  PROVIDE ( rom_iq_est_enable = 0x40005d48 ) ;
  PROVIDE ( rom_loopback_mode_en = 0x40002e74 ) ;
  PROVIDE ( rom_pbus_force_mode = 0x40004290 ) ;
  PROVIDE ( rom_pbus_force_test = 0x400043d6 ) ;
  PROVIDE ( rom_pbus_rd = 0x40004418 ) ;
  PROVIDE ( rom_pbus_rd_addr = 0x40004334 ) ;
  PROVIDE ( rom_pbus_rd_shift = 0x40004390 ) ;
  PROVIDE ( rom_pbus_set_rxgain = 0x40004484 ) ;
  PROVIDE ( rom_pbus_xpd_rx_off = 0x400044f6 ) ;
  PROVIDE ( rom_pbus_xpd_rx_on = 0x40004532 ) ;
  PROVIDE ( rom_pbus_xpd_tx_off = 0x400045a2 ) ;
  PROVIDE ( rom_pbus_xpd_tx_on = 0x40004652 ) ;
  PROVIDE ( rom_phyFuns = 0x4087fa04 ) ;
  PROVIDE ( rom_pwdet_sar2_init = 0x40004806 ) ;
  PROVIDE ( rom_pwdet_tone_start = 0x400048b4 ) ;
  PROVIDE ( rom_pwdet_wait_idle = 0x40004b10 ) ;
  PROVIDE ( rom_read_sar_dout = 0x40004b80 ) ;
  PROVIDE ( rom_rfpll_set_freq = 0x400059e6 ) ;
  PROVIDE ( rom_rfrx_gain_index = 0x400071fa ) ;
  PROVIDE ( rom_set_chan_cal_interp = 0x40002e2e ) ;
  PROVIDE ( rom_set_chan_freq_sw_start = 0x40003ce0 ) ;
  PROVIDE ( rom_set_loopback_gain = 0x400046f2 ) ;
  PROVIDE ( rom_set_txcap_reg = 0x400041c8 ) ;
  PROVIDE ( rom_spiflash_legacy_data = 0x4087ffec ) ;
  PROVIDE ( rom_spiflash_legacy_funcs = 0x4087fff0 ) ;
  PROVIDE ( rom_start_tx_tone_step = 0x400052ac ) ;
  PROVIDE ( rom_stop_tx_tone = 0x40005372 ) ;
  PROVIDE ( rom_txcal_debuge_mode = 0x40004780 ) ;
  PROVIDE ( round = 0x4002f5de ) ;
  PROVIDE ( rounding = 0x4002f7c0 ) ;
  PROVIDE ( rounding = 0x4002fb7e ) ;
  PROVIDE ( rounding = 0x4002feb2 ) ;
  PROVIDE ( roundup2 = 0x40001c94 ) ;
  PROVIDE ( rshift = 0x40041732 ) ;
  PROVIDE ( rssi_margin = 0x400114aa ) ;
  PROVIDE ( rtc_get_reset_reason = 0x40019680 ) ;
  PROVIDE ( rtc_get_wakeup_cause = 0x4001968c ) ;
  PROVIDE ( rtc_is_deep_sleep_reset = 0x40019696 ) ;
  PROVIDE ( rtc_unhold_all_pads = 0x4001975c ) ;
  PROVIDE ( rx11ACRate2AMPDULimit = 0x4000e430 ) ;
  PROVIDE ( rx11AXRate2AMPDULimit = 0x40012216 ) ;
  PROVIDE ( rx11NRate2AMPDULimit = 0x40011ae8 ) ;
  PROVIDE ( rx_beacon_count = 0x4087fe84 ) ;
  PROVIDE ( rx_beacon_dtim_tim = 0x4087fe58 ) ;
  PROVIDE ( rx_beacon_dtim_tim_mcast = 0x4087fe54 ) ;
  PROVIDE ( rx_beacon_hw_parse = 0x4087fe7c ) ;
  PROVIDE ( rx_beacon_sw_parse = 0x4087fe80 ) ;
  PROVIDE ( rx_beacon_tim_bdata = 0x4087fe6c ) ;
  PROVIDE ( rx_beacon_tim_bdata_bitmap_mbssid_other = 0x4087fe5c ) ;
  PROVIDE ( rx_beacon_tim_bdata_bitmap_mbssid_self = 0x4087fe60 ) ;
  PROVIDE ( rx_beacon_tim_bdata_bitmap_trans = 0x4087fe64 ) ;
  PROVIDE ( rx_beacon_tim_bdata_bitmapctl = 0x4087fe68 ) ;
  PROVIDE ( rx_beacon_tim_count = 0x4087fe78 ) ;
  PROVIDE ( rx_beacon_tim_udata = 0x4087fe74 ) ;
  PROVIDE ( rx_beacon_tim_udata_bitmap = 0x4087fe70 ) ;
  PROVIDE ( rx_gain_force_rom = 0x400035b6 ) ;
  PROVIDE ( rxdc_est_min = 0x400064d2 ) ;
  PROVIDE ( rxiq_cover_mg_mp = 0x40006016 ) ;
  PROVIDE ( rxiq_get_mis = 0x40005ec4 ) ;
  PROVIDE ( rxiq_set_reg = 0x40005214 ) ;
  PROVIDE ( s_cache_drom_mmu_size = 0x4087fa84 ) ;
  PROVIDE ( s_cache_irom_mmu_size = 0x4087fa88 ) ;
  PROVIDE ( s_dist_base.2738 = 0x4004bff4 ) ;
  PROVIDE ( s_dist_extra.2739 = 0x4004c074 ) ;
  PROVIDE ( s_encap_amsdu_func = 0x4087fe88 ) ;
  PROVIDE ( s_flash_cache_enable = 0x4087fa58 ) ;
  PROVIDE ( s_fragment_ptr = 0x4087ff54 ) ;
  PROVIDE ( s_he_dcm_min_len_bytes = 0x4087fdd0 ) ;
  PROVIDE ( s_he_min_len_bytes = 0x4087fdf0 ) ;
  PROVIDE ( s_ht_ampdu_density = 0x4087fd01 ) ;
  PROVIDE ( s_ht_ampdu_density_us = 0x4087fd02 ) ;
  PROVIDE ( s_intr_handlers = 0x4087f464 ) ;
  PROVIDE ( s_is_rsa = 0x4087e610 ) ;
  PROVIDE ( s_itwt_state = 0x4087fe40 ) ;
  PROVIDE ( s_length_base.2736 = 0x4004c0f4 ) ;
  PROVIDE ( s_length_dezigzag.2740 = 0x4004c170 ) ;
  PROVIDE ( s_length_extra.2737 = 0x4004c184 ) ;
  PROVIDE ( s_michael_mic_failure_cb = 0x4087fee0 ) ;
  PROVIDE ( s_min_table_sizes.2741 = 0x4004c200 ) ;
  PROVIDE ( s_mmap_entries_head = 0x4087fa68 ) ;
  PROVIDE ( s_mmap_last_handle = 0x4087fa6c ) ;
  PROVIDE ( s_mmap_page_num = 0x4087fa70 ) ;
  PROVIDE ( s_mmap_page_refcnt = 0x4087fa74 ) ;
  PROVIDE ( s_mplen_bk_bitmap = 0x4087fda8 ) ;
  PROVIDE ( s_mplen_high_bitmap = 0x4087fdb0 ) ;
  PROVIDE ( s_mplen_low_bitmap = 0x4087fdc0 ) ;
  PROVIDE ( s_mplen_vi_bitmap = 0x4087fdac ) ;
  PROVIDE ( s_multi_heap_mutex = 0x4087fa80 ) ;
  PROVIDE ( s_netstack_free = 0x4087ff94 ) ;
  PROVIDE ( s_poison_check_region = 0x4087fa78 ) ;
  PROVIDE ( s_poison_fill_region = 0x4087fa7c ) ;
  PROVIDE ( s_pp_task_create_sem = 0x4087ff3c ) ;
  PROVIDE ( s_pp_task_del_sem = 0x4087ff38 ) ;
  PROVIDE ( s_running_phy_type = 0x4087fd00 ) ;
  PROVIDE ( s_spi_flash_hal_max_read_len = 0x4087fa5c ) ;
  PROVIDE ( s_tdefl_large_dist_extra = 0x4004c20c ) ;
  PROVIDE ( s_tdefl_large_dist_sym = 0x4004c28c ) ;
  PROVIDE ( s_tdefl_len_extra = 0x4004c30c ) ;
  PROVIDE ( s_tdefl_len_sym = 0x4004c40c ) ;
  PROVIDE ( s_tdefl_packed_code_size_syms_swizzle = 0x4004c170 ) ;
  PROVIDE ( s_tdefl_small_dist_extra = 0x4004c60c ) ;
  PROVIDE ( s_tdefl_small_dist_sym = 0x4004c80c ) ;
  PROVIDE ( s_ticks_per_us = 0x4087faa0 ) ;
  PROVIDE ( s_wifi_queue = 0x4087ff44 ) ;
  PROVIDE ( sbrk = 0x40039d80 ) ;
  PROVIDE ( sdesc.2750 = 0x4004de34 ) ;
  PROVIDE ( sdio_slave_mode_init = 0x400027e6 ) ;
  PROVIDE ( sdio_slave_pads_init = 0x4000271a ) ;
  PROVIDE ( sdio_slv_hal_init_device_id = 0x40020fd4 ) ;
  PROVIDE ( secure_boot_verify_block = 0x40019aac ) ;
  PROVIDE ( send_packet = 0x40022e68 ) ;
  PROVIDE ( set_cal_rxdc = 0x40005e78 ) ;
  PROVIDE ( set_cca_rom = 0x4000335a ) ;
  PROVIDE ( set_chan_reg = 0x40002f4a ) ;
  PROVIDE ( set_channel_rfpll_freq = 0x40005c86 ) ;
  PROVIDE ( set_lb_txiq = 0x400069e4 ) ;
  PROVIDE ( set_pbus_reg = 0x4000570c ) ;
  PROVIDE ( set_rf_freq_offset = 0x40005c78 ) ;
  PROVIDE ( set_rfpll_freq = 0x40005c1e ) ;
  PROVIDE ( set_rx_comp = 0x4000501c ) ;
  PROVIDE ( set_rx_gain_cal_dc = 0x40006cee ) ;
  PROVIDE ( set_rx_gain_cal_iq = 0x40006a08 ) ;
  PROVIDE ( set_rx_sense_rom = 0x4000338c ) ;
  PROVIDE ( set_rxclk_en = 0x4000528c ) ;
  PROVIDE ( set_txclk_en = 0x40005268 ) ;
  PROVIDE ( setjmp = 0x40031372 ) ;
  PROVIDE ( setlocale = 0x4003f72e ) ;
  PROVIDE ( sha_block_bytes = 0x4004ace8 ) ;
  PROVIDE ( sha_padding = 0x4004acec ) ;
  PROVIDE ( sha_result_bytes = 0x4004ad6c ) ;
  PROVIDE ( sha_state_bytes = 0x4004ad70 ) ;
  PROVIDE ( sigb_common_ru_allocation = 0x4004ff38 ) ;
  PROVIDE ( sigb_ru_allocation_user_num = 0x4004ffc8 ) ;
  PROVIDE ( sign_and_exit = 0x4002f7d0 ) ;
  PROVIDE ( sign_exit = 0x4002f5ea ) ;
  PROVIDE ( sip_after_tx_complete = 0x40002554 ) ;
  PROVIDE ( sip_alloc_to_host_evt = 0x40001caa ) ;
  PROVIDE ( sip_boot_rx_ctrl = 0x40002180 ) ;
  PROVIDE ( sip_download_begin = 0x40001f6e ) ;
  PROVIDE ( sip_from_host_avail_cb = 0x400019c0 ) ;
  PROVIDE ( sip_from_host_process = 0x40002306 ) ;
  PROVIDE ( sip_get_ptr = 0x4000254a ) ;
  PROVIDE ( sip_get_send_length = 0x40001958 ) ;
  PROVIDE ( sip_get_state = 0x40001f7c ) ;
  PROVIDE ( sip_init_attach = 0x40001f86 ) ;
  PROVIDE ( sip_install_rx_ctrl_cb = 0x40001f56 ) ;
  PROVIDE ( sip_install_rx_data_cb = 0x40001f62 ) ;
  PROVIDE ( sip_is_active = 0x400025c6 ) ;
  PROVIDE ( sip_post_init = 0x4000203a ) ;
  PROVIDE ( sip_reclaim_from_host_cmd = 0x40001f20 ) ;
  PROVIDE ( sip_reclaim_tx_data_pkt = 0x40001ece ) ;
  PROVIDE ( sip_send = 0x400020c0 ) ;
  PROVIDE ( sip_start_send = 0x40001b1e ) ;
  PROVIDE ( sip_task = 0x40001c72 ) ;
  PROVIDE ( sip_task_q = 0x4087f2f8 ) ;
  PROVIDE ( sip_to_host_chain_append = 0x4000205e ) ;
  PROVIDE ( sip_to_host_done_cb = 0x40001a72 ) ;
  PROVIDE ( sip_to_host_done_process = 0x40001db2 ) ;
  PROVIDE ( sip_to_host_evt_send_done = 0x40001d3e ) ;
  PROVIDE ( siprintf = 0x40031422 ) ;
  PROVIDE ( siscanf = 0x4003146c ) ;
  PROVIDE ( slcCtrl = 0x4087f318 ) ;
  PROVIDE ( slc_add_credits = 0x40002b94 ) ;
  PROVIDE ( slc_enable = 0x4000283a ) ;
  PROVIDE ( slc_from_host_chain_fetch = 0x400029a6 ) ;
  PROVIDE ( slc_from_host_chain_recycle = 0x40002ba6 ) ;
  PROVIDE ( slc_has_pkt_to_host = 0x400026d8 ) ;
  PROVIDE ( slc_init_attach = 0x40002a58 ) ;
  PROVIDE ( slc_init_credit = 0x40002b84 ) ;
  PROVIDE ( slc_isr = 0x4000260e ) ;
  PROVIDE ( slc_reattach = 0x4000270a ) ;
  PROVIDE ( slc_send_to_host_chain = 0x4000288c ) ;
  PROVIDE ( slc_set_host_io_max_window = 0x40002a3e ) ;
  PROVIDE ( slc_to_host_chain_recycle = 0x40002920 ) ;
  PROVIDE ( sniprintf = 0x4003157e ) ;
  PROVIDE ( software_reset = 0x4001973c ) ;
  PROVIDE ( software_reset_cpu = 0x4001974c ) ;
  PROVIDE ( spi_cache_mode_switch = 0x40024872 ) ;
  PROVIDE ( spi_common_set_dummy_output = 0x400249c4 ) ;
  PROVIDE ( spi_common_set_flash_cs_timing = 0x4002497e ) ;
  PROVIDE ( spi_dummy_len_fix = 0x40023e46 ) ;
  PROVIDE ( spi_flash_attach = 0x40024cfa ) ;
  PROVIDE ( spi_flash_boot_attach = 0x40024cce ) ;
  PROVIDE ( spi_flash_cache2phys = 0x400272be ) ;
  PROVIDE ( spi_flash_cache_enabled = 0x400252f8 ) ;
  PROVIDE ( spi_flash_check_and_flush_cache = 0x400274a0 ) ;
  PROVIDE ( spi_flash_chip_gd_get_io_mode = 0x4002630a ) ;
  PROVIDE ( spi_flash_chip_gd_probe = 0x40026296 ) ;
  PROVIDE ( spi_flash_chip_gd_set_io_mode = 0x400262b8 ) ;
  PROVIDE ( spi_flash_chip_generic_config_data = 0x4087ffe0 ) ;
  PROVIDE ( spi_flash_chip_generic_config_host_io_mode = 0x400268f6 ) ;
  PROVIDE ( spi_flash_chip_generic_default_config_data = 0x4004d940 ) ;
  PROVIDE ( spi_flash_chip_generic_detect_size = 0x40026442 ) ;
  PROVIDE ( spi_flash_chip_generic_erase_block = 0x40026524 ) ;
  PROVIDE ( spi_flash_chip_generic_erase_chip = 0x40026468 ) ;
  PROVIDE ( spi_flash_chip_generic_erase_sector = 0x400264c4 ) ;
  PROVIDE ( spi_flash_chip_generic_get_caps = 0x40026bd0 ) ;
  PROVIDE ( spi_flash_chip_generic_get_io_mode = 0x40026a54 ) ;
  PROVIDE ( spi_flash_chip_generic_get_write_protect = 0x4002677c ) ;
  PROVIDE ( spi_flash_chip_generic_page_program = 0x40026584 ) ;
  PROVIDE ( spi_flash_chip_generic_probe = 0x400263e8 ) ;
  PROVIDE ( spi_flash_chip_generic_read = 0x400269a8 ) ;
  PROVIDE ( spi_flash_chip_generic_read_reg = 0x40026826 ) ;
  PROVIDE ( spi_flash_chip_generic_read_unique_id = 0x40026b58 ) ;
  PROVIDE ( spi_flash_chip_generic_reset = 0x400263ec ) ;
  PROVIDE ( spi_flash_chip_generic_set_io_mode = 0x40026b38 ) ;
  PROVIDE ( spi_flash_chip_generic_set_write_protect = 0x40026734 ) ;
  PROVIDE ( spi_flash_chip_generic_suspend_cmd_conf = 0x40026be2 ) ;
  PROVIDE ( spi_flash_chip_generic_wait_idle = 0x4002686e ) ;
  PROVIDE ( spi_flash_chip_generic_write = 0x400265e0 ) ;
  PROVIDE ( spi_flash_chip_generic_write_encrypted = 0x4002666e ) ;
  PROVIDE ( spi_flash_chip_generic_yield = 0x40026838 ) ;
  PROVIDE ( spi_flash_common_read_qe_sr.isra.1.constprop.3 = 0x40026372 ) ;
  PROVIDE ( spi_flash_common_read_status_16b_rdsr_rdsr2 = 0x400263ac ) ;
  PROVIDE ( spi_flash_common_read_status_8b_rdsr = 0x40026a72 ) ;
  PROVIDE ( spi_flash_common_read_status_8b_rdsr2 = 0x40026a40 ) ;
  PROVIDE ( spi_flash_common_set_io_mode = 0x40026aae ) ;
  PROVIDE ( spi_flash_common_write_qe_sr.isra.2 = 0x40026328 ) ;
  PROVIDE ( spi_flash_common_write_status_16b_wrsr = 0x4002635e ) ;
  PROVIDE ( spi_flash_common_write_status_8b_wrsr = 0x40026a84 ) ;
  PROVIDE ( spi_flash_common_write_status_8b_wrsr2 = 0x40026a98 ) ;
  PROVIDE ( spi_flash_disable_cache = 0x400252c2 ) ;
  PROVIDE ( spi_flash_enable_cache = 0x40025308 ) ;
  PROVIDE ( spi_flash_encryption = 0x4087ffdc ) ;
  PROVIDE ( spi_flash_encryption_default = 0x4004d980 ) ;
  PROVIDE ( spi_flash_encryption_hal_check = 0x40020084 ) ;
  PROVIDE ( spi_flash_encryption_hal_destroy = 0x40020078 ) ;
  PROVIDE ( spi_flash_encryption_hal_disable = 0x4002001e ) ;
  PROVIDE ( spi_flash_encryption_hal_done = 0x40020056 ) ;
  PROVIDE ( spi_flash_encryption_hal_enable = 0x40020008 ) ;
  PROVIDE ( spi_flash_encryption_hal_prepare = 0x4002002a ) ;
  PROVIDE ( spi_flash_generic_wait_host_idle = 0x400267c6 ) ;
  PROVIDE ( spi_flash_get_chip_size = 0x40027528 ) ;
  PROVIDE ( spi_flash_guard_get = 0x4002753e ) ;
  PROVIDE ( spi_flash_guard_set = 0x40027534 ) ;
  PROVIDE ( spi_flash_hal_check_status = 0x400205a0 ) ;
  PROVIDE ( spi_flash_hal_common_command = 0x400202f4 ) ;
  PROVIDE ( spi_flash_hal_configure_host_io_mode = 0x4002015e ) ;
  PROVIDE ( spi_flash_hal_device_config = 0x400207b0 ) ;
  PROVIDE ( spi_flash_hal_disable_auto_resume_mode = 0x40020776 ) ;
  PROVIDE ( spi_flash_hal_disable_auto_suspend_mode = 0x40020708 ) ;
  PROVIDE ( spi_flash_hal_erase_block = 0x400204b0 ) ;
  PROVIDE ( spi_flash_hal_erase_chip = 0x40020442 ) ;
  PROVIDE ( spi_flash_hal_erase_sector = 0x40020466 ) ;
  PROVIDE ( spi_flash_hal_host_idle = 0x4002057a ) ;
  PROVIDE ( spi_flash_hal_poll_cmd_done = 0x40020138 ) ;
  PROVIDE ( spi_flash_hal_program_page = 0x400204f6 ) ;
  PROVIDE ( spi_flash_hal_read = 0x400203d4 ) ;
  PROVIDE ( spi_flash_hal_resume = 0x4002080a ) ;
  PROVIDE ( spi_flash_hal_set_write_protect = 0x40020556 ) ;
  PROVIDE ( spi_flash_hal_setup_auto_resume_mode = 0x400206ce ) ;
  PROVIDE ( spi_flash_hal_setup_auto_suspend_mode = 0x4002065e ) ;
  PROVIDE ( spi_flash_hal_setup_read_suspend = 0x400205b6 ) ;
  PROVIDE ( spi_flash_hal_suspend = 0x4002081a ) ;
  PROVIDE ( spi_flash_mmap = 0x40027026 ) ;
  PROVIDE ( spi_flash_mmap_dump = 0x400271be ) ;
  PROVIDE ( spi_flash_mmap_get_free_pages = 0x40027250 ) ;
  PROVIDE ( spi_flash_mmap_init = 0x40026c28 ) ;
  PROVIDE ( spi_flash_mmap_os_func_set = 0x40026d18 ) ;
  PROVIDE ( spi_flash_mmap_page_num_init = 0x40026d2a ) ;
  PROVIDE ( spi_flash_mmap_pages = 0x40026d60 ) ;
  PROVIDE ( spi_flash_munmap = 0x400270f2 ) ;
  PROVIDE ( spi_flash_phys2cache = 0x400273c8 ) ;
  PROVIDE ( spi_flash_read_encrypted = 0x40027548 ) ;
  PROVIDE ( spi_flash_restore_cache = 0x400252e0 ) ;
  PROVIDE ( spi_modes = 0x4004b05c ) ;
  PROVIDE ( spi_set_dummy_output = 0x40023e5e ) ;
  PROVIDE ( spiflash_end_default = 0x400257be ) ;
  PROVIDE ( spiflash_start_default = 0x4002579a ) ;
  PROVIDE ( spimem_flash_ll_get_buffer_data = 0x400200da ) ;
  PROVIDE ( spimem_flash_ll_set_buffer_data = 0x4002008e ) ;
  PROVIDE ( spur_cal = 0x40007086 ) ;
  PROVIDE ( spur_coef_cfg = 0x400070d6 ) ;
  PROVIDE ( spur_reg_write_one_tone = 0x40006e22 ) ;
  PROVIDE ( srand = 0x400311fe ) ;
  PROVIDE ( sscanf = 0x40031762 ) ;
  PROVIDE ( sta_input = 0x40015efe ) ;
  PROVIDE ( sta_rxcb = 0x4087ff8c ) ;
  PROVIDE ( strcasecmp = 0x400318ce ) ;
  PROVIDE ( strcasestr = 0x40031912 ) ;
  PROVIDE ( strcat = 0x400319a6 ) ;
  PROVIDE ( strcoll = 0x40031afe ) ;
  PROVIDE ( strcspn = 0x40031b64 ) ;
  PROVIDE ( strdup = 0x40031b86 ) ;
  PROVIDE ( strlcat = 0x40031bce ) ;
  PROVIDE ( strlcpy = 0x40031c22 ) ;
  PROVIDE ( strlwr = 0x40031cc8 ) ;
  PROVIDE ( strncasecmp = 0x40031cf6 ) ;
  PROVIDE ( strncat = 0x40031d50 ) ;
  PROVIDE ( strndup = 0x40031dce ) ;
  PROVIDE ( strnlen = 0x40031e36 ) ;
  PROVIDE ( strsep = 0x40031e80 ) ;
  PROVIDE ( strspn = 0x40031e88 ) ;
  PROVIDE ( strstr = 0x40031eaa ) ;
  PROVIDE ( strtod = 0x40041138 ) ;
  PROVIDE ( strtod_l = 0x40041116 ) ;
  PROVIDE ( strtof = 0x4004123c ) ;
  PROVIDE ( strtof_l = 0x4004115c ) ;
  PROVIDE ( strtok_r = 0x40031f3c ) ;
  PROVIDE ( strtol_l = 0x40032084 ) ;
  PROVIDE ( strtoll = 0x400414fa ) ;
  PROVIDE ( strtoll_l = 0x400414da ) ;
  PROVIDE ( strtoul_l = 0x400321e2 ) ;
  PROVIDE ( strtoull = 0x400416e4 ) ;
  PROVIDE ( strtoull_l = 0x400416c4 ) ;
  PROVIDE ( strupr = 0x40032222 ) ;
  PROVIDE ( sulp = 0x4004041a ) ;
  PROVIDE ( sum = 0x4002f78e ) ;
  PROVIDE ( sum = 0x4002fe12 ) ;
  PROVIDE ( swapfunc = 0x40030eba ) ;
  PROVIDE ( syscall_table_ptr = 0x4087ffd4 ) ;
  PROVIDE ( systimer_hal_connect_alarm_counter = 0x40020b5e ) ;
  PROVIDE ( systimer_hal_counter_can_stall_by_cpu = 0x40020bac ) ;
  PROVIDE ( systimer_hal_counter_value_advance = 0x40020a60 ) ;
  PROVIDE ( systimer_hal_deinit = 0x40020844 ) ;
  PROVIDE ( systimer_hal_enable_alarm_int = 0x40020a4e ) ;
  PROVIDE ( systimer_hal_enable_counter = 0x40020ad4 ) ;
  PROVIDE ( systimer_hal_get_alarm_value = 0x40020a1e ) ;
  PROVIDE ( systimer_hal_get_counter_value = 0x40020864 ) ;
  PROVIDE ( systimer_hal_get_time = 0x400208dc ) ;
  PROVIDE ( systimer_hal_init = 0x4002082a ) ;
  PROVIDE ( systimer_hal_on_apb_freq_update = 0x40020a5e ) ;
  PROVIDE ( systimer_hal_select_alarm_mode = 0x40020aea ) ;
  PROVIDE ( systimer_hal_set_alarm_period = 0x40020980 ) ;
  PROVIDE ( systimer_hal_set_alarm_target = 0x400208ec ) ;
  PROVIDE ( systimer_hal_set_tick_rate_ops = 0x4002085a ) ;
  PROVIDE ( tdefl_compress = 0x4001e3aa ) ;
  PROVIDE ( tdefl_compress_buffer = 0x4001eb7e ) ;
  PROVIDE ( tdefl_compress_lz_codes = 0x4001be56 ) ;
  PROVIDE ( tdefl_compress_mem_to_heap = 0x4001eca2 ) ;
  PROVIDE ( tdefl_compress_mem_to_mem = 0x4001ecb0 ) ;
  PROVIDE ( tdefl_compress_mem_to_output = 0x4001ec9e ) ;
  PROVIDE ( tdefl_flush_block = 0x4001ccde ) ;
  PROVIDE ( tdefl_flush_output_buffer = 0x4001c108 ) ;
  PROVIDE ( tdefl_get_adler32 = 0x4001ec9a ) ;
  PROVIDE ( tdefl_get_prev_return_status = 0x4001ec96 ) ;
  PROVIDE ( tdefl_init = 0x4001eb98 ) ;
  PROVIDE ( tdefl_optimize_huffman_table = 0x4001c170 ) ;
  PROVIDE ( tdefl_start_dynamic_block = 0x4001c76a ) ;
  PROVIDE ( tdefl_start_static_block = 0x4001c68c ) ;
  PROVIDE ( tdefl_write_image_to_png_file_in_memory = 0x4001ecbc ) ;
  PROVIDE ( tdefl_write_image_to_png_file_in_memory_ex = 0x4001ecb4 ) ;
  PROVIDE ( tee_hal_config_master_mode = 0x40020ff4 ) ;
  PROVIDE ( temp_to_power = 0x400075c8 ) ;
  PROVIDE ( test_free_rx_statistics = 0x400143a8 ) ;
  PROVIDE ( test_mimo_update_user_info = 0x400135f0 ) ;
  PROVIDE ( test_mumimo_get_heltf_num = 0x400135c6 ) ;
  PROVIDE ( test_nonmimo_update_user_info = 0x40013766 ) ;
  PROVIDE ( test_parse_rx_mu_mimo = 0x4001370c ) ;
  PROVIDE ( test_parse_rx_mu_nonmimo = 0x400139e6 ) ;
  PROVIDE ( test_rx_process_complete_noeb = 0x4001404c ) ;
  PROVIDE ( test_rx_process_complete_retry = 0x40014104 ) ;
  PROVIDE ( test_tx_fail_statistics = 0x40014822 ) ;
  PROVIDE ( test_tx_succ_statistics = 0x40014930 ) ;
  PROVIDE ( tinfl_decompress = 0x4001d25c ) ;
  PROVIDE ( tinfl_decompress_mem_to_callback = 0x4001e3a6 ) ;
  PROVIDE ( tinfl_decompress_mem_to_heap = 0x4001e2d0 ) ;
  PROVIDE ( tinfl_decompress_mem_to_mem = 0x4001e34a ) ;
  PROVIDE ( tinytens = 0x400498a8 ) ;
  PROVIDE ( tlsf_add_pool = 0x400211fc ) ;
  PROVIDE ( tlsf_align_size = 0x40022336 ) ;
  PROVIDE ( tlsf_alloc_overhead = 0x40022318 ) ;
  PROVIDE ( tlsf_block_size = 0x40021084 ) ;
  PROVIDE ( tlsf_block_size_max = 0x400210b6 ) ;
  PROVIDE ( tlsf_block_size_min = 0x400210b2 ) ;
  PROVIDE ( tlsf_check = 0x40021104 ) ;
  PROVIDE ( tlsf_check_pool = 0x40021092 ) ;
  PROVIDE ( tlsf_create = 0x400210c0 ) ;
  PROVIDE ( tlsf_create_with_pool = 0x400212fe ) ;
  PROVIDE ( tlsf_free = 0x40021bfe ) ;
  PROVIDE ( tlsf_get_pool = 0x400210fe ) ;
  PROVIDE ( tlsf_malloc = 0x40021324 ) ;
  PROVIDE ( tlsf_memalign = 0x40021bf0 ) ;
  PROVIDE ( tlsf_memalign_offs = 0x40021724 ) ;
  PROVIDE ( tlsf_poison_check_pfunc_set = 0x40022326 ) ;
  PROVIDE ( tlsf_poison_fill_pfunc_set = 0x4002231c ) ;
  PROVIDE ( tlsf_pool_overhead = 0x400210bc ) ;
  PROVIDE ( tlsf_realloc = 0x40021f66 ) ;
  PROVIDE ( tlsf_remove_pool = 0x40021612 ) ;
  PROVIDE ( tlsf_size = 0x40022330 ) ;
  PROVIDE ( tlsf_walk_pool = 0x40021046 ) ;
  PROVIDE ( toascii = 0x40039d94 ) ;
  PROVIDE ( tolower = 0x40039d9a ) ;
  PROVIDE ( toupper = 0x40039db6 ) ;
  PROVIDE ( trcAmpduSetState = 0x40011962 ) ;
  PROVIDE ( trc_SetTxAmpduState = 0x40011982 ) ;
  PROVIDE ( trc_calc_duration = 0x40011c04 ) ;
  PROVIDE ( trc_ctl_ptr = 0x4087ff18 ) ;
  PROVIDE ( trc_isTxAmpduOperational = 0x4001106e ) ;
  PROVIDE ( trc_onAmpduOp = 0x40011988 ) ;
  PROVIDE ( trc_tid_isTxAmpduOperational = 0x4001107a ) ;
  PROVIDE ( tsens_code_read = 0x40007554 ) ;
  PROVIDE ( tsens_dac_cal = 0x400074be ) ;
  PROVIDE ( tsens_index_to_dac = 0x4000748a ) ;
  PROVIDE ( tsens_index_to_offset = 0x400074a4 ) ;
  PROVIDE ( tsens_power_up = 0x4000736c ) ;
  PROVIDE ( tsens_read_init = 0x4000737c ) ;
  PROVIDE ( tsens_temp_read = 0x40007560 ) ;
  PROVIDE ( tsf_hal_clear_mac_modem_rf_power_state = 0x400092e2 ) ;
  PROVIDE ( tsf_hal_clear_soc_wakeup_request = 0x400092fc ) ;
  PROVIDE ( tsf_hal_get_counter_value = 0x4000942c ) ;
  PROVIDE ( tsf_hal_get_mac_modem_rf_power_state = 0x400092f0 ) ;
  PROVIDE ( tsf_hal_get_tbtt_interval = 0x400098be ) ;
  PROVIDE ( tsf_hal_get_time = 0x4000948a ) ;
  PROVIDE ( tsf_hal_get_timer_target = 0x40009a16 ) ;
  PROVIDE ( tsf_hal_is_tsf_enabled = 0x4000926c ) ;
  PROVIDE ( tsf_hal_map_tbtt_target_to_rx_frame = 0x40009300 ) ;
  PROVIDE ( tsf_hal_map_tsf_to_bssid = 0x400093b8 ) ;
  PROVIDE ( tsf_hal_set_counter_value = 0x40009468 ) ;
  PROVIDE ( tsf_hal_set_modem_wakeup_early_time = 0x400092a8 ) ;
  PROVIDE ( tsf_hal_set_rx_beacon_abort_tsf_time_deviation_sync_disable = 0x400093a8 ) ;
  PROVIDE ( tsf_hal_set_rx_beacon_abort_tsf_time_deviation_sync_enable = 0x4000939a ) ;
  PROVIDE ( tsf_hal_set_rx_beacon_fail_tsf_time_deviation_sync_disable = 0x4000938a ) ;
  PROVIDE ( tsf_hal_set_rx_beacon_fail_tsf_time_deviation_sync_enable = 0x4000937a ) ;
  PROVIDE ( tsf_hal_set_rx_beacon_success_tsf_time_deviation_sync_disable = 0x40009368 ) ;
  PROVIDE ( tsf_hal_set_rx_beacon_success_tsf_time_deviation_sync_enable = 0x40009358 ) ;
  PROVIDE ( tsf_hal_set_tbtt_disable = 0x40009500 ) ;
  PROVIDE ( tsf_hal_set_tbtt_early_time = 0x40009800 ) ;
  PROVIDE ( tsf_hal_set_tbtt_enable = 0x400094a8 ) ;
  PROVIDE ( tsf_hal_set_tbtt_interval = 0x40009860 ) ;
  PROVIDE ( tsf_hal_set_tbtt_intr_disable = 0x40009586 ) ;
  PROVIDE ( tsf_hal_set_tbtt_intr_enable = 0x4000955a ) ;
  PROVIDE ( tsf_hal_set_tbtt_modem_wakeup_disable = 0x400096c0 ) ;
  PROVIDE ( tsf_hal_set_tbtt_modem_wakeup_enable = 0x40009668 ) ;
  PROVIDE ( tsf_hal_set_tbtt_rf_ctrl_disable = 0x40009772 ) ;
  PROVIDE ( tsf_hal_set_tbtt_rf_ctrl_enable = 0x4000971a ) ;
  PROVIDE ( tsf_hal_set_tbtt_rf_ctrl_wait_cycles = 0x400092bc ) ;
  PROVIDE ( tsf_hal_set_tbtt_soc_wakeup_disable = 0x4000960e ) ;
  PROVIDE ( tsf_hal_set_tbtt_soc_wakeup_enable = 0x400095b6 ) ;
  PROVIDE ( tsf_hal_set_tbtt_start_time = 0x400097cc ) ;
  PROVIDE ( tsf_hal_set_time = 0x400094a6 ) ;
  PROVIDE ( tsf_hal_set_timer_disable = 0x4000996c ) ;
  PROVIDE ( tsf_hal_set_timer_enable = 0x4000990c ) ;
  PROVIDE ( tsf_hal_set_timer_intr_disable = 0x40009a96 ) ;
  PROVIDE ( tsf_hal_set_timer_intr_enable = 0x40009a68 ) ;
  PROVIDE ( tsf_hal_set_timer_modem_wakeup_disable = 0x40009bea ) ;
  PROVIDE ( tsf_hal_set_timer_modem_wakeup_enable = 0x40009b8a ) ;
  PROVIDE ( tsf_hal_set_timer_rf_ctrl_disable = 0x40009cac ) ;
  PROVIDE ( tsf_hal_set_timer_rf_ctrl_enable = 0x40009c4c ) ;
  PROVIDE ( tsf_hal_set_timer_rf_ctrl_wait_cycles = 0x400092ce ) ;
  PROVIDE ( tsf_hal_set_timer_soc_wakeup_disable = 0x40009b28 ) ;
  PROVIDE ( tsf_hal_set_timer_soc_wakeup_enable = 0x40009ac8 ) ;
  PROVIDE ( tsf_hal_set_timer_target = 0x400099d4 ) ;
  PROVIDE ( tsf_hal_set_tsf_disable = 0x40009212 ) ;
  PROVIDE ( tsf_hal_set_tsf_enable = 0x400091ba ) ;
  PROVIDE ( tsf_hal_set_tsf_time_deviation = 0x40009322 ) ;
  PROVIDE ( tsf_hal_set_tsf_time_deviation_sync_disable = 0x40009346 ) ;
  PROVIDE ( tsf_hal_set_tsf_time_deviation_sync_enable = 0x40009336 ) ;
  PROVIDE ( tsf_hal_unmap_tbtt_target_to_rx_frame = 0x40009310 ) ;
  PROVIDE ( tx_cap_init = 0x40008254 ) ;
  PROVIDE ( tx_paon_set = 0x40004df4 ) ;
  PROVIDE ( tx_pwctrl_bg_init = 0x40004c64 ) ;
  PROVIDE ( tx_pwctrl_init = 0x4000866a ) ;
  PROVIDE ( tx_pwctrl_init_cal = 0x40008500 ) ;
  PROVIDE ( tx_state_set = 0x4000556a ) ;
  PROVIDE ( txbbgain_to_index = 0x400088ce ) ;
  PROVIDE ( txcal_work_mode = 0x400047d6 ) ;
  PROVIDE ( txdc_cal = 0x4000761e ) ;
  PROVIDE ( txdc_cal_init = 0x400078a0 ) ;
  PROVIDE ( txiq_cal_init = 0x40007fe8 ) ;
  PROVIDE ( txiq_cover = 0x40007a4c ) ;
  PROVIDE ( txiq_get_mis_pwr = 0x400079a4 ) ;
  PROVIDE ( txiq_set_reg = 0x400051ac ) ;
  PROVIDE ( txtone_linear_pwr = 0x40004994 ) ;
  PROVIDE ( uECC_point_mult_hardware = 0x40028c9a ) ;
  PROVIDE ( uECC_secp192r1 = 0x40028c86 ) ;
  PROVIDE ( uECC_secp256r1 = 0x40028c90 ) ;
  PROVIDE ( uECC_verify_hardware = 0x40028dba ) ;
  PROVIDE ( uECC_vli_add = 0x40028564 ) ;
  PROVIDE ( uECC_vli_clear = 0x400284b2 ) ;
  PROVIDE ( uECC_vli_cmp_unsafe = 0x40028510 ) ;
  PROVIDE ( uECC_vli_isZero = 0x400284ce ) ;
  PROVIDE ( uECC_vli_modInv = 0x400288d4 ) ;
  PROVIDE ( uECC_vli_modMult = 0x40028ae2 ) ;
  PROVIDE ( uECC_vli_modMult_fast = 0x40028c62 ) ;
  PROVIDE ( uECC_vli_modSub = 0x400285de ) ;
  PROVIDE ( uECC_vli_mult = 0x400289e4 ) ;
  PROVIDE ( uECC_vli_rshift1 = 0x40028544 ) ;
  PROVIDE ( uECC_vli_set = 0x400284f0 ) ;
  PROVIDE ( uECC_vli_sub = 0x4002859e ) ;
  PROVIDE ( uartAttach = 0x40022c76 ) ;
  PROVIDE ( uart_baudrate_detect = 0x40022cb0 ) ;
  PROVIDE ( uart_buff_switch = 0x40022f28 ) ;
  PROVIDE ( uart_div_modify = 0x40022cc6 ) ;
  PROVIDE ( uart_hal_clk_enable = 0x400294c2 ) ;
  PROVIDE ( uart_hal_clk_set_div = 0x4002950a ) ;
  PROVIDE ( uart_hal_clk_source_sel = 0x40029544 ) ;
  PROVIDE ( uart_hal_clr_intsts_mask = 0x40029330 ) ;
  PROVIDE ( uart_hal_core_rst = 0x400294c0 ) ;
  PROVIDE ( uart_hal_disable_autobaud = 0x4002938c ) ;
  PROVIDE ( uart_hal_disable_intr_mask = 0x4002934c ) ;
  PROVIDE ( uart_hal_enable_autobaud = 0x4002936e ) ;
  PROVIDE ( uart_hal_enable_glitch_filter = 0x400293be ) ;
  PROVIDE ( uart_hal_enable_intr_mask = 0x4002933c ) ;
  PROVIDE ( uart_hal_get_autobaud_sts = 0x400293ac ) ;
  PROVIDE ( uart_hal_get_fsm_status = 0x4002961a ) ;
  PROVIDE ( uart_hal_get_high_pulse_cnt = 0x40029408 ) ;
  PROVIDE ( uart_hal_get_intsts_mask = 0x40029360 ) ;
  PROVIDE ( uart_hal_get_low_pulse_cnt = 0x400293f6 ) ;
  PROVIDE ( uart_hal_get_rxd_edge_cnt = 0x400293e4 ) ;
  PROVIDE ( uart_hal_get_rxfifo_count = 0x400294b0 ) ;
  PROVIDE ( uart_hal_get_txfifo_count = 0x4002949e ) ;
  PROVIDE ( uart_hal_gpio_rx_config = 0x4002965c ) ;
  PROVIDE ( uart_hal_gpio_tx_config = 0x4002962a ) ;
  PROVIDE ( uart_hal_read_fifo = 0x4002960a ) ;
  PROVIDE ( uart_hal_rxfifo_rst = 0x4002944e ) ;
  PROVIDE ( uart_hal_set_data_bits_num = 0x400295c6 ) ;
  PROVIDE ( uart_hal_set_glitch_filter = 0x400293d0 ) ;
  PROVIDE ( uart_hal_set_parity = 0x40029584 ) ;
  PROVIDE ( uart_hal_set_rx_stop_err = 0x40029480 ) ;
  PROVIDE ( uart_hal_set_rxfifo_trigger = 0x400295e6 ) ;
  PROVIDE ( uart_hal_set_stop_bits_num = 0x400295a2 ) ;
  PROVIDE ( uart_hal_txfifo_rst = 0x4002941c ) ;
  PROVIDE ( uart_hal_write_fifo = 0x400295fe ) ;
  PROVIDE ( uart_ll_update = 0x40029310 ) ;
  PROVIDE ( uart_rx_buff.6526 = 0x4087e61c ) ;
  PROVIDE ( uart_rx_intr_handler = 0x40022e14 ) ;
  PROVIDE ( uart_rx_one_char = 0x40022df0 ) ;
  PROVIDE ( uart_rx_one_char_block = 0x40022dd0 ) ;
  PROVIDE ( uart_rx_readbuff = 0x40022edc ) ;
  PROVIDE ( uart_serial_baudrate_detect = 0x40022b20 ) ;
  PROVIDE ( uart_serial_config = 0x40022a36 ) ;
  PROVIDE ( uart_serial_div_modify = 0x40022b9e ) ;
  PROVIDE ( uart_serial_init = 0x40022962 ) ;
  PROVIDE ( uart_serial_intr_config = 0x40022a88 ) ;
  PROVIDE ( uart_serial_param_attach = 0x40022abc ) ;
  PROVIDE ( uart_serial_rx_intr_disable = 0x40022c46 ) ;
  PROVIDE ( uart_serial_rx_intr_enable = 0x40022c5e ) ;
  PROVIDE ( uart_serial_rx_isr_handler = 0x40022900 ) ;
  PROVIDE ( uart_serial_rx_one_char = 0x40022c24 ) ;
  PROVIDE ( uart_serial_rx_one_char_block = 0x40022c0c ) ;
  PROVIDE ( uart_serial_tx_flush = 0x40022be0 ) ;
  PROVIDE ( uart_serial_tx_idle = 0x40022bf2 ) ;
  PROVIDE ( uart_serial_tx_one_char = 0x40022bb8 ) ;
  PROVIDE ( uart_tx_flush = 0x40022d8a ) ;
  PROVIDE ( uart_tx_one_char = 0x40022cda ) ;
  PROVIDE ( uart_tx_one_char2 = 0x40022d20 ) ;
  PROVIDE ( uart_tx_one_char3 = 0x40022d62 ) ;
  PROVIDE ( uart_tx_send_queued_data = 0x40022da8 ) ;
  PROVIDE ( uart_tx_switch = 0x40022ca4 ) ;
  PROVIDE ( uart_tx_wait_idle = 0x40022dbc ) ;
  PROVIDE ( und_ov_flow = 0x4002f9fe ) ;
  PROVIDE ( und_ov_flow = 0x4002fb9a ) ;
  PROVIDE ( undflow = 0x4002f58c ) ;
  PROVIDE ( undflow = 0x4002f60a ) ;
  PROVIDE ( undflow = 0x4002f728 ) ;
  PROVIDE ( undflow = 0x4002fce2 ) ;
  PROVIDE ( undflow = 0x400300be ) ;
  PROVIDE ( undflow = 0x400301d8 ) ;
  PROVIDE ( undflow = 0x40030226 ) ;
  PROVIDE ( undflow = 0x40030302 ) ;
  PROVIDE ( ungetc = 0x40039fde ) ;
  PROVIDE ( unpackloop = 0x40001794 ) ;
  PROVIDE ( usb_serial_device_print_is_enabled = 0x400228f0 ) ;
  PROVIDE ( usb_serial_device_rx_one_char = 0x400228d8 ) ;
  PROVIDE ( usb_serial_device_rx_one_char_block = 0x400228c6 ) ;
  PROVIDE ( usb_serial_device_tx_flush = 0x400228bc ) ;
  PROVIDE ( usb_serial_device_tx_one_char = 0x40022856 ) ;
  PROVIDE ( usb_uart_connected = 0x4087f564 ) ;
  PROVIDE ( user_code_start = 0x4087ee1c ) ;
  PROVIDE ( utoa = 0x4003a08c ) ;
  PROVIDE ( vfiprintf = 0x4003b9d2 ) ;
  PROVIDE ( vfprintf = 0x4003e1ae ) ;
  PROVIDE ( vht_max_apep_length = 0x40049ef0 ) ;
  PROVIDE ( viprintf = 0x4003e26e ) ;
  PROVIDE ( vli_mmod_fast_secp192r1 = 0x40028606 ) ;
  PROVIDE ( vli_mmod_fast_secp256r1 = 0x400286ac ) ;
  PROVIDE ( vli_modInv_update = 0x40028894 ) ;
  PROVIDE ( vsniprintf = 0x4003e38e ) ;
  PROVIDE ( wDevCheckBlockError = 0x40012602 ) ;
  PROVIDE ( wDevCtrl_ptr = 0x4087ff68 ) ;
  PROVIDE ( wDevMacSleep_ptr = 0x4087ff64 ) ;
  PROVIDE ( wDev_AppendRxBlocks = 0x4001253c ) ;
  PROVIDE ( wDev_DiscardFrame = 0x4001269a ) ;
  PROVIDE ( wDev_GetNoiseFloor = 0x400124e8 ) ;
  PROVIDE ( wDev_IndicateAmpdu = 0x40012c32 ) ;
  PROVIDE ( wDev_IndicateFrame = 0x4001298e ) ;
  PROVIDE ( wDev_ProcessFiq = 0x4001237c ) ;
  PROVIDE ( wDev_ProcessRxSucData = 0x40012c48 ) ;
  PROVIDE ( wait_rfpll_cal_end = 0x40005984 ) ;
  PROVIDE ( wdevProcessRxSucDataAll = 0x40013030 ) ;
  PROVIDE ( wdev_csi_len_align = 0x4001297c ) ;
  PROVIDE ( wdev_is_data_in_rxlist = 0x400128d4 ) ;
  PROVIDE ( wdev_mac_reg_load = 0x400126c0 ) ;
  PROVIDE ( wdev_mac_reg_store = 0x4001279c ) ;
  PROVIDE ( wdev_mac_sleep = 0x40012906 ) ;
  PROVIDE ( wdev_mac_special_reg_load = 0x40012876 ) ;
  PROVIDE ( wdev_mac_special_reg_store = 0x4001288c ) ;
  PROVIDE ( wdev_mac_wakeup = 0x400128ac ) ;
  PROVIDE ( wdt_hal_config_stage = 0x40020dc4 ) ;
  PROVIDE ( wdt_hal_deinit = 0x40020d62 ) ;
  PROVIDE ( wdt_hal_disable = 0x40020f14 ) ;
  PROVIDE ( wdt_hal_enable = 0x40020eec ) ;
  PROVIDE ( wdt_hal_feed = 0x40020f58 ) ;
  PROVIDE ( wdt_hal_handle_intr = 0x40020f32 ) ;
  PROVIDE ( wdt_hal_init = 0x40020bd6 ) ;
  PROVIDE ( wdt_hal_is_enabled = 0x40020fa2 ) ;
  PROVIDE ( wdt_hal_set_flashboot_en = 0x40020f70 ) ;
  PROVIDE ( wdt_hal_write_protect_disable = 0x40020ec4 ) ;
  PROVIDE ( wdt_hal_write_protect_enable = 0x40020eda ) ;
  PROVIDE ( wifi_11g_rate_chg = 0x400089ce ) ;
  PROVIDE ( wifi_agc_sat_gain = 0x4000541c ) ;
  PROVIDE ( wifi_fbw_sel = 0x400054a8 ) ;
  PROVIDE ( wifi_get_macaddr = 0x40015538 ) ;
  PROVIDE ( wifi_get_target_power = 0x40008df6 ) ;
  PROVIDE ( wifi_get_tx_gain = 0x40008cee ) ;
  PROVIDE ( wifi_is_started = 0x40015012 ) ;
  PROVIDE ( wifi_rf_phy_disable = 0x40016afc ) ;
  PROVIDE ( wifi_rf_phy_enable = 0x40016a68 ) ;
  PROVIDE ( wifi_rifs_mode_en = 0x4000573e ) ;
  PROVIDE ( wifi_sta_rx_probe_req = 0x4087fedc ) ;
  PROVIDE ( wr_rf_freq_mem = 0x400037de ) ;
  PROVIDE ( write_chan_freq = 0x4000369c ) ;
  PROVIDE ( write_gain_mem = 0x40004d64 ) ;
  PROVIDE ( write_pll_cap = 0x40005a44 ) ;
  PROVIDE ( write_rfpll_sdm = 0x400058ee ) ;
  PROVIDE ( xor_end = 0x4002fd4c ) ;
  PROVIDE ( xor_end = 0x40030484 ) ;
  PROVIDE ( xphyQueue = 0x4087ff30 ) ;
  PROVIDE ( zero = 0x4002f64a ) ;
  PROVIDE ( zero = 0x4002f82e ) ;
  PROVIDE ( zero = 0x4002fa7c ) ;
  PROVIDE ( zero = 0x4002fc52 ) ;
  PROVIDE ( zero_den = 0x4002f8a8 ) ;
  PROVIDE ( zero_denormal = 0x4002fa6a ) ;
  PROVIDE ( zero_denormal = 0x4002fc34 ) ;
  PROVIDE ( zero_operand = 0x4002ffca ) ;
  PROVIDE ( zero_operand_return = 0x4002ffd4 ) ;
  PROVIDE ( zeroes.5057 = 0x40048ae4 ) ;
  PROVIDE ( zeroes.5061 = 0x40049200 ) ;
  PROVIDE ( zeroes.5078 = 0x40048dc4 ) ;
  PROVIDE ( zeroes.5093 = 0x400494bc ) ;
}
