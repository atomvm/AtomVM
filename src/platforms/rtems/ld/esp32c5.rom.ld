/*
 * SPDX-FileCopyrightText: 2026 Espressif Systems (Shanghai) CO LTD
 * SPDX-FileCopyrightText: 2026 Peter M. <petermm@gmail.com>
 *
 * SPDX-License-Identifier: Apache-2.0 OR BSD-2-Clause
 */
SECTIONS {
  /* Compatibility callbacks referenced by newer libpp even in ECO2 builds.
   * These are data slots, not calls into ECO3-only ROM functions. */
  PROVIDE ( s_offchan_tx_progress_in_ptr = 0x4085fc5c ) ;
  PROVIDE ( s_phy_get_max_pwr_new_ptr = 0x4085fc58 ) ;
  PROVIDE ( .data_bss_ok = 0x4000174c ) ;
  PROVIDE ( .data_ok = 0x40001722 ) ;
  PROVIDE ( .stack_ok = 0x400016ea ) ;
  PROVIDE ( CSWTCH.121 = 0x4004a2d0 ) ;
  PROVIDE ( CSWTCH.167 = 0x4004db38 ) ;
  PROVIDE ( CSWTCH.168 = 0x4004db38 ) ;
  PROVIDE ( CSWTCH.169 = 0x4004db38 ) ;
  PROVIDE ( CSWTCH.25 = 0x4004b9e8 ) ;
  PROVIDE ( Cache_Address_Through_Cache = 0x4002c590 ) ;
  PROVIDE ( Cache_Clean_Addr = 0x4002c842 ) ;
  PROVIDE ( Cache_Clean_All = 0x4002c894 ) ;
  PROVIDE ( Cache_Config_Autoload = 0x4002c980 ) ;
  PROVIDE ( Cache_Count_Flash_Pages = 0x4002d3c0 ) ;
  PROVIDE ( Cache_Disable_Autoload = 0x4002ca5c ) ;
  PROVIDE ( Cache_Disable_Cache = 0x4002cc48 ) ;
  PROVIDE ( Cache_Disable_PreLock = 0x4002cb4a ) ;
  PROVIDE ( Cache_Enable_Autoload = 0x4002ca4a ) ;
  PROVIDE ( Cache_Enable_Cache = 0x4002cc96 ) ;
  PROVIDE ( Cache_Enable_PreLock = 0x4002ca90 ) ;
  PROVIDE ( Cache_End_Preload = 0x4002c96c ) ;
  PROVIDE ( Cache_Flash_To_SPIRAM_Copy = 0x4002d404 ) ;
  PROVIDE ( Cache_Freeze_Disable = 0x4002c702 ) ;
  PROVIDE ( Cache_Freeze_Enable = 0x4002c6ca ) ;
  PROVIDE ( Cache_Get_DROM_MMU_End = 0x4002d0b0 ) ;
  PROVIDE ( Cache_Get_IROM_MMU_End = 0x4002d0a6 ) ;
  PROVIDE ( Cache_Get_Line_Size = 0x4002c554 ) ;
  PROVIDE ( Cache_Get_Mode = 0x4002c566 ) ;
  PROVIDE ( Cache_Get_Virtual_Addr = 0x4002d38a ) ;
  PROVIDE ( Cache_Invalidate_Addr = 0x4002c830 ) ;
  PROVIDE ( Cache_Invalidate_All = 0x4002c878 ) ;
  PROVIDE ( Cache_Invalidate_ICache_All = 0x4002c878 ) ;
  PROVIDE ( Cache_Lock_Addr = 0x4002cb80 ) ;
  PROVIDE ( Cache_Lock_Items = 0x4002c694 ) ;
  PROVIDE ( Cache_MMU_Init = 0x4002d0c4 ) ;
  PROVIDE ( Cache_MSPI_MMU_Set = 0x4002d0f8 ) ;
  PROVIDE ( Cache_MSPI_MMU_Set_Readback = 0x4002cd20 ) ;
  PROVIDE ( Cache_MSPI_MMU_Set_Secure = 0x4002d12c ) ;
  PROVIDE ( Cache_Mask_All = 0x4002c8e8 ) ;
  PROVIDE ( Cache_Op_Addr = 0x4002c720 ) ;
  PROVIDE ( Cache_Preload_Done = 0x4002c960 ) ;
  PROVIDE ( Cache_Resume_Autoload = 0x4002c79c ) ;
  PROVIDE ( Cache_Resume_Cache = 0x4002cc96 ) ;
  PROVIDE ( Cache_Set_IDROM_MMU_Info = 0x4002d074 ) ;
  PROVIDE ( Cache_Set_IDROM_MMU_Size = 0x4002cf68 ) ;
  PROVIDE ( Cache_Start_Preload = 0x4002c902 ) ;
  PROVIDE ( Cache_Suspend_Autoload = 0x4002c670 ) ;
  PROVIDE ( Cache_Suspend_Cache = 0x4002ccac ) ;
  PROVIDE ( Cache_Sync_Addr = 0x4002c7b0 ) ;
  PROVIDE ( Cache_Sync_Items = 0x4002c634 ) ;
  PROVIDE ( Cache_Travel_Tag_Memory = 0x4002d2f6 ) ;
  PROVIDE ( Cache_UnMask_Dram0 = 0x4002c8f6 ) ;
  PROVIDE ( Cache_Unlock_Addr = 0x4002cbe4 ) ;
  PROVIDE ( Cache_WriteBack_Addr = 0x4002c854 ) ;
  PROVIDE ( Cache_WriteBack_All = 0x4002c8b0 ) ;
  PROVIDE ( Cache_WriteBack_Invalidate_Addr = 0x4002c866 ) ;
  PROVIDE ( Cache_WriteBack_Invalidate_All = 0x4002c8cc ) ;
  PROVIDE ( Clip8 = 0x4004d3e0 ) ;
  PROVIDE ( Disable_QMode = 0x400293bc ) ;
  PROVIDE ( EFUSE = 0x600b4800 ) ;
  PROVIDE ( Enable_QMode = 0x4002936c ) ;
  PROVIDE ( FilePacketSendDeflatedReqMsgProc = 0x400283e6 ) ;
  PROVIDE ( FilePacketSendReqMsgProc = 0x40028030 ) ;
  PROVIDE ( FlashDwnLdDeflatedStartMsgProc = 0x40028380 ) ;
  PROVIDE ( FlashDwnLdParamCfgMsgProc = 0x40028134 ) ;
  PROVIDE ( FlashDwnLdStartMsgProc = 0x40027fc0 ) ;
  PROVIDE ( FlashDwnLdStopDeflatedReqMsgProc = 0x400284ec ) ;
  PROVIDE ( FlashDwnLdStopReqMsgProc = 0x400280fa ) ;
  PROVIDE ( GetAccess = 0x40011296 ) ;
  PROVIDE ( GetSecurityInfoProc = 0x400285e0 ) ;
  PROVIDE ( GetUartDevice = 0x40026590 ) ;
  PROVIDE ( Ipsf = 0x4004d7e0 ) ;
  PROVIDE ( LP_WDT = 0x600b1c00 ) ;
  PROVIDE ( MD5Final = 0x40022000 ) ;
  PROVIDE ( MD5Init = 0x40021f06 ) ;
  PROVIDE ( MD5Transform = 0x400215fe ) ;
  PROVIDE ( MD5Update = 0x40021f38 ) ;
  PROVIDE ( MemDwnLdStartMsgProc = 0x40028160 ) ;
  PROVIDE ( MemDwnLdStopReqMsgProc = 0x40028218 ) ;
  PROVIDE ( MemPacketSendReqMsgProc = 0x40028198 ) ;
  PROVIDE ( PCR = 0x60096000 ) ;
  PROVIDE ( RC_GetBlockAckTime = 0x4000ce14 ) ;
  PROVIDE ( ROM_Boot_Cache_Init = 0x4002c5b2 ) ;
  PROVIDE ( ROM_Direct_Boot_Cache_Init = 0x4002c5ee ) ;
  PROVIDE ( ROM_Direct_Boot_MMU_Init = 0x4002c60a ) ;
  PROVIDE ( RcvMsg = 0x40026532 ) ;
  PROVIDE ( SPIEraseArea = 0x40029d3e ) ;
  PROVIDE ( SPILock = 0x400297c6 ) ;
  PROVIDE ( SPIMEM0 = 0x60002000 ) ;
  PROVIDE ( SPIMEM1 = 0x60003000 ) ;
  PROVIDE ( SPIMasterReadModeCnfig = 0x400298c2 ) ;
  PROVIDE ( SPI_Common_Command = 0x40028fd6 ) ;
  PROVIDE ( SPI_WakeUp = 0x40028e4a ) ;
  PROVIDE ( SPI_block_erase = 0x40028f20 ) ;
  PROVIDE ( SPI_chip_erase = 0x40028ea0 ) ;
  PROVIDE ( SPI_init = 0x4002959a ) ;
  PROVIDE ( SPI_page_program = 0x4002922a ) ;
  PROVIDE ( SPI_read_data = 0x40028c98 ) ;
  PROVIDE ( SPI_sector_erase = 0x40028ed8 ) ;
  PROVIDE ( SPI_write_enable = 0x4002920e ) ;
  PROVIDE ( SYSTIMER = 0x6000a000 ) ;
  PROVIDE ( SelectSpiFunction = 0x40028c00 ) ;
  PROVIDE ( SendMsg = 0x40026320 ) ;
  PROVIDE ( SetSpiDrvs = 0x40028b08 ) ;
  PROVIDE ( TIMERG0 = 0x60008000 ) ;
  PROVIDE ( TIMERG1 = 0x60009000 ) ;
  PROVIDE ( TRC_AMPDU_PER_DOWN_THRESHOLD = 0x400150d0 ) ;
  PROVIDE ( TRC_AMPDU_PER_UP_THRESHOLD = 0x400154c2 ) ;
  PROVIDE ( TRC_PER_IS_GOOD = 0x400147b2 ) ;
  PROVIDE ( UartConnCheck = 0x40027eec ) ;
  PROVIDE ( UartConnectProc = 0x4002823e ) ;
  PROVIDE ( UartDev = 0x4085f4fc ) ;
  PROVIDE ( UartDwnLdProc = 0x400286f6 ) ;
  PROVIDE ( UartGetCmdLn = 0x40026542 ) ;
  PROVIDE ( UartRegReadProc = 0x400282bc ) ;
  PROVIDE ( UartRegWriteProc = 0x4002824a ) ;
  PROVIDE ( UartRxString = 0x40026272 ) ;
  PROVIDE ( UartSecureDwnLdProc = 0x40027c96 ) ;
  PROVIDE ( UartSetBaudProc = 0x40028346 ) ;
  PROVIDE ( UartSpiAttachProc = 0x400282fc ) ;
  PROVIDE ( UartSpiReadProc = 0x40028318 ) ;
  PROVIDE ( Uart_Init = 0x400260d4 ) ;
  PROVIDE ( VerifyFlashMd5Proc = 0x4002851e ) ;
  PROVIDE ( Wait_SPI_Idle = 0x40028e80 ) ;
  PROVIDE ( Zig = 0x4004d860 ) ;
  PROVIDE ( _SPIEraseArea = 0x40029c96 ) ;
  PROVIDE ( _SPI_write_enable = 0x400291c8 ) ;
  PROVIDE ( __GNU_EH_FRAME_HDR = 0x00000000 ) ;
  PROVIDE ( __absvdi2 = 0x40031036 ) ;
  PROVIDE ( __absvsi2 = 0x40031020 ) ;
  PROVIDE ( __adddf3 = 0x400338b6 ) ;
  PROVIDE ( __addsf3 = 0x400355b6 ) ;
  PROVIDE ( __addvdi3 = 0x40031074 ) ;
  PROVIDE ( __addvsi3 = 0x40031056 ) ;
  PROVIDE ( __ashldi3 = 0x40030f90 ) ;
  PROVIDE ( __ashrdi3 = 0x40030fba ) ;
  PROVIDE ( __assert_func = 0x40026cbe ) ;
  PROVIDE ( __bswapdi2 = 0x400325d0 ) ;
  PROVIDE ( __bswapsi2 = 0x400325ac ) ;
  PROVIDE ( __call_Cache_Address_Through_Cache = 0x40000640 ) ;
  PROVIDE ( __call_Cache_Clean_Addr = 0x40000654 ) ;
  PROVIDE ( __call_Cache_Clean_All = 0x40000664 ) ;
  PROVIDE ( __call_Cache_Config_Autoload = 0x4000068c ) ;
  PROVIDE ( __call_Cache_Count_Flash_Pages = 0x400006dc ) ;
  PROVIDE ( __call_Cache_Disable_Autoload = 0x40000694 ) ;
  PROVIDE ( __call_Cache_Disable_Cache = 0x400006ac ) ;
  PROVIDE ( __call_Cache_Disable_PreLock = 0x4000069c ) ;
  PROVIDE ( __call_Cache_Enable_Autoload = 0x40000690 ) ;
  PROVIDE ( __call_Cache_Enable_Cache = 0x400006b0 ) ;
  PROVIDE ( __call_Cache_Enable_PreLock = 0x40000698 ) ;
  PROVIDE ( __call_Cache_End_Preload = 0x40000688 ) ;
  PROVIDE ( __call_Cache_Flash_To_SPIRAM_Copy = 0x400006fc ) ;
  PROVIDE ( __call_Cache_Freeze_Disable = 0x400006c0 ) ;
  PROVIDE ( __call_Cache_Freeze_Enable = 0x400006bc ) ;
  PROVIDE ( __call_Cache_Get_DROM_MMU_End = 0x400006cc ) ;
  PROVIDE ( __call_Cache_Get_IROM_MMU_End = 0x400006c8 ) ;
  PROVIDE ( __call_Cache_Get_Line_Size = 0x40000638 ) ;
  PROVIDE ( __call_Cache_Get_Mode = 0x4000063c ) ;
  PROVIDE ( __call_Cache_Get_Virtual_Addr = 0x400006e4 ) ;
  PROVIDE ( __call_Cache_Invalidate_Addr = 0x40000650 ) ;
  PROVIDE ( __call_Cache_Invalidate_All = 0x40000660 ) ;
  PROVIDE ( __call_Cache_Lock_Addr = 0x400006a4 ) ;
  PROVIDE ( __call_Cache_Lock_Items = 0x400006a0 ) ;
  PROVIDE ( __call_Cache_MMU_Init = 0x400006d0 ) ;
  PROVIDE ( __call_Cache_MSPI_MMU_Set = 0x400006d4 ) ;
  PROVIDE ( __call_Cache_MSPI_MMU_Set_Secure = 0x400006d8 ) ;
  PROVIDE ( __call_Cache_Mask_All = 0x40000670 ) ;
  PROVIDE ( __call_Cache_Op_Addr = 0x4000064c ) ;
  PROVIDE ( __call_Cache_Preload_Done = 0x40000684 ) ;
  PROVIDE ( __call_Cache_Resume_Autoload = 0x4000067c ) ;
  PROVIDE ( __call_Cache_Resume_Cache = 0x400006b8 ) ;
  PROVIDE ( __call_Cache_Set_IDROM_MMU_Info = 0x400006f8 ) ;
  PROVIDE ( __call_Cache_Set_IDROM_MMU_Size = 0x400006c4 ) ;
  PROVIDE ( __call_Cache_Start_Preload = 0x40000680 ) ;
  PROVIDE ( __call_Cache_Suspend_Autoload = 0x40000678 ) ;
  PROVIDE ( __call_Cache_Suspend_Cache = 0x400006b4 ) ;
  PROVIDE ( __call_Cache_Sync_Items = 0x40000648 ) ;
  PROVIDE ( __call_Cache_Travel_Tag_Memory = 0x400006e0 ) ;
  PROVIDE ( __call_Cache_UnMask_Dram0 = 0x40000674 ) ;
  PROVIDE ( __call_Cache_Unlock_Addr = 0x400006a8 ) ;
  PROVIDE ( __call_Cache_WriteBack_Addr = 0x40000658 ) ;
  PROVIDE ( __call_Cache_WriteBack_All = 0x40000668 ) ;
  PROVIDE ( __call_Cache_WriteBack_Invalidate_Addr = 0x4000065c ) ;
  PROVIDE ( __call_Cache_WriteBack_Invalidate_All = 0x4000066c ) ;
  PROVIDE ( __call_Disable_QMode = 0x400001e8 ) ;
  PROVIDE ( __call_Enable_QMode = 0x400001ec ) ;
  PROVIDE ( __call_GetAccess = 0x40000c00 ) ;
  PROVIDE ( __call_GetSecurityInfoProc = 0x400000c0 ) ;
  PROVIDE ( __call_GetUartDevice = 0x400000b8 ) ;
  PROVIDE ( __call_MD5Final = 0x400007a0 ) ;
  PROVIDE ( __call_MD5Init = 0x40000798 ) ;
  PROVIDE ( __call_MD5Update = 0x4000079c ) ;
  PROVIDE ( __call_RC_GetBlockAckTime = 0x40000bec ) ;
  PROVIDE ( __call_ROM_Boot_Cache_Init = 0x40000644 ) ;
  PROVIDE ( __call_SPIEraseArea = 0x40000168 ) ;
  PROVIDE ( __call_SPILock = 0x400001b0 ) ;
  PROVIDE ( __call_SPIMasterReadModeCnfig = 0x400001b4 ) ;
  PROVIDE ( __call_SPI_Common_Command = 0x400001b8 ) ;
  PROVIDE ( __call_SPI_WakeUp = 0x400001bc ) ;
  PROVIDE ( __call_SPI_block_erase = 0x400001c0 ) ;
  PROVIDE ( __call_SPI_chip_erase = 0x400001c4 ) ;
  PROVIDE ( __call_SPI_init = 0x400001c8 ) ;
  PROVIDE ( __call_SPI_page_program = 0x400001cc ) ;
  PROVIDE ( __call_SPI_read_data = 0x400001d0 ) ;
  PROVIDE ( __call_SPI_sector_erase = 0x400001d4 ) ;
  PROVIDE ( __call_SPI_write_enable = 0x4000016c ) ;
  PROVIDE ( __call_SelectSpiFunction = 0x400001d8 ) ;
  PROVIDE ( __call_SetSpiDrvs = 0x400001dc ) ;
  PROVIDE ( __call_TRC_AMPDU_PER_DOWN_THRESHOLD = 0x40000f80 ) ;
  PROVIDE ( __call_TRC_AMPDU_PER_UP_THRESHOLD = 0x40000f84 ) ;
  PROVIDE ( __call_TRC_PER_IS_GOOD = 0x40000f88 ) ;
  PROVIDE ( __call_UartDwnLdProc = 0x400000bc ) ;
  PROVIDE ( __call_UartGetCmdLn = 0x40000050 ) ;
  PROVIDE ( __call_UartRxString = 0x4000004c ) ;
  PROVIDE ( __call_Uart_Init = 0x400000c4 ) ;
  PROVIDE ( __call_Wait_SPI_Idle = 0x400001e0 ) ;
  PROVIDE ( __call__SPIEraseArea = 0x4000014c ) ;
  PROVIDE ( __call__SPI_write_enable = 0x40000150 ) ;
  PROVIDE ( __call___absvdi2 = 0x40000900 ) ;
  PROVIDE ( __call___absvsi2 = 0x40000904 ) ;
  PROVIDE ( __call___adddf3 = 0x40000908 ) ;
  PROVIDE ( __call___addsf3 = 0x400008bc ) ;
  PROVIDE ( __call___addvdi3 = 0x4000090c ) ;
  PROVIDE ( __call___addvsi3 = 0x40000910 ) ;
  PROVIDE ( __call___ashldi3 = 0x40000914 ) ;
  PROVIDE ( __call___ashrdi3 = 0x40000918 ) ;
  PROVIDE ( __call___bswapdi2 = 0x4000091c ) ;
  PROVIDE ( __call___bswapsi2 = 0x40000920 ) ;
  PROVIDE ( __call___clear_cache = 0x40000924 ) ;
  PROVIDE ( __call___clrsbdi2 = 0x40000928 ) ;
  PROVIDE ( __call___clrsbsi2 = 0x4000092c ) ;
  PROVIDE ( __call___clzdi2 = 0x40000930 ) ;
  PROVIDE ( __call___clzsi2 = 0x40000934 ) ;
  PROVIDE ( __call___cmpdi2 = 0x40000938 ) ;
  PROVIDE ( __call___ctzdi2 = 0x4000093c ) ;
  PROVIDE ( __call___ctzsi2 = 0x40000940 ) ;
  PROVIDE ( __call___divdc3 = 0x40000944 ) ;
  PROVIDE ( __call___divdf3 = 0x40000948 ) ;
  PROVIDE ( __call___divdi3 = 0x4000094c ) ;
  PROVIDE ( __call___divsc3 = 0x40000950 ) ;
  PROVIDE ( __call___divsf3 = 0x400008c0 ) ;
  PROVIDE ( __call___divsi3 = 0x40000954 ) ;
  PROVIDE ( __call___eqdf2 = 0x40000958 ) ;
  PROVIDE ( __call___eqsf2 = 0x400008c4 ) ;
  PROVIDE ( __call___extenddftf2 = 0x40000a24 ) ;
  PROVIDE ( __call___extendsfdf2 = 0x4000095c ) ;
  PROVIDE ( __call___ffsdi2 = 0x40000960 ) ;
  PROVIDE ( __call___ffssi2 = 0x40000964 ) ;
  PROVIDE ( __call___fixdfdi = 0x40000968 ) ;
  PROVIDE ( __call___fixdfsi = 0x4000096c ) ;
  PROVIDE ( __call___fixsfdi = 0x40000970 ) ;
  PROVIDE ( __call___fixsfsi = 0x400008c8 ) ;
  PROVIDE ( __call___fixunsdfsi = 0x40000974 ) ;
  PROVIDE ( __call___fixunssfdi = 0x40000978 ) ;
  PROVIDE ( __call___fixunssfsi = 0x4000097c ) ;
  PROVIDE ( __call___floatdidf = 0x40000980 ) ;
  PROVIDE ( __call___floatdisf = 0x40000984 ) ;
  PROVIDE ( __call___floatsidf = 0x40000988 ) ;
  PROVIDE ( __call___floatsisf = 0x400008cc ) ;
  PROVIDE ( __call___floatundidf = 0x4000098c ) ;
  PROVIDE ( __call___floatundisf = 0x40000990 ) ;
  PROVIDE ( __call___floatunsidf = 0x40000994 ) ;
  PROVIDE ( __call___floatunsisf = 0x400008d0 ) ;
  PROVIDE ( __call___gcc_bcmp = 0x40000998 ) ;
  PROVIDE ( __call___gedf2 = 0x4000099c ) ;
  PROVIDE ( __call___gesf2 = 0x400008d4 ) ;
  PROVIDE ( __call___gtdf2 = 0x400009a0 ) ;
  PROVIDE ( __call___gtsf2 = 0x400008d8 ) ;
  PROVIDE ( __call___ledf2 = 0x400009a4 ) ;
  PROVIDE ( __call___lesf2 = 0x400008dc ) ;
  PROVIDE ( __call___lshrdi3 = 0x400009a8 ) ;
  PROVIDE ( __call___ltdf2 = 0x400009ac ) ;
  PROVIDE ( __call___ltsf2 = 0x400008e0 ) ;
  PROVIDE ( __call___moddi3 = 0x400009b0 ) ;
  PROVIDE ( __call___modsi3 = 0x400009b4 ) ;
  PROVIDE ( __call___muldc3 = 0x400009b8 ) ;
  PROVIDE ( __call___muldf3 = 0x400009bc ) ;
  PROVIDE ( __call___muldi3 = 0x400009c0 ) ;
  PROVIDE ( __call___mulsc3 = 0x400009c4 ) ;
  PROVIDE ( __call___mulsf3 = 0x400008e4 ) ;
  PROVIDE ( __call___mulsi3 = 0x400009c8 ) ;
  PROVIDE ( __call___mulvdi3 = 0x400009cc ) ;
  PROVIDE ( __call___mulvsi3 = 0x400009d0 ) ;
  PROVIDE ( __call___nedf2 = 0x400009d4 ) ;
  PROVIDE ( __call___negdf2 = 0x400009d8 ) ;
  PROVIDE ( __call___negdi2 = 0x400009dc ) ;
  PROVIDE ( __call___negsf2 = 0x400008e8 ) ;
  PROVIDE ( __call___negvdi2 = 0x400009e0 ) ;
  PROVIDE ( __call___negvsi2 = 0x400009e4 ) ;
  PROVIDE ( __call___nesf2 = 0x400008ec ) ;
  PROVIDE ( __call___paritysi2 = 0x400009e8 ) ;
  PROVIDE ( __call___popcountdi2 = 0x400009ec ) ;
  PROVIDE ( __call___popcountsi2 = 0x400009f0 ) ;
  PROVIDE ( __call___powidf2 = 0x400009f4 ) ;
  PROVIDE ( __call___powisf2 = 0x400008f0 ) ;
  PROVIDE ( __call___smakebuf_r = 0x400005d0 ) ;
  PROVIDE ( __call___sprint_r = 0x400005e4 ) ;
  PROVIDE ( __call___subdf3 = 0x400009f8 ) ;
  PROVIDE ( __call___subsf3 = 0x400008f4 ) ;
  PROVIDE ( __call___subvdi3 = 0x400009fc ) ;
  PROVIDE ( __call___subvsi3 = 0x40000a00 ) ;
  PROVIDE ( __call___swbuf = 0x400005dc ) ;
  PROVIDE ( __call___swbuf_r = 0x400005d8 ) ;
  PROVIDE ( __call___swhatbuf_r = 0x400005d4 ) ;
  PROVIDE ( __call___swsetup_r = 0x400005e0 ) ;
  PROVIDE ( __call___truncdfsf2 = 0x400008f8 ) ;
  PROVIDE ( __call___trunctfdf2 = 0x40000a28 ) ;
  PROVIDE ( __call___ucmpdi2 = 0x40000a04 ) ;
  PROVIDE ( __call___udiv_w_sdiv = 0x40000a14 ) ;
  PROVIDE ( __call___udivdi3 = 0x40000a08 ) ;
  PROVIDE ( __call___udivmoddi4 = 0x40000a0c ) ;
  PROVIDE ( __call___udivsi3 = 0x40000a10 ) ;
  PROVIDE ( __call___umoddi3 = 0x40000a18 ) ;
  PROVIDE ( __call___umodsi3 = 0x40000a1c ) ;
  PROVIDE ( __call___unorddf2 = 0x40000a20 ) ;
  PROVIDE ( __call___unordsf2 = 0x400008fc ) ;
  PROVIDE ( __call__esp_rom_spiflash_erase_block = 0x4000013c ) ;
  PROVIDE ( __call__esp_rom_spiflash_erase_sector = 0x40000138 ) ;
  PROVIDE ( __call__esp_rom_spiflash_read = 0x40000144 ) ;
  PROVIDE ( __call__esp_rom_spiflash_unlock = 0x40000148 ) ;
  PROVIDE ( __call__esp_rom_spiflash_write = 0x40000140 ) ;
  PROVIDE ( __call__fflush_r = 0x400005c4 ) ;
  PROVIDE ( __call__fiprintf_r = 0x400005e8 ) ;
  PROVIDE ( __call__fprintf_r = 0x400005ec ) ;
  PROVIDE ( __call__fwalk = 0x400005c8 ) ;
  PROVIDE ( __call__fwalk_reent = 0x400005cc ) ;
  PROVIDE ( __call__isatty_r = 0x400004e4 ) ;
  PROVIDE ( __call__printf_common = 0x40000630 ) ;
  PROVIDE ( __call__printf_i = 0x40000634 ) ;
  PROVIDE ( __call__rvfp__adddf3 = 0x40000a70 ) ;
  PROVIDE ( __call__rvfp__addsf3 = 0x40000a2c ) ;
  PROVIDE ( __call__rvfp__eqdf2 = 0x40000a74 ) ;
  PROVIDE ( __call__rvfp__eqsf2 = 0x40000a30 ) ;
  PROVIDE ( __call__rvfp__extendsfdf2 = 0x40000a34 ) ;
  PROVIDE ( __call__rvfp__fixdfdi = 0x40000a78 ) ;
  PROVIDE ( __call__rvfp__fixdfsi = 0x40000a7c ) ;
  PROVIDE ( __call__rvfp__fixsfdi = 0x40000a80 ) ;
  PROVIDE ( __call__rvfp__fixsfsi = 0x40000a38 ) ;
  PROVIDE ( __call__rvfp__fixunsdfsi = 0x40000a84 ) ;
  PROVIDE ( __call__rvfp__fixunssfdi = 0x40000a88 ) ;
  PROVIDE ( __call__rvfp__fixunssfsi = 0x40000a3c ) ;
  PROVIDE ( __call__rvfp__floatdidf = 0x40000a8c ) ;
  PROVIDE ( __call__rvfp__floatdisf = 0x40000a40 ) ;
  PROVIDE ( __call__rvfp__floatsidf = 0x40000a90 ) ;
  PROVIDE ( __call__rvfp__floatsisf = 0x40000a44 ) ;
  PROVIDE ( __call__rvfp__floatundidf = 0x40000a94 ) ;
  PROVIDE ( __call__rvfp__floatundisf = 0x40000a48 ) ;
  PROVIDE ( __call__rvfp__floatunsidf = 0x40000a98 ) ;
  PROVIDE ( __call__rvfp__floatunsisf = 0x40000a4c ) ;
  PROVIDE ( __call__rvfp__gedf2 = 0x40000a9c ) ;
  PROVIDE ( __call__rvfp__gesf2 = 0x40000a50 ) ;
  PROVIDE ( __call__rvfp__gtdf2 = 0x40000aa0 ) ;
  PROVIDE ( __call__rvfp__gtsf2 = 0x40000a54 ) ;
  PROVIDE ( __call__rvfp__ledf2 = 0x40000aa4 ) ;
  PROVIDE ( __call__rvfp__lesf2 = 0x40000a58 ) ;
  PROVIDE ( __call__rvfp__ltdf2 = 0x40000aa8 ) ;
  PROVIDE ( __call__rvfp__ltsf2 = 0x40000a5c ) ;
  PROVIDE ( __call__rvfp__muldf3 = 0x40000aac ) ;
  PROVIDE ( __call__rvfp__mulsf3 = 0x40000a60 ) ;
  PROVIDE ( __call__rvfp__nedf2 = 0x40000ab0 ) ;
  PROVIDE ( __call__rvfp__nesf2 = 0x40000a64 ) ;
  PROVIDE ( __call__rvfp__subdf3 = 0x40000ab4 ) ;
  PROVIDE ( __call__rvfp__subsf3 = 0x40000a68 ) ;
  PROVIDE ( __call__rvfp__truncdfsf2 = 0x40000a6c ) ;
  PROVIDE ( __call__vfiprintf_r = 0x400005f0 ) ;
  PROVIDE ( __call__vfprintf_r = 0x400005f4 ) ;
  PROVIDE ( __call_abs = 0x40000588 ) ;
  PROVIDE ( __call_ampdu_dispatch = 0x40000b20 ) ;
  PROVIDE ( __call_ampdu_dispatch_all = 0x40000b24 ) ;
  PROVIDE ( __call_ampdu_dispatch_as_many_as_possible = 0x40000b28 ) ;
  PROVIDE ( __call_ampdu_dispatch_movement = 0x40000b2c ) ;
  PROVIDE ( __call_ampdu_dispatch_upto = 0x40000b30 ) ;
  PROVIDE ( __call_ampdu_process_multicast_address_qos_frame = 0x40000be4 ) ;
  PROVIDE ( __call_asprintf = 0x4000060c ) ;
  PROVIDE ( __call_atoi = 0x400005b0 ) ;
  PROVIDE ( __call_atol = 0x400005b4 ) ;
  PROVIDE ( __call_bzero = 0x400004e0 ) ;
  PROVIDE ( __call_chip752_phyrom_version = 0x400010e0 ) ;
  PROVIDE ( __call_chip752_phyrom_version_num = 0x400010e4 ) ;
  PROVIDE ( __call_chm_is_at_home_channel = 0x40000b34 ) ;
  PROVIDE ( __call_clear_super_wdt_reset_flag = 0x400000a0 ) ;
  PROVIDE ( __call_cnx_node_is_existing = 0x40000b38 ) ;
  PROVIDE ( __call_cnx_node_search = 0x40000b3c ) ;
  PROVIDE ( __call_coex_bt_release = 0x40000acc ) ;
  PROVIDE ( __call_coex_bt_request = 0x40000ad0 ) ;
  PROVIDE ( __call_coex_core_ble_conn_dyn_prio_get = 0x40000ad4 ) ;
  PROVIDE ( __call_coex_core_event_duration_get = 0x40000ad8 ) ;
  PROVIDE ( __call_coex_core_pti_get = 0x40000adc ) ;
  PROVIDE ( __call_coex_core_release = 0x40000ae0 ) ;
  PROVIDE ( __call_coex_core_request = 0x40000ae4 ) ;
  PROVIDE ( __call_coex_core_status_get = 0x40000ae8 ) ;
  PROVIDE ( __call_coex_core_timer_idx_get = 0x40000aec ) ;
  PROVIDE ( __call_coex_event_duration_get = 0x40000af0 ) ;
  PROVIDE ( __call_coex_hw_timer_disable = 0x40000af4 ) ;
  PROVIDE ( __call_coex_hw_timer_enable = 0x40000af8 ) ;
  PROVIDE ( __call_coex_hw_timer_set = 0x40000afc ) ;
  PROVIDE ( __call_coex_schm_interval_set = 0x40000b00 ) ;
  PROVIDE ( __call_coex_schm_lock = 0x40000b04 ) ;
  PROVIDE ( __call_coex_schm_unlock = 0x40000b08 ) ;
  PROVIDE ( __call_coex_status_get = 0x40000b0c ) ;
  PROVIDE ( __call_coex_wifi_release = 0x40000b10 ) ;
  PROVIDE ( __call_config_is_cache_tx_buf_enabled = 0x4000100c ) ;
  PROVIDE ( __call_crc16_be = 0x40000788 ) ;
  PROVIDE ( __call_crc16_le = 0x4000077c ) ;
  PROVIDE ( __call_crc32_be = 0x40000784 ) ;
  PROVIDE ( __call_crc32_le = 0x40000778 ) ;
  PROVIDE ( __call_crc8_be = 0x4000078c ) ;
  PROVIDE ( __call_crc8_le = 0x40000780 ) ;
  PROVIDE ( __call_detect_spi_flash_chip = 0x40000288 ) ;
  PROVIDE ( __call_disable_default_watchdog = 0x400000a4 ) ;
  PROVIDE ( __call_div = 0x4000058c ) ;
  PROVIDE ( __call_ebuf_list_remove = 0x40000bf0 ) ;
  PROVIDE ( __call_esf_buf_alloc = 0x40000bf4 ) ;
  PROVIDE ( __call_esf_buf_alloc_dynamic = 0x40000bf8 ) ;
  PROVIDE ( __call_esf_buf_recycle = 0x40000bfc ) ;
  PROVIDE ( __call_esp_coex_ble_conn_dynamic_prio_get = 0x40000b14 ) ;
  PROVIDE ( __call_esp_coex_rom_version_get = 0x40000ac8 ) ;
  PROVIDE ( __call_esp_crc8 = 0x40000790 ) ;
  PROVIDE ( __call_esp_enable_cache_flash_wrap = 0x40000214 ) ;
  PROVIDE ( __call_esp_flash_chip_driver_initialized = 0x40000240 ) ;
  PROVIDE ( __call_esp_flash_erase_chip = 0x4000024c ) ;
  PROVIDE ( __call_esp_flash_erase_region = 0x40000250 ) ;
  PROVIDE ( __call_esp_flash_get_chip_write_protect = 0x40000254 ) ;
  PROVIDE ( __call_esp_flash_get_io_mode = 0x40000278 ) ;
  PROVIDE ( __call_esp_flash_get_protectable_regions = 0x4000025c ) ;
  PROVIDE ( __call_esp_flash_get_protected_region = 0x40000260 ) ;
  PROVIDE ( __call_esp_flash_get_size = 0x40000248 ) ;
  PROVIDE ( __call_esp_flash_read = 0x40000268 ) ;
  PROVIDE ( __call_esp_flash_read_chip_id = 0x40000284 ) ;
  PROVIDE ( __call_esp_flash_read_encrypted = 0x40000274 ) ;
  PROVIDE ( __call_esp_flash_read_id = 0x40000244 ) ;
  PROVIDE ( __call_esp_flash_set_chip_write_protect = 0x40000258 ) ;
  PROVIDE ( __call_esp_flash_set_io_mode = 0x4000027c ) ;
  PROVIDE ( __call_esp_flash_set_protected_region = 0x40000264 ) ;
  PROVIDE ( __call_esp_flash_suspend_cmd_init = 0x4000028c ) ;
  PROVIDE ( __call_esp_flash_write = 0x4000026c ) ;
  PROVIDE ( __call_esp_flash_write_encrypted = 0x40000270 ) ;
  PROVIDE ( __call_esp_net80211_rom_version_get = 0x40000b18 ) ;
  PROVIDE ( __call_esp_pp_rom_version_get = 0x40000be8 ) ;
  PROVIDE ( __call_esp_rom_check_recover_key = 0x40000890 ) ;
  PROVIDE ( __call_esp_rom_get_rtc_wake_addr = 0x400000ac ) ;
  PROVIDE ( __call_esp_rom_km_huk_conf = 0x40000894 ) ;
  PROVIDE ( __call_esp_rom_km_huk_risk = 0x40000898 ) ;
  PROVIDE ( __call_esp_rom_newlib_init_common_mutexes = 0x400004b4 ) ;
  PROVIDE ( __call_esp_rom_set_rtc_wake_addr = 0x400000a8 ) ;
  PROVIDE ( __call_esp_rom_spi_cmd_config = 0x40000114 ) ;
  PROVIDE ( __call_esp_rom_spi_cmd_start = 0x40000118 ) ;
  PROVIDE ( __call_esp_rom_spi_flash_auto_sus_res = 0x4000017c ) ;
  PROVIDE ( __call_esp_rom_spi_flash_send_resume = 0x40000180 ) ;
  PROVIDE ( __call_esp_rom_spi_flash_update_id = 0x40000184 ) ;
  PROVIDE ( __call_esp_rom_spi_set_address_bit_len = 0x400001ac ) ;
  PROVIDE ( __call_esp_rom_spi_set_op_mode = 0x4000011c ) ;
  PROVIDE ( __call_esp_rom_spiflash_config_clk = 0x40000188 ) ;
  PROVIDE ( __call_esp_rom_spiflash_config_param = 0x40000170 ) ;
  PROVIDE ( __call_esp_rom_spiflash_config_readmode = 0x4000018c ) ;
  PROVIDE ( __call_esp_rom_spiflash_erase_block = 0x40000158 ) ;
  PROVIDE ( __call_esp_rom_spiflash_erase_chip = 0x40000134 ) ;
  PROVIDE ( __call_esp_rom_spiflash_erase_sector = 0x40000154 ) ;
  PROVIDE ( __call_esp_rom_spiflash_read = 0x40000160 ) ;
  PROVIDE ( __call_esp_rom_spiflash_read_status = 0x40000190 ) ;
  PROVIDE ( __call_esp_rom_spiflash_read_statushigh = 0x40000194 ) ;
  PROVIDE ( __call_esp_rom_spiflash_read_user_cmd = 0x40000174 ) ;
  PROVIDE ( __call_esp_rom_spiflash_select_qio_pins = 0x40000178 ) ;
  PROVIDE ( __call_esp_rom_spiflash_unlock = 0x40000164 ) ;
  PROVIDE ( __call_esp_rom_spiflash_wait_idle = 0x40000120 ) ;
  PROVIDE ( __call_esp_rom_spiflash_write = 0x4000015c ) ;
  PROVIDE ( __call_esp_rom_spiflash_write_disable = 0x4000019c ) ;
  PROVIDE ( __call_esp_rom_spiflash_write_encrypted = 0x40000124 ) ;
  PROVIDE ( __call_esp_rom_spiflash_write_encrypted_dest = 0x40000128 ) ;
  PROVIDE ( __call_esp_rom_spiflash_write_encrypted_disable = 0x40000130 ) ;
  PROVIDE ( __call_esp_rom_spiflash_write_encrypted_enable = 0x4000012c ) ;
  PROVIDE ( __call_esp_rom_spiflash_write_status = 0x40000198 ) ;
  PROVIDE ( __call_esp_test_clr_rx_error_occurs = 0x40001060 ) ;
  PROVIDE ( __call_esp_test_clr_rx_mu_statistics = 0x40001074 ) ;
  PROVIDE ( __call_esp_test_clr_rx_statistics = 0x40001050 ) ;
  PROVIDE ( __call_esp_test_clr_tx_statistics = 0x40001020 ) ;
  PROVIDE ( __call_esp_test_clr_tx_tb_statistics = 0x40001028 ) ;
  PROVIDE ( __call_esp_test_disable_rx_mu_statistics = 0x4000107c ) ;
  PROVIDE ( __call_esp_test_disable_rx_statistics = 0x40001064 ) ;
  PROVIDE ( __call_esp_test_disable_tx_statistics = 0x40001018 ) ;
  PROVIDE ( __call_esp_test_enable_rx_mu_statistics = 0x40001078 ) ;
  PROVIDE ( __call_esp_test_enable_rx_statistics = 0x40001068 ) ;
  PROVIDE ( __call_esp_test_enable_tx_statistics = 0x4000101c ) ;
  PROVIDE ( __call_esp_test_get_rx_error_occurs = 0x4000105c ) ;
  PROVIDE ( __call_esp_test_get_rx_mu_statistics = 0x40001070 ) ;
  PROVIDE ( __call_esp_test_get_rx_statistics = 0x40001054 ) ;
  PROVIDE ( __call_esp_test_get_tx_statistics = 0x40001024 ) ;
  PROVIDE ( __call_esp_test_get_tx_tb_statistics = 0x4000102c ) ;
  PROVIDE ( __call_esp_test_rx_parse_mu = 0x4000106c ) ;
  PROVIDE ( __call_esp_test_rx_process_complete = 0x4000104c ) ;
  PROVIDE ( __call_esp_test_set_rx_error_occurs = 0x40001058 ) ;
  PROVIDE ( __call_esp_test_tx_count_collision = 0x40001044 ) ;
  PROVIDE ( __call_esp_test_tx_count_retry = 0x40001040 ) ;
  PROVIDE ( __call_esp_test_tx_count_timeout = 0x40001048 ) ;
  PROVIDE ( __call_esp_test_tx_enab_statistics = 0x40001038 ) ;
  PROVIDE ( __call_esp_test_tx_process_complete = 0x40001030 ) ;
  PROVIDE ( __call_esp_test_tx_process_txq_state = 0x40001034 ) ;
  PROVIDE ( __call_esp_test_tx_tb_complete = 0x4000103c ) ;
  PROVIDE ( __call_esp_wifi_internal_tx = 0x40000b1c ) ;
  PROVIDE ( __call_esprv_intc_int_disable = 0x40000750 ) ;
  PROVIDE ( __call_esprv_intc_int_enable = 0x4000074c ) ;
  PROVIDE ( __call_esprv_intc_int_set_priority = 0x40000744 ) ;
  PROVIDE ( __call_esprv_intc_int_set_threshold = 0x40000748 ) ;
  PROVIDE ( __call_esprv_intc_int_set_type = 0x40000754 ) ;
  PROVIDE ( __call_ets_aes_block = 0x400007e8 ) ;
  PROVIDE ( __call_ets_aes_disable = 0x400007e0 ) ;
  PROVIDE ( __call_ets_aes_enable = 0x400007dc ) ;
  PROVIDE ( __call_ets_aes_setkey = 0x400007e4 ) ;
  PROVIDE ( __call_ets_aes_setkey_dec = 0x400007ec ) ;
  PROVIDE ( __call_ets_aes_setkey_enc = 0x400007f0 ) ;
  PROVIDE ( __call_ets_bigint_disable = 0x400007f8 ) ;
  PROVIDE ( __call_ets_bigint_enable = 0x400007f4 ) ;
  PROVIDE ( __call_ets_bigint_getz = 0x4000080c ) ;
  PROVIDE ( __call_ets_bigint_modexp = 0x40000804 ) ;
  PROVIDE ( __call_ets_bigint_modmult = 0x40000800 ) ;
  PROVIDE ( __call_ets_bigint_multiply = 0x400007fc ) ;
  PROVIDE ( __call_ets_bigint_wait_finish = 0x40000808 ) ;
  PROVIDE ( __call_ets_clk_assist_debug_clock_enable = 0x4000009c ) ;
  PROVIDE ( __call_ets_clk_get_cpu_freq = 0x40000704 ) ;
  PROVIDE ( __call_ets_clk_get_xtal_freq = 0x40000700 ) ;
  PROVIDE ( __call_ets_delay_us = 0x4000003c ) ;
  PROVIDE ( __call_ets_ds_disable = 0x40000814 ) ;
  PROVIDE ( __call_ets_ds_enable = 0x40000810 ) ;
  PROVIDE ( __call_ets_ds_encrypt_params = 0x40000824 ) ;
  PROVIDE ( __call_ets_ds_finish_sign = 0x40000820 ) ;
  PROVIDE ( __call_ets_ds_is_busy = 0x4000081c ) ;
  PROVIDE ( __call_ets_ds_start_sign = 0x40000818 ) ;
  PROVIDE ( __call_ets_ecdsa_verify = 0x400008a4 ) ;
  PROVIDE ( __call_ets_efuse_cache_encryption_enabled = 0x40000858 ) ;
  PROVIDE ( __call_ets_efuse_clear_program_registers = 0x40000830 ) ;
  PROVIDE ( __call_ets_efuse_count_unused_key_blocks = 0x4000084c ) ;
  PROVIDE ( __call_ets_efuse_direct_boot_mode_disabled = 0x40000870 ) ;
  PROVIDE ( __call_ets_efuse_download_modes_disabled = 0x4000085c ) ;
  PROVIDE ( __call_ets_efuse_find_purpose = 0x40000860 ) ;
  PROVIDE ( __call_ets_efuse_find_unused_key_block = 0x40000844 ) ;
  PROVIDE ( __call_ets_efuse_force_send_resume = 0x40000864 ) ;
  PROVIDE ( __call_ets_efuse_get_flash_delay_us = 0x40000868 ) ;
  PROVIDE ( __call_ets_efuse_get_key_purpose = 0x4000083c ) ;
  PROVIDE ( __call_ets_efuse_get_read_register_address = 0x40000838 ) ;
  PROVIDE ( __call_ets_efuse_get_uart_print_control = 0x4000086c ) ;
  PROVIDE ( __call_ets_efuse_jtag_disabled = 0x40000878 ) ;
  PROVIDE ( __call_ets_efuse_key_block_unused = 0x40000840 ) ;
  PROVIDE ( __call_ets_efuse_program = 0x4000082c ) ;
  PROVIDE ( __call_ets_efuse_read = 0x40000828 ) ;
  PROVIDE ( __call_ets_efuse_rs_calculate = 0x40000848 ) ;
  PROVIDE ( __call_ets_efuse_secure_boot_aggressive_revoke_enabled = 0x40000854 ) ;
  PROVIDE ( __call_ets_efuse_secure_boot_enabled = 0x40000850 ) ;
  PROVIDE ( __call_ets_efuse_secure_boot_fast_wake_enabled = 0x40000888 ) ;
  PROVIDE ( __call_ets_efuse_security_download_modes_enabled = 0x40000874 ) ;
  PROVIDE ( __call_ets_efuse_usb_device_disabled = 0x40000884 ) ;
  PROVIDE ( __call_ets_efuse_usb_download_mode_disabled = 0x40000880 ) ;
  PROVIDE ( __call_ets_efuse_usb_print_is_disabled = 0x4000087c ) ;
  PROVIDE ( __call_ets_efuse_write_key = 0x40000834 ) ;
  PROVIDE ( __call_ets_emsa_pss_verify = 0x4000089c ) ;
  PROVIDE ( __call_ets_get_bootloader_offset = 0x40001544 ) ;
  PROVIDE ( __call_ets_get_cpu_frequency = 0x40000040 ) ;
  PROVIDE ( __call_ets_get_printf_channel = 0x40000038 ) ;
  PROVIDE ( __call_ets_hmac_calculate_downstream = 0x400007d4 ) ;
  PROVIDE ( __call_ets_hmac_calculate_message = 0x400007d0 ) ;
  PROVIDE ( __call_ets_hmac_disable = 0x400007cc ) ;
  PROVIDE ( __call_ets_hmac_enable = 0x400007c8 ) ;
  PROVIDE ( __call_ets_hmac_invalidate_downstream = 0x400007d8 ) ;
  PROVIDE ( __call_ets_install_lock = 0x40000048 ) ;
  PROVIDE ( __call_ets_install_putc1 = 0x40000028 ) ;
  PROVIDE ( __call_ets_install_putc2 = 0x4000002c ) ;
  PROVIDE ( __call_ets_install_uart_printf = 0x40000030 ) ;
  PROVIDE ( __call_ets_install_usb_printf = 0x40000034 ) ;
  PROVIDE ( __call_ets_intr_lock = 0x40000764 ) ;
  PROVIDE ( __call_ets_intr_register_ctx = 0x40000760 ) ;
  PROVIDE ( __call_ets_intr_unlock = 0x40000768 ) ;
  PROVIDE ( __call_ets_isr_attach = 0x4000076c ) ;
  PROVIDE ( __call_ets_isr_mask = 0x40000770 ) ;
  PROVIDE ( __call_ets_isr_unmask = 0x40000774 ) ;
  PROVIDE ( __call_ets_jtag_enable_temporarily = 0x4000088c ) ;
  PROVIDE ( __call_ets_mgf1_sha256 = 0x400008b4 ) ;
  PROVIDE ( __call_ets_printf = 0x40000024 ) ;
  PROVIDE ( __call_ets_rsa_pss_verify = 0x400008a0 ) ;
  PROVIDE ( __call_ets_secure_boot_read_key_digests = 0x400008b0 ) ;
  PROVIDE ( __call_ets_secure_boot_revoke_public_key_digest = 0x400008b8 ) ;
  PROVIDE ( __call_ets_secure_boot_verify_bootloader_with_keys = 0x400008a8 ) ;
  PROVIDE ( __call_ets_secure_boot_verify_signature = 0x400008ac ) ;
  PROVIDE ( __call_ets_set_bootloader_offset = 0x40001548 ) ;
  PROVIDE ( __call_ets_set_user_start = 0x400000c8 ) ;
  PROVIDE ( __call_ets_sha_clone = 0x400007c4 ) ;
  PROVIDE ( __call_ets_sha_disable = 0x400007a8 ) ;
  PROVIDE ( __call_ets_sha_enable = 0x400007a4 ) ;
  PROVIDE ( __call_ets_sha_finish = 0x400007c0 ) ;
  PROVIDE ( __call_ets_sha_get_state = 0x400007ac ) ;
  PROVIDE ( __call_ets_sha_init = 0x400007b0 ) ;
  PROVIDE ( __call_ets_sha_process = 0x400007b4 ) ;
  PROVIDE ( __call_ets_sha_starts = 0x400007b8 ) ;
  PROVIDE ( __call_ets_sha_update = 0x400007bc ) ;
  PROVIDE ( __call_ets_update_cpu_frequency = 0x40000044 ) ;
  PROVIDE ( __call_ets_write_char_uart = 0x40000080 ) ;
  PROVIDE ( __call_fflush = 0x400005c0 ) ;
  PROVIDE ( __call_fiprintf = 0x400005f8 ) ;
  PROVIDE ( __call_flash2spiram_instruction_offset = 0x400006e8 ) ;
  PROVIDE ( __call_flash2spiram_rodata_offset = 0x400006ec ) ;
  PROVIDE ( __call_flash_instr_rodata_end_page = 0x400006f4 ) ;
  PROVIDE ( __call_flash_instr_rodata_start_page = 0x400006f0 ) ;
  PROVIDE ( __call_fprintf = 0x400005fc ) ;
  PROVIDE ( __call_get_estimated_batime = 0x400010d4 ) ;
  PROVIDE ( __call_get_sublen_offset = 0x400010d8 ) ;
  PROVIDE ( __call_gpio_bypass_matrix_in = 0x40000718 ) ;
  PROVIDE ( __call_gpio_get_input_level = 0x4000070c ) ;
  PROVIDE ( __call_gpio_matrix_in = 0x40000710 ) ;
  PROVIDE ( __call_gpio_matrix_out = 0x40000714 ) ;
  PROVIDE ( __call_gpio_output_disable = 0x4000071c ) ;
  PROVIDE ( __call_gpio_output_enable = 0x40000720 ) ;
  PROVIDE ( __call_gpio_pad_hold = 0x40000740 ) ;
  PROVIDE ( __call_gpio_pad_input_disable = 0x40000724 ) ;
  PROVIDE ( __call_gpio_pad_input_enable = 0x40000728 ) ;
  PROVIDE ( __call_gpio_pad_pulldown = 0x4000072c ) ;
  PROVIDE ( __call_gpio_pad_pullup = 0x40000730 ) ;
  PROVIDE ( __call_gpio_pad_select_gpio = 0x40000734 ) ;
  PROVIDE ( __call_gpio_pad_set_drv = 0x40000738 ) ;
  PROVIDE ( __call_gpio_pad_unhold = 0x4000073c ) ;
  PROVIDE ( __call_gpio_set_output_level = 0x40000708 ) ;
  PROVIDE ( __call_hal_enable_rx_statistics = 0x40000c4c ) ;
  PROVIDE ( __call_hal_enable_tsf_timer = 0x40000c50 ) ;
  PROVIDE ( __call_hal_enable_tx_statistics = 0x40000c48 ) ;
  PROVIDE ( __call_hal_get_sta_tsf = 0x40000c68 ) ;
  PROVIDE ( __call_hal_get_tsf_time = 0x40000c64 ) ;
  PROVIDE ( __call_hal_he_get_aid = 0x40000c40 ) ;
  PROVIDE ( __call_hal_he_get_bss_color = 0x40000c28 ) ;
  PROVIDE ( __call_hal_he_get_mplen_addr_end = 0x40000c34 ) ;
  PROVIDE ( __call_hal_he_get_mplen_addr_start = 0x40000c30 ) ;
  PROVIDE ( __call_hal_he_set_bf_report_rate = 0x40000c38 ) ;
  PROVIDE ( __call_hal_he_set_ersu = 0x40000c2c ) ;
  PROVIDE ( __call_hal_he_set_ersu_ack_rate = 0x40000c3c ) ;
  PROVIDE ( __call_hal_mac_clr_txq_state = 0x40000c18 ) ;
  PROVIDE ( __call_hal_mac_deinit_twt_tx = 0x40000c20 ) ;
  PROVIDE ( __call_hal_mac_get_txq_complete = 0x40000c1c ) ;
  PROVIDE ( __call_hal_mac_get_txq_state = 0x40000c14 ) ;
  PROVIDE ( __call_hal_mac_is_dma_enable = 0x40000c24 ) ;
  PROVIDE ( __call_hal_mac_is_low_rate_enabled = 0x40000c04 ) ;
  PROVIDE ( __call_hal_mac_tx_clr_mplen = 0x40000c10 ) ;
  PROVIDE ( __call_hal_mac_tx_get_blockack = 0x40000c08 ) ;
  PROVIDE ( __call_hal_mac_tx_set_ppdu = 0x40000c0c ) ;
  PROVIDE ( __call_hal_random = 0x40000c44 ) ;
  PROVIDE ( __call_hal_tsf_clear_soc_wakeup_request = 0x40000c60 ) ;
  PROVIDE ( __call_hal_tsf_timer_set_target = 0x40000c5c ) ;
  PROVIDE ( __call_hal_wdev_timer_set_target = 0x40000c58 ) ;
  PROVIDE ( __call_hal_wdev_timer_target_enable = 0x40000c54 ) ;
  PROVIDE ( __call_he_get_min_subframe_len = 0x400010c0 ) ;
  PROVIDE ( __call_he_get_min_subframe_len_dcm = 0x400010c4 ) ;
  PROVIDE ( __call_ht_get_min_subframe_len = 0x400010b8 ) ;
  PROVIDE ( __call_ic_ebuf_alloc = 0x40000b4c ) ;
  PROVIDE ( __call_ic_ebuf_recycle_rx = 0x40000b40 ) ;
  PROVIDE ( __call_ic_ebuf_recycle_tx = 0x40000b44 ) ;
  PROVIDE ( __call_ic_get_he_rts_threshold_bytes = 0x40000c88 ) ;
  PROVIDE ( __call_ic_get_trc = 0x40000c74 ) ;
  PROVIDE ( __call_ic_interface_enabled = 0x40000c80 ) ;
  PROVIDE ( __call_ic_mac_deinit = 0x40000c78 ) ;
  PROVIDE ( __call_ic_mac_init = 0x40000c7c ) ;
  PROVIDE ( __call_ic_reset_extra_softap_rx_ba = 0x40000b50 ) ;
  PROVIDE ( __call_ic_reset_rx_ba = 0x40000b48 ) ;
  PROVIDE ( __call_ieee80211_align_eb = 0x40000b54 ) ;
  PROVIDE ( __call_ieee80211_alloc_tx_buf = 0x40000b9c ) ;
  PROVIDE ( __call_ieee80211_ampdu_reorder = 0x40000b58 ) ;
  PROVIDE ( __call_ieee80211_ampdu_start_age_timer = 0x40000b5c ) ;
  PROVIDE ( __call_ieee80211_classify = 0x40000b74 ) ;
  PROVIDE ( __call_ieee80211_copy_eb_header = 0x40000b78 ) ;
  PROVIDE ( __call_ieee80211_crypto_decap = 0x40000b88 ) ;
  PROVIDE ( __call_ieee80211_crypto_encap = 0x40000b84 ) ;
  PROVIDE ( __call_ieee80211_decap = 0x40000b8c ) ;
  PROVIDE ( __call_ieee80211_encap_esfbuf = 0x40000b60 ) ;
  PROVIDE ( __call_ieee80211_encap_esfbuf_htc = 0x40000bc0 ) ;
  PROVIDE ( __call_ieee80211_find_elem = 0x40000bac ) ;
  PROVIDE ( __call_ieee80211_find_elem_match = 0x40000ba4 ) ;
  PROVIDE ( __call_ieee80211_find_ext_elem = 0x40000bb0 ) ;
  PROVIDE ( __call_ieee80211_find_ext_ie = 0x40000bb8 ) ;
  PROVIDE ( __call_ieee80211_find_ie = 0x40000bb4 ) ;
  PROVIDE ( __call_ieee80211_find_ie_match = 0x40000ba8 ) ;
  PROVIDE ( __call_ieee80211_gettid = 0x40000b94 ) ;
  PROVIDE ( __call_ieee80211_is_tx_allowed = 0x40000b64 ) ;
  PROVIDE ( __call_ieee80211_merge_mbssid_profile = 0x40000bbc ) ;
  PROVIDE ( __call_ieee80211_output_do = 0x40000ba0 ) ;
  PROVIDE ( __call_ieee80211_output_pending_eb = 0x40000b68 ) ;
  PROVIDE ( __call_ieee80211_output_process = 0x40000b6c ) ;
  PROVIDE ( __call_ieee80211_post_hmac_tx = 0x40000b98 ) ;
  PROVIDE ( __call_ieee80211_recycle_cache_eb = 0x40000b7c ) ;
  PROVIDE ( __call_ieee80211_search_node = 0x40000b80 ) ;
  PROVIDE ( __call_ieee80211_set_tx_desc = 0x40000b70 ) ;
  PROVIDE ( __call_ieee80211_set_tx_pti = 0x40000b90 ) ;
  PROVIDE ( __call_intr_handler_set = 0x40000758 ) ;
  PROVIDE ( __call_intr_matrix_set = 0x4000075c ) ;
  PROVIDE ( __call_is_lmac_idle = 0x40000c84 ) ;
  PROVIDE ( __call_is_ndpa_to_dut = 0x400010c8 ) ;
  PROVIDE ( __call_is_use_muedca = 0x400010cc ) ;
  PROVIDE ( __call_isalnum = 0x400004ec ) ;
  PROVIDE ( __call_isalpha = 0x400004f0 ) ;
  PROVIDE ( __call_isascii = 0x400004f4 ) ;
  PROVIDE ( __call_isblank = 0x400004f8 ) ;
  PROVIDE ( __call_iscntrl = 0x400004fc ) ;
  PROVIDE ( __call_isdigit = 0x40000500 ) ;
  PROVIDE ( __call_isgraph = 0x40000508 ) ;
  PROVIDE ( __call_islower = 0x40000504 ) ;
  PROVIDE ( __call_isprint = 0x4000050c ) ;
  PROVIDE ( __call_ispunct = 0x40000510 ) ;
  PROVIDE ( __call_isspace = 0x40000514 ) ;
  PROVIDE ( __call_isupper = 0x40000518 ) ;
  PROVIDE ( __call_itoa = 0x400005ac ) ;
  PROVIDE ( __call_jd_decomp = 0x40000110 ) ;
  PROVIDE ( __call_jd_prepare = 0x4000010c ) ;
  PROVIDE ( __call_labs = 0x40000590 ) ;
  PROVIDE ( __call_ldiv = 0x40000594 ) ;
  PROVIDE ( __call_lldesc_build_chain = 0x4000154c ) ;
  PROVIDE ( __call_lmacAdjustTimestamp = 0x40000c8c ) ;
  PROVIDE ( __call_lmacDisableTransmit = 0x40000cd4 ) ;
  PROVIDE ( __call_lmacDiscardAgedMSDU = 0x40000c90 ) ;
  PROVIDE ( __call_lmacDiscardFrameExchangeSequence = 0x40000cd8 ) ;
  PROVIDE ( __call_lmacDiscardMSDU = 0x40000c94 ) ;
  PROVIDE ( __call_lmacEndFrameExchangeSequence = 0x40000c98 ) ;
  PROVIDE ( __call_lmacEndRetryAMPDUFail = 0x40000d00 ) ;
  PROVIDE ( __call_lmacIsIdle = 0x40000c9c ) ;
  PROVIDE ( __call_lmacIsLongFrame = 0x40000ca0 ) ;
  PROVIDE ( __call_lmacMSDUAged = 0x40000ca4 ) ;
  PROVIDE ( __call_lmacPostTxComplete = 0x40000ca8 ) ;
  PROVIDE ( __call_lmacProcessAckTimeout = 0x40000ce0 ) ;
  PROVIDE ( __call_lmacProcessAllTxTimeout = 0x40000cac ) ;
  PROVIDE ( __call_lmacProcessCollision = 0x40000cdc ) ;
  PROVIDE ( __call_lmacProcessCollisions = 0x40000cb0 ) ;
  PROVIDE ( __call_lmacProcessCollisions_task = 0x40000ce8 ) ;
  PROVIDE ( __call_lmacProcessCtsTimeout = 0x40000cf4 ) ;
  PROVIDE ( __call_lmacProcessLongFrameSuccess = 0x40000d0c ) ;
  PROVIDE ( __call_lmacProcessLongRetryFail = 0x40000cf8 ) ;
  PROVIDE ( __call_lmacProcessModemStateRxBeacon = 0x40000d14 ) ;
  PROVIDE ( __call_lmacProcessRxSucData = 0x40000cb4 ) ;
  PROVIDE ( __call_lmacProcessShortFrameSuccess = 0x40000d10 ) ;
  PROVIDE ( __call_lmacProcessShortRetryFail = 0x40000ce4 ) ;
  PROVIDE ( __call_lmacProcessTxComplete = 0x40000d08 ) ;
  PROVIDE ( __call_lmacProcessTxError = 0x40000cf0 ) ;
  PROVIDE ( __call_lmacProcessTxRtsError = 0x40000cec ) ;
  PROVIDE ( __call_lmacProcessTxSuccess = 0x40000d04 ) ;
  PROVIDE ( __call_lmacReachLongLimit = 0x40000cb8 ) ;
  PROVIDE ( __call_lmacReachShortLimit = 0x40000cbc ) ;
  PROVIDE ( __call_lmacRecycleMPDU = 0x40000cc0 ) ;
  PROVIDE ( __call_lmacRetryTxFrame = 0x40000cfc ) ;
  PROVIDE ( __call_lmacRxDone = 0x40000cc4 ) ;
  PROVIDE ( __call_lmacSetTxFrame = 0x40000cc8 ) ;
  PROVIDE ( __call_lmacTxDone = 0x40000ccc ) ;
  PROVIDE ( __call_lmacTxFrame = 0x40000cd0 ) ;
  PROVIDE ( __call_longjmp = 0x40000580 ) ;
  PROVIDE ( __call_mac_tx_set_duration = 0x40000d18 ) ;
  PROVIDE ( __call_mac_tx_set_hesig = 0x40000d34 ) ;
  PROVIDE ( __call_mac_tx_set_htsig = 0x40000d2c ) ;
  PROVIDE ( __call_mac_tx_set_len = 0x40000d28 ) ;
  PROVIDE ( __call_mac_tx_set_mplen = 0x40000d3c ) ;
  PROVIDE ( __call_mac_tx_set_plcp0 = 0x40000d1c ) ;
  PROVIDE ( __call_mac_tx_set_plcp1 = 0x40000d20 ) ;
  PROVIDE ( __call_mac_tx_set_plcp2 = 0x40000d24 ) ;
  PROVIDE ( __call_mac_tx_set_pti = 0x40000d44 ) ;
  PROVIDE ( __call_mac_tx_set_tb = 0x40000d38 ) ;
  PROVIDE ( __call_mac_tx_set_txop_q = 0x40000d40 ) ;
  PROVIDE ( __call_mac_tx_set_vhtsig = 0x40000d30 ) ;
  PROVIDE ( __call_md5_vector = 0x40000794 ) ;
  PROVIDE ( __call_memccpy = 0x40000528 ) ;
  PROVIDE ( __call_memchr = 0x4000052c ) ;
  PROVIDE ( __call_memcmp = 0x400004c4 ) ;
  PROVIDE ( __call_memcpy = 0x400004bc ) ;
  PROVIDE ( __call_memmove = 0x400004c0 ) ;
  PROVIDE ( __call_memrchr = 0x40000530 ) ;
  PROVIDE ( __call_memset = 0x400004b8 ) ;
  PROVIDE ( __call_memspi_host_erase_block = 0x40000324 ) ;
  PROVIDE ( __call_memspi_host_erase_chip = 0x4000031c ) ;
  PROVIDE ( __call_memspi_host_erase_sector = 0x40000320 ) ;
  PROVIDE ( __call_memspi_host_flush_cache = 0x40000318 ) ;
  PROVIDE ( __call_memspi_host_program_page = 0x40000328 ) ;
  PROVIDE ( __call_memspi_host_read = 0x4000032c ) ;
  PROVIDE ( __call_memspi_host_read_data_slicer = 0x40000338 ) ;
  PROVIDE ( __call_memspi_host_read_id_hs = 0x40000310 ) ;
  PROVIDE ( __call_memspi_host_read_status_hs = 0x40000314 ) ;
  PROVIDE ( __call_memspi_host_set_max_read_len = 0x40000334 ) ;
  PROVIDE ( __call_memspi_host_set_write_protect = 0x40000330 ) ;
  PROVIDE ( __call_memspi_host_write_data_slicer = 0x4000033c ) ;
  PROVIDE ( __call_multi_heap_aligned_alloc_impl = 0x4000049c ) ;
  PROVIDE ( __call_multi_heap_aligned_alloc_impl_offs = 0x40000498 ) ;
  PROVIDE ( __call_multi_heap_check = 0x400004a0 ) ;
  PROVIDE ( __call_multi_heap_dump = 0x400004a4 ) ;
  PROVIDE ( __call_multi_heap_free_impl = 0x40000490 ) ;
  PROVIDE ( __call_multi_heap_free_size_impl = 0x400004a8 ) ;
  PROVIDE ( __call_multi_heap_get_allocated_size_impl = 0x40000468 ) ;
  PROVIDE ( __call_multi_heap_get_block_address_impl = 0x40000464 ) ;
  PROVIDE ( __call_multi_heap_get_first_block = 0x40000480 ) ;
  PROVIDE ( __call_multi_heap_get_info_impl = 0x400004b0 ) ;
  PROVIDE ( __call_multi_heap_get_next_block = 0x40000484 ) ;
  PROVIDE ( __call_multi_heap_internal_lock = 0x40000478 ) ;
  PROVIDE ( __call_multi_heap_internal_unlock = 0x4000047c ) ;
  PROVIDE ( __call_multi_heap_is_free = 0x40000488 ) ;
  PROVIDE ( __call_multi_heap_malloc_impl = 0x4000048c ) ;
  PROVIDE ( __call_multi_heap_minimum_free_size_impl = 0x400004ac ) ;
  PROVIDE ( __call_multi_heap_os_funcs_init = 0x40000474 ) ;
  PROVIDE ( __call_multi_heap_realloc_impl = 0x40000494 ) ;
  PROVIDE ( __call_multi_heap_register_impl = 0x4000046c ) ;
  PROVIDE ( __call_multi_heap_set_lock = 0x40000470 ) ;
  PROVIDE ( __call_multofup = 0x40000090 ) ;
  PROVIDE ( __call_mz_adler32 = 0x400000cc ) ;
  PROVIDE ( __call_mz_free = 0x400000d0 ) ;
  PROVIDE ( __call_phy_abs_temp = 0x40001100 ) ;
  PROVIDE ( __call_phy_adc_rate_set = 0x40001214 ) ;
  PROVIDE ( __call_phy_agc_max_gain_set = 0x40001318 ) ;
  PROVIDE ( __call_phy_agc_reg_init = 0x4000131c ) ;
  PROVIDE ( __call_phy_ant_btrx_cfg = 0x40001148 ) ;
  PROVIDE ( __call_phy_ant_bttx_cfg = 0x40001144 ) ;
  PROVIDE ( __call_phy_ant_dft_cfg = 0x40001138 ) ;
  PROVIDE ( __call_phy_ant_init = 0x40001360 ) ;
  PROVIDE ( __call_phy_ant_wifirx_cfg = 0x40001140 ) ;
  PROVIDE ( __call_phy_ant_wifitx_cfg = 0x4000113c ) ;
  PROVIDE ( __call_phy_band_reg = 0x40001224 ) ;
  PROVIDE ( __call_phy_bb_bss_cbw40 = 0x40001118 ) ;
  PROVIDE ( __call_phy_bb_bss_cbw40_dig = 0x400012f4 ) ;
  PROVIDE ( __call_phy_bb_cbw_chan_cfg = 0x400013a4 ) ;
  PROVIDE ( __call_phy_bb_cfo_cfg = 0x400013b4 ) ;
  PROVIDE ( __call_phy_bb_gain_index = 0x40001430 ) ;
  PROVIDE ( __call_phy_bb_reg_init = 0x40001320 ) ;
  PROVIDE ( __call_phy_bb_wdg_cfg = 0x4000130c ) ;
  PROVIDE ( __call_phy_bb_wdg_test_en = 0x40001348 ) ;
  PROVIDE ( __call_phy_bb_wdt_get_status = 0x400013d4 ) ;
  PROVIDE ( __call_phy_bb_wdt_int_enable = 0x400013cc ) ;
  PROVIDE ( __call_phy_bb_wdt_rst_enable = 0x400013c8 ) ;
  PROVIDE ( __call_phy_bb_wdt_timeout_clear = 0x400013d0 ) ;
  PROVIDE ( __call_phy_bbpll_cal = 0x4000135c ) ;
  PROVIDE ( __call_phy_bbtx_outfilter = 0x400013c4 ) ;
  PROVIDE ( __call_phy_bt_chan_pwr_interp = 0x400014d8 ) ;
  PROVIDE ( __call_phy_bt_filter_reg = 0x40001368 ) ;
  PROVIDE ( __call_phy_bt_gain_offset = 0x40001300 ) ;
  PROVIDE ( __call_phy_bt_get_tx_gain = 0x400014c8 ) ;
  PROVIDE ( __call_phy_bt_get_tx_tab_ = 0x400014f8 ) ;
  PROVIDE ( __call_phy_bt_set_tx_gain = 0x400014fc ) ;
  PROVIDE ( __call_phy_bt_tx_gain_init = 0x40001500 ) ;
  PROVIDE ( __call_phy_bt_tx_pwctrl_init = 0x400014bc ) ;
  PROVIDE ( __call_phy_bt_txdc_cal = 0x4000146c ) ;
  PROVIDE ( __call_phy_bt_txiq_cal = 0x40001470 ) ;
  PROVIDE ( __call_phy_byte_to_word = 0x40001110 ) ;
  PROVIDE ( __call_phy_chan14_mic_cfg = 0x40001128 ) ;
  PROVIDE ( __call_phy_chan14_mic_enable = 0x40001124 ) ;
  PROVIDE ( __call_phy_chan_dump_cfg = 0x4000114c ) ;
  PROVIDE ( __call_phy_chan_dump_cfg_752 = 0x40001150 ) ;
  PROVIDE ( __call_phy_chan_filt_set = 0x40001164 ) ;
  PROVIDE ( __call_phy_chan_to_freq = 0x400013dc ) ;
  PROVIDE ( __call_phy_chip_i2c_readReg = 0x400011cc ) ;
  PROVIDE ( __call_phy_chip_i2c_readReg_org = 0x400011c8 ) ;
  PROVIDE ( __call_phy_chip_i2c_writeReg = 0x400011ec ) ;
  PROVIDE ( __call_phy_chip_set_chan_ana_ = 0x4000153c ) ;
  PROVIDE ( __call_phy_ckgen_2g_cal = 0x40001210 ) ;
  PROVIDE ( __call_phy_ckgen_5g_cal = 0x4000120c ) ;
  PROVIDE ( __call_phy_close_pa = 0x40001374 ) ;
  PROVIDE ( __call_phy_code_to_temp = 0x40001450 ) ;
  PROVIDE ( __call_phy_csidump_force_lltf_cfg = 0x400013ac ) ;
  PROVIDE ( __call_phy_dac_rate_set = 0x40001218 ) ;
  PROVIDE ( __call_phy_dc_iq_est = 0x400013ec ) ;
  PROVIDE ( __call_phy_dig_gain_check = 0x400014cc ) ;
  PROVIDE ( __call_phy_dig_reg_backup = 0x40001160 ) ;
  PROVIDE ( __call_phy_dis_hw_set_freq = 0x400011a8 ) ;
  PROVIDE ( __call_phy_disable_agc = 0x400012e0 ) ;
  PROVIDE ( __call_phy_disable_cca = 0x400012e8 ) ;
  PROVIDE ( __call_phy_disable_low_rate = 0x40001158 ) ;
  PROVIDE ( __call_phy_en_hw_set_freq = 0x400011a4 ) ;
  PROVIDE ( __call_phy_en_pwdet = 0x400012a0 ) ;
  PROVIDE ( __call_phy_enable_agc = 0x400012e4 ) ;
  PROVIDE ( __call_phy_enable_cca = 0x400012ec ) ;
  PROVIDE ( __call_phy_enable_low_rate = 0x40001154 ) ;
  PROVIDE ( __call_phy_encode_i2c_master = 0x4000121c ) ;
  PROVIDE ( __call_phy_fe_adc_on = 0x40001390 ) ;
  PROVIDE ( __call_phy_fe_reg_init = 0x40001304 ) ;
  PROVIDE ( __call_phy_fe_txrx_reset = 0x40001310 ) ;
  PROVIDE ( __call_phy_fft_scale_force = 0x40001398 ) ;
  PROVIDE ( __call_phy_filter_dcap_set = 0x40001204 ) ;
  PROVIDE ( __call_phy_force_pwr_index = 0x40001394 ) ;
  PROVIDE ( __call_phy_force_rx_gain = 0x4000139c ) ;
  PROVIDE ( __call_phy_force_txrx_off = 0x40001328 ) ;
  PROVIDE ( __call_phy_freq_band_reg_set = 0x400013b8 ) ;
  PROVIDE ( __call_phy_freq_chan_en_sw = 0x40001178 ) ;
  PROVIDE ( __call_phy_freq_correct = 0x40001378 ) ;
  PROVIDE ( __call_phy_freq_i2c_mem_write = 0x40001190 ) ;
  PROVIDE ( __call_phy_freq_i2c_num_addr = 0x40001198 ) ;
  PROVIDE ( __call_phy_freq_i2c_write_set = 0x4000119c ) ;
  PROVIDE ( __call_phy_freq_module_resetn = 0x40001174 ) ;
  PROVIDE ( __call_phy_freq_num_get_data = 0x40001194 ) ;
  PROVIDE ( __call_phy_freq_to_chan = 0x400013d8 ) ;
  PROVIDE ( __call_phy_freq_to_index = 0x400013e0 ) ;
  PROVIDE ( __call_phy_freq_to_mbgain = 0x400014a8 ) ;
  PROVIDE ( __call_phy_gen_rx_gain_table = 0x40001438 ) ;
  PROVIDE ( __call_phy_get_cal_chan = 0x4000149c ) ;
  PROVIDE ( __call_phy_get_chan_cal_index = 0x400014a0 ) ;
  PROVIDE ( __call_phy_get_chan_cap = 0x400014a4 ) ;
  PROVIDE ( __call_phy_get_chan_target_power = 0x400014e4 ) ;
  PROVIDE ( __call_phy_get_data_sat = 0x4000110c ) ;
  PROVIDE ( __call_phy_get_dco_comp = 0x40001404 ) ;
  PROVIDE ( __call_phy_get_fm_sar_dout = 0x400012b0 ) ;
  PROVIDE ( __call_phy_get_freq_mem_addr = 0x40001184 ) ;
  PROVIDE ( __call_phy_get_freq_mem_param = 0x40001180 ) ;
  PROVIDE ( __call_phy_get_i2c_hostid_ = 0x400011c4 ) ;
  PROVIDE ( __call_phy_get_i2c_mst0_mask = 0x400011c0 ) ;
  PROVIDE ( __call_phy_get_i2c_read_mask_ = 0x400011bc ) ;
  PROVIDE ( __call_phy_get_mac_addr = 0x4000122c ) ;
  PROVIDE ( __call_phy_get_max_pwr = 0x400010f0 ) ;
  PROVIDE ( __call_phy_get_most_tpw = 0x40001130 ) ;
  PROVIDE ( __call_phy_get_pkdet_data = 0x400012d8 ) ;
  PROVIDE ( __call_phy_get_power_atten = 0x40001488 ) ;
  PROVIDE ( __call_phy_get_power_db = 0x400012bc ) ;
  PROVIDE ( __call_phy_get_pwdet_offset_ = 0x400014b0 ) ;
  PROVIDE ( __call_phy_get_pwr_index = 0x400010f4 ) ;
  PROVIDE ( __call_phy_get_rate_fcc_index = 0x400014e0 ) ;
  PROVIDE ( __call_phy_get_rc_dout = 0x400010f8 ) ;
  PROVIDE ( __call_phy_get_rfcal_rxiq_data = 0x40001400 ) ;
  PROVIDE ( __call_phy_get_romfuncs = 0x40001538 ) ;
  PROVIDE ( __call_phy_get_rx_freq = 0x40001114 ) ;
  PROVIDE ( __call_phy_get_rx_pbus_freq = 0x40001288 ) ;
  PROVIDE ( __call_phy_get_rxbb_dc = 0x4000143c ) ;
  PROVIDE ( __call_phy_get_sar2_vol = 0x400012d4 ) ;
  PROVIDE ( __call_phy_get_sar_sig_ref = 0x400012a4 ) ;
  PROVIDE ( __call_phy_get_target_pwr = 0x400010ec ) ;
  PROVIDE ( __call_phy_get_tone_sar_dout = 0x400012ac ) ;
  PROVIDE ( __call_phy_get_tsens_value_ = 0x40001448 ) ;
  PROVIDE ( __call_phy_get_tx_gain_value = 0x400014e8 ) ;
  PROVIDE ( __call_phy_hemu_ru26_good_res = 0x400013b0 ) ;
  PROVIDE ( __call_phy_i2c_clk_sel = 0x400011b8 ) ;
  PROVIDE ( __call_phy_i2c_enter_critical_ = 0x400011b0 ) ;
  PROVIDE ( __call_phy_i2c_exit_critical_ = 0x400011b4 ) ;
  PROVIDE ( __call_phy_i2c_master_fill = 0x40001220 ) ;
  PROVIDE ( __call_phy_i2c_master_reset = 0x40001120 ) ;
  PROVIDE ( __call_phy_i2c_paral_read = 0x400011d8 ) ;
  PROVIDE ( __call_phy_i2c_paral_set_mst0 = 0x400011d0 ) ;
  PROVIDE ( __call_phy_i2c_paral_set_read = 0x400011d4 ) ;
  PROVIDE ( __call_phy_i2c_paral_write = 0x400011dc ) ;
  PROVIDE ( __call_phy_i2c_paral_write_mask = 0x400011e4 ) ;
  PROVIDE ( __call_phy_i2c_paral_write_num = 0x400011e0 ) ;
  PROVIDE ( __call_phy_i2c_pkdet_set = 0x40001200 ) ;
  PROVIDE ( __call_phy_i2c_rc_cal_set = 0x40001208 ) ;
  PROVIDE ( __call_phy_i2c_readReg = 0x400011e8 ) ;
  PROVIDE ( __call_phy_i2c_readReg_Mask = 0x400011f4 ) ;
  PROVIDE ( __call_phy_i2c_sar2_init_code = 0x400011fc ) ;
  PROVIDE ( __call_phy_i2c_writeReg = 0x400011f0 ) ;
  PROVIDE ( __call_phy_i2c_writeReg_Mask = 0x4000152c ) ;
  PROVIDE ( __call_phy_i2cmst_reg_init = 0x400012fc ) ;
  PROVIDE ( __call_phy_index_to_txbbgain = 0x400014c4 ) ;
  PROVIDE ( __call_phy_iq_corr_enable = 0x40001354 ) ;
  PROVIDE ( __call_phy_iq_est_disable = 0x400013e8 ) ;
  PROVIDE ( __call_phy_iq_est_enable = 0x400013e4 ) ;
  PROVIDE ( __call_phy_is_low_rate_enabled = 0x4000115c ) ;
  PROVIDE ( __call_phy_linear_to_db = 0x400012b8 ) ;
  PROVIDE ( __call_phy_loop_clk_en = 0x40001108 ) ;
  PROVIDE ( __call_phy_mac_enable_bb = 0x40001308 ) ;
  PROVIDE ( __call_phy_meas_tone_pwr_db = 0x400012c0 ) ;
  PROVIDE ( __call_phy_noise_floor_auto_set = 0x4000134c ) ;
  PROVIDE ( __call_phy_nrx_freq_set = 0x4000138c ) ;
  PROVIDE ( __call_phy_open_fe_bb_clk = 0x40001228 ) ;
  PROVIDE ( __call_phy_open_i2c_xpd = 0x40001324 ) ;
  PROVIDE ( __call_phy_param_addr = 0x400010dc ) ;
  PROVIDE ( __call_phy_pbus_clear_reg = 0x4000125c ) ;
  PROVIDE ( __call_phy_pbus_debugmode = 0x40001254 ) ;
  PROVIDE ( __call_phy_pbus_force_mode = 0x40001244 ) ;
  PROVIDE ( __call_phy_pbus_force_test = 0x4000124c ) ;
  PROVIDE ( __call_phy_pbus_rd = 0x40001250 ) ;
  PROVIDE ( __call_phy_pbus_rd_addr_ = 0x40001248 ) ;
  PROVIDE ( __call_phy_pbus_reg_store = 0x40001280 ) ;
  PROVIDE ( __call_phy_pbus_rx_dco_cal = 0x40001408 ) ;
  PROVIDE ( __call_phy_pbus_set_dco = 0x40001264 ) ;
  PROVIDE ( __call_phy_pbus_set_rftx1_5g = 0x40001294 ) ;
  PROVIDE ( __call_phy_pbus_set_rxgain = 0x40001260 ) ;
  PROVIDE ( __call_phy_pbus_workmode = 0x40001258 ) ;
  PROVIDE ( __call_phy_pbus_xpd_iq_path = 0x40001290 ) ;
  PROVIDE ( __call_phy_pbus_xpd_rx_off = 0x40001528 ) ;
  PROVIDE ( __call_phy_pbus_xpd_rx_on = 0x40001530 ) ;
  PROVIDE ( __call_phy_pbus_xpd_tx_off = 0x40001540 ) ;
  PROVIDE ( __call_phy_pbus_xpd_tx_on = 0x40001534 ) ;
  PROVIDE ( __call_phy_pkdadc_set = 0x40001388 ) ;
  PROVIDE ( __call_phy_pkdet_vol_start = 0x400012c8 ) ;
  PROVIDE ( __call_phy_pll_cap_mem_update = 0x400011a0 ) ;
  PROVIDE ( __call_phy_pwdet_code_cal = 0x40001490 ) ;
  PROVIDE ( __call_phy_pwdet_ref_code = 0x4000148c ) ;
  PROVIDE ( __call_phy_pwdet_reg_init = 0x40001298 ) ;
  PROVIDE ( __call_phy_pwdet_sar2_init = 0x4000129c ) ;
  PROVIDE ( __call_phy_pwdet_tone_start = 0x400012a8 ) ;
  PROVIDE ( __call_phy_pwdet_wait_idle = 0x400012c4 ) ;
  PROVIDE ( __call_phy_rate_to_index = 0x400010e8 ) ;
  PROVIDE ( __call_phy_rc_cal = 0x400010fc ) ;
  PROVIDE ( __call_phy_read_hw_noisefloor = 0x40001350 ) ;
  PROVIDE ( __call_phy_read_rf_freq_mem = 0x4000118c ) ;
  PROVIDE ( __call_phy_read_sar2_code = 0x400012d0 ) ;
  PROVIDE ( __call_phy_read_sar_dout = 0x400012cc ) ;
  PROVIDE ( __call_phy_rf_cal_data_backup = 0x4000123c ) ;
  PROVIDE ( __call_phy_rf_cal_data_recovery = 0x40001238 ) ;
  PROVIDE ( __call_phy_rfagc_disable = 0x40001384 ) ;
  PROVIDE ( __call_phy_rfcal_data_check = 0x40001240 ) ;
  PROVIDE ( __call_phy_rfcal_data_sub = 0x40001234 ) ;
  PROVIDE ( __call_phy_rfcal_pwrctrl = 0x400014ac ) ;
  PROVIDE ( __call_phy_rfcal_rxiq = 0x400013fc ) ;
  PROVIDE ( __call_phy_rfcal_txcap = 0x40001494 ) ;
  PROVIDE ( __call_phy_rfcal_txiq = 0x40001484 ) ;
  PROVIDE ( __call_phy_rfrx_gain_index = 0x40001434 ) ;
  PROVIDE ( __call_phy_rx11blr_cfg = 0x40001168 ) ;
  PROVIDE ( __call_phy_rx_dco_cal_1step = 0x40001410 ) ;
  PROVIDE ( __call_phy_rx_gain_force = 0x40001334 ) ;
  PROVIDE ( __call_phy_rx_pkdet_dc_cal = 0x400012dc ) ;
  PROVIDE ( __call_phy_rx_sense_set = 0x4000136c ) ;
  PROVIDE ( __call_phy_rxdc_est_min = 0x4000140c ) ;
  PROVIDE ( __call_phy_rxiq_cover_mg_mp = 0x400013f8 ) ;
  PROVIDE ( __call_phy_rxiq_get_mis = 0x400013f4 ) ;
  PROVIDE ( __call_phy_rxiq_opt = 0x40001418 ) ;
  PROVIDE ( __call_phy_rxiq_set_reg = 0x40001330 ) ;
  PROVIDE ( __call_phy_set_bb_wdg = 0x400013bc ) ;
  PROVIDE ( __call_phy_set_cal_rxdc = 0x400013f0 ) ;
  PROVIDE ( __call_phy_set_cca = 0x4000116c ) ;
  PROVIDE ( __call_phy_set_chan_interp = 0x40001104 ) ;
  PROVIDE ( __call_phy_set_chan_reg = 0x4000111c ) ;
  PROVIDE ( __call_phy_set_lb_txiq = 0x40001414 ) ;
  PROVIDE ( __call_phy_set_loopback_gain = 0x40001268 ) ;
  PROVIDE ( __call_phy_set_mac_data = 0x40001230 ) ;
  PROVIDE ( __call_phy_set_most_tpw = 0x4000112c ) ;
  PROVIDE ( __call_phy_set_pbus_mem = 0x40001284 ) ;
  PROVIDE ( __call_phy_set_pbus_mem_2g = 0x40001278 ) ;
  PROVIDE ( __call_phy_set_pbus_mem_5g = 0x4000127c ) ;
  PROVIDE ( __call_phy_set_pbus_reg = 0x4000137c ) ;
  PROVIDE ( __call_phy_set_rx_comp_ = 0x40001314 ) ;
  PROVIDE ( __call_phy_set_rx_gain_cal_dc = 0x40001420 ) ;
  PROVIDE ( __call_phy_set_rx_gain_cal_iq = 0x4000141c ) ;
  PROVIDE ( __call_phy_set_rx_pbus_freq = 0x4000128c ) ;
  PROVIDE ( __call_phy_set_rx_sense = 0x40001170 ) ;
  PROVIDE ( __call_phy_set_rxclk_en = 0x4000133c ) ;
  PROVIDE ( __call_phy_set_tsens_power_ = 0x40001444 ) ;
  PROVIDE ( __call_phy_set_tx_gain_mem = 0x400014dc ) ;
  PROVIDE ( __call_phy_set_txcap_reg = 0x400011f8 ) ;
  PROVIDE ( __call_phy_set_txclk_en = 0x40001338 ) ;
  PROVIDE ( __call_phy_sifs_reg_init = 0x400013c0 ) ;
  PROVIDE ( __call_phy_spur_cal = 0x40001428 ) ;
  PROVIDE ( __call_phy_spur_coef_cfg = 0x4000142c ) ;
  PROVIDE ( __call_phy_spur_reg_write = 0x40001424 ) ;
  PROVIDE ( __call_phy_start_tx_tone_step = 0x40001340 ) ;
  PROVIDE ( __call_phy_stop_tx_tone = 0x40001344 ) ;
  PROVIDE ( __call_phy_temp_to_power_ = 0x40001468 ) ;
  PROVIDE ( __call_phy_tsens_code_read = 0x4000145c ) ;
  PROVIDE ( __call_phy_tsens_dac_cal = 0x40001458 ) ;
  PROVIDE ( __call_phy_tsens_dac_to_index = 0x40001454 ) ;
  PROVIDE ( __call_phy_tsens_read_init = 0x4000144c ) ;
  PROVIDE ( __call_phy_tsens_temp_read = 0x40001460 ) ;
  PROVIDE ( __call_phy_tsens_temp_read_local = 0x40001464 ) ;
  PROVIDE ( __call_phy_tx_paon_set = 0x400012f8 ) ;
  PROVIDE ( __call_phy_tx_pwctrl_init = 0x400014b8 ) ;
  PROVIDE ( __call_phy_tx_pwctrl_init_cal = 0x400014b4 ) ;
  PROVIDE ( __call_phy_tx_state_out = 0x40001134 ) ;
  PROVIDE ( __call_phy_tx_state_set = 0x40001370 ) ;
  PROVIDE ( __call_phy_txbbgain_to_index = 0x400014c0 ) ;
  PROVIDE ( __call_phy_txcal_debuge_mode_ = 0x4000126c ) ;
  PROVIDE ( __call_phy_txcal_work_mode = 0x40001270 ) ;
  PROVIDE ( __call_phy_txcap_setting = 0x40001498 ) ;
  PROVIDE ( __call_phy_txdc_cal = 0x40001474 ) ;
  PROVIDE ( __call_phy_txdc_cal_pwdet = 0x40001478 ) ;
  PROVIDE ( __call_phy_txiq_cover = 0x40001480 ) ;
  PROVIDE ( __call_phy_txiq_get_mis_pwr = 0x4000147c ) ;
  PROVIDE ( __call_phy_txiq_set_reg = 0x4000132c ) ;
  PROVIDE ( __call_phy_txtone_linear_pwr = 0x400012b4 ) ;
  PROVIDE ( __call_phy_vht_support = 0x400013a8 ) ;
  PROVIDE ( __call_phy_wait_freq_set_busy = 0x400011ac ) ;
  PROVIDE ( __call_phy_wifi_11g_rate_chg = 0x400014d4 ) ;
  PROVIDE ( __call_phy_wifi_agc_sat_gain = 0x40001358 ) ;
  PROVIDE ( __call_phy_wifi_enable_set = 0x400013a0 ) ;
  PROVIDE ( __call_phy_wifi_fbw_sel = 0x40001364 ) ;
  PROVIDE ( __call_phy_wifi_get_target_power = 0x400014ec ) ;
  PROVIDE ( __call_phy_wifi_get_tx_gain = 0x400014d0 ) ;
  PROVIDE ( __call_phy_wifi_get_tx_tab_ = 0x400014f0 ) ;
  PROVIDE ( __call_phy_wifi_rifs_mode_en = 0x40001380 ) ;
  PROVIDE ( __call_phy_wifi_set_tx_gain = 0x400014f4 ) ;
  PROVIDE ( __call_phy_wr_freq_mem = 0x40001188 ) ;
  PROVIDE ( __call_phy_wr_rx_gain_mem = 0x40001440 ) ;
  PROVIDE ( __call_phy_write_chan_freq = 0x4000117c ) ;
  PROVIDE ( __call_phy_write_gain_mem = 0x400012f0 ) ;
  PROVIDE ( __call_phy_write_pbus_mem = 0x40001274 ) ;
  PROVIDE ( __call_pm_allow_tx = 0x40000dc4 ) ;
  PROVIDE ( __call_pm_beacon_monitor_tbtt_start = 0x40001514 ) ;
  PROVIDE ( __call_pm_beacon_monitor_tbtt_timeout_process = 0x40000e00 ) ;
  PROVIDE ( __call_pm_beacon_offset_add_loss_counter = 0x400015c8 ) ;
  PROVIDE ( __call_pm_beacon_offset_add_total_counter = 0x400015c4 ) ;
  PROVIDE ( __call_pm_beacon_offset_check = 0x400015cc ) ;
  PROVIDE ( __call_pm_beacon_offset_get_average = 0x400015d0 ) ;
  PROVIDE ( __call_pm_beacon_offset_get_expect = 0x400015d4 ) ;
  PROVIDE ( __call_pm_beacon_offset_get_params = 0x400015d8 ) ;
  PROVIDE ( __call_pm_beacon_offset_is_enabled = 0x400015bc ) ;
  PROVIDE ( __call_pm_beacon_offset_is_sampling = 0x400015c0 ) ;
  PROVIDE ( __call_pm_check_state = 0x40000d48 ) ;
  PROVIDE ( __call_pm_clear_wakeup_signal = 0x40000e0c ) ;
  PROVIDE ( __call_pm_coex_pwr_update = 0x40001508 ) ;
  PROVIDE ( __call_pm_coex_schm_overall_period_get = 0x40001504 ) ;
  PROVIDE ( __call_pm_disable_dream_timer = 0x40000d4c ) ;
  PROVIDE ( __call_pm_disable_sleep_delay_timer = 0x40000d50 ) ;
  PROVIDE ( __call_pm_disconnected_wake = 0x40000dd4 ) ;
  PROVIDE ( __call_pm_dream = 0x40000d54 ) ;
  PROVIDE ( __call_pm_enable_active_timer = 0x40000d60 ) ;
  PROVIDE ( __call_pm_enable_max_idle_timer = 0x400015b8 ) ;
  PROVIDE ( __call_pm_enable_sleep_delay_timer = 0x40000d64 ) ;
  PROVIDE ( __call_pm_enable_twt_keep_alive = 0x40000de0 ) ;
  PROVIDE ( __call_pm_enable_twt_keep_alive_timer = 0x40000df8 ) ;
  PROVIDE ( __call_pm_extend_tbtt_adaptive_servo = 0x40000dc8 ) ;
  PROVIDE ( __call_pm_get_tbtt_count = 0x4000151c ) ;
  PROVIDE ( __call_pm_is_in_wifi_slice_threshold = 0x40000d70 ) ;
  PROVIDE ( __call_pm_is_twt_awake = 0x40000ddc ) ;
  PROVIDE ( __call_pm_is_twt_start = 0x40000dec ) ;
  PROVIDE ( __call_pm_is_waked = 0x40000d74 ) ;
  PROVIDE ( __call_pm_keep_alive = 0x40000d78 ) ;
  PROVIDE ( __call_pm_local_tsf_process = 0x40000d68 ) ;
  PROVIDE ( __call_pm_mac_disable_tsf_tbtt_modem_wakeup = 0x40000e14 ) ;
  PROVIDE ( __call_pm_mac_disable_tsf_tbtt_soc_wakeup = 0x40000e10 ) ;
  PROVIDE ( __call_pm_mac_enable_tsf_tbtt_modem_wakeup = 0x40000e1c ) ;
  PROVIDE ( __call_pm_mac_enable_tsf_tbtt_soc_wakeup = 0x40000e18 ) ;
  PROVIDE ( __call_pm_mac_modem_params_rt_update = 0x40000e20 ) ;
  PROVIDE ( __call_pm_mac_sleep = 0x40000d5c ) ;
  PROVIDE ( __call_pm_mac_try_enable_modem_state = 0x40000dfc ) ;
  PROVIDE ( __call_pm_mac_wakeup = 0x40000d58 ) ;
  PROVIDE ( __call_pm_on_beacon_rx = 0x40000d7c ) ;
  PROVIDE ( __call_pm_on_data_rx = 0x40000d80 ) ;
  PROVIDE ( __call_pm_on_data_tx = 0x40000d84 ) ;
  PROVIDE ( __call_pm_on_isr = 0x40000d90 ) ;
  PROVIDE ( __call_pm_on_isr_set_twt_target = 0x40000d94 ) ;
  PROVIDE ( __call_pm_on_isr_sleep = 0x40000d8c ) ;
  PROVIDE ( __call_pm_on_isr_twt_wake = 0x40000d98 ) ;
  PROVIDE ( __call_pm_on_tbtt = 0x40000d88 ) ;
  PROVIDE ( __call_pm_on_tsf_timer = 0x40000d9c ) ;
  PROVIDE ( __call_pm_on_twt_force_tx = 0x40000da0 ) ;
  PROVIDE ( __call_pm_parse_beacon = 0x40000da4 ) ;
  PROVIDE ( __call_pm_parse_mbssid_element = 0x40000dd0 ) ;
  PROVIDE ( __call_pm_process_tim = 0x40000da8 ) ;
  PROVIDE ( __call_pm_rx_beacon_process = 0x40000dac ) ;
  PROVIDE ( __call_pm_rx_data_process = 0x40000db0 ) ;
  PROVIDE ( __call_pm_save_tbtt_info = 0x40001518 ) ;
  PROVIDE ( __call_pm_scale_listen_interval = 0x40000dcc ) ;
  PROVIDE ( __call_pm_set_beacon_filter = 0x40000d6c ) ;
  PROVIDE ( __call_pm_sleep = 0x40000db4 ) ;
  PROVIDE ( __call_pm_sleep_for = 0x40000db8 ) ;
  PROVIDE ( __call_pm_tbtt_process = 0x40000dbc ) ;
  PROVIDE ( __call_pm_twt_disallow_tx = 0x40000e08 ) ;
  PROVIDE ( __call_pm_twt_on_tsf_timer = 0x40000de4 ) ;
  PROVIDE ( __call_pm_twt_process = 0x40000de8 ) ;
  PROVIDE ( __call_pm_twt_set_target_tsf = 0x40000df4 ) ;
  PROVIDE ( __call_pm_twt_set_target_wdev_time = 0x40000df0 ) ;
  PROVIDE ( __call_pm_tx_data_done_process = 0x40000dc0 ) ;
  PROVIDE ( __call_pm_tx_data_process = 0x40000dd8 ) ;
  PROVIDE ( __call_pm_update_at_next_beacon = 0x40000e24 ) ;
  PROVIDE ( __call_pm_update_next_tbtt = 0x40000e04 ) ;
  PROVIDE ( __call_pmu_enable_unhold_pads = 0x40000020 ) ;
  PROVIDE ( __call_ppAMPDU2Normal = 0x40000e30 ) ;
  PROVIDE ( __call_ppAdd2AMPDUTail = 0x40000f0c ) ;
  PROVIDE ( __call_ppAssembleAMPDU = 0x40000e38 ) ;
  PROVIDE ( __call_ppCalDeliNum = 0x40000ef0 ) ;
  PROVIDE ( __call_ppCalFrameTimes = 0x40000e3c ) ;
  PROVIDE ( __call_ppCalPreFecPaddingFactor = 0x40000eec ) ;
  PROVIDE ( __call_ppCalSubFrameLength = 0x40000e40 ) ;
  PROVIDE ( __call_ppCalTxAMPDULength = 0x40000e44 ) ;
  PROVIDE ( __call_ppCalTxHEAMPDULength = 0x40000f04 ) ;
  PROVIDE ( __call_ppCalTxVHTSMPDULength = 0x40000edc ) ;
  PROVIDE ( __call_ppCalVHTDeliNum = 0x40000ed8 ) ;
  PROVIDE ( __call_ppCertSetRate = 0x40000efc ) ;
  PROVIDE ( __call_ppCheckTxAMPDUlength = 0x40000e48 ) ;
  PROVIDE ( __call_ppCheckTxHEAMPDUlength = 0x40000ef8 ) ;
  PROVIDE ( __call_ppCheckTxRTS = 0x40000ee0 ) ;
  PROVIDE ( __call_ppDequeueRxq_Locked = 0x40000e4c ) ;
  PROVIDE ( __call_ppDequeueTxDone_Locked = 0x40000ec4 ) ;
  PROVIDE ( __call_ppDequeueTxQ = 0x40000e50 ) ;
  PROVIDE ( __call_ppDirectRecycleAmpdu = 0x40000f10 ) ;
  PROVIDE ( __call_ppDisableQueue = 0x40000ed4 ) ;
  PROVIDE ( __call_ppEmptyDelimiterLength = 0x40000e54 ) ;
  PROVIDE ( __call_ppEnqueueRxq = 0x40000e58 ) ;
  PROVIDE ( __call_ppEnqueueTxDone = 0x40000e5c ) ;
  PROVIDE ( __call_ppGetTxframe = 0x40000e60 ) ;
  PROVIDE ( __call_ppHEAMPDU2Normal = 0x40000e34 ) ;
  PROVIDE ( __call_ppMapTxQueue = 0x40000e64 ) ;
  PROVIDE ( __call_ppMapWaitTxq = 0x40000ecc ) ;
  PROVIDE ( __call_ppProcTxCallback = 0x40000ee8 ) ;
  PROVIDE ( __call_ppProcTxDone = 0x40000ec8 ) ;
  PROVIDE ( __call_ppProcTxSecFrame = 0x40000e68 ) ;
  PROVIDE ( __call_ppProcessLifeTime = 0x40000ee4 ) ;
  PROVIDE ( __call_ppProcessRxPktHdr = 0x40000e6c ) ;
  PROVIDE ( __call_ppProcessTxQ = 0x40000e70 ) ;
  PROVIDE ( __call_ppProcessWaitingQueue = 0x40000ed0 ) ;
  PROVIDE ( __call_ppRecordBarRRC = 0x40000e74 ) ;
  PROVIDE ( __call_ppRecycleAmpdu = 0x40000e78 ) ;
  PROVIDE ( __call_ppRecycleRxPkt = 0x40000e7c ) ;
  PROVIDE ( __call_ppRegressAmpdu = 0x40000f14 ) ;
  PROVIDE ( __call_ppRemoveHEAMPDUflags = 0x4000150c ) ;
  PROVIDE ( __call_ppRemoveHTC = 0x40000ef4 ) ;
  PROVIDE ( __call_ppResortTxAMPDU = 0x40000e80 ) ;
  PROVIDE ( __call_ppResumeTxAMPDU = 0x40000e84 ) ;
  PROVIDE ( __call_ppRxFragmentProc = 0x40000e88 ) ;
  PROVIDE ( __call_ppRxPkt = 0x40000e8c ) ;
  PROVIDE ( __call_ppRxProtoProc = 0x40000e90 ) ;
  PROVIDE ( __call_ppSearchTxQueue = 0x40000e94 ) ;
  PROVIDE ( __call_ppSearchTxframe = 0x40000e98 ) ;
  PROVIDE ( __call_ppSelectNextQueue = 0x40000e9c ) ;
  PROVIDE ( __call_ppSelectTxFormat = 0x40000f00 ) ;
  PROVIDE ( __call_ppSubFromAMPDU = 0x40000ea0 ) ;
  PROVIDE ( __call_ppTask = 0x40000ea4 ) ;
  PROVIDE ( __call_ppTxPkt = 0x40000ea8 ) ;
  PROVIDE ( __call_ppTxProtoProc = 0x40000eac ) ;
  PROVIDE ( __call_ppTxqUpdateBitmap = 0x40000eb0 ) ;
  PROVIDE ( __call_pp_coex_tx_release = 0x40000f08 ) ;
  PROVIDE ( __call_pp_coex_tx_request = 0x40000eb4 ) ;
  PROVIDE ( __call_pp_hdrsize = 0x40000eb8 ) ;
  PROVIDE ( __call_pp_post = 0x40000ebc ) ;
  PROVIDE ( __call_pp_process_hmac_waiting_txq = 0x40000ec0 ) ;
  PROVIDE ( __call_pp_timer_do_process = 0x40000f18 ) ;
  PROVIDE ( __call_printf = 0x40000600 ) ;
  PROVIDE ( __call_pwr_hal_clear_mac_modem_state_wakeup_protect_signal = 0x400010d0 ) ;
  PROVIDE ( __call_qsort = 0x40000598 ) ;
  PROVIDE ( __call_rand = 0x400005a0 ) ;
  PROVIDE ( __call_rand_r = 0x4000059c ) ;
  PROVIDE ( __call_rcAmpduLowerRate = 0x40000f2c ) ;
  PROVIDE ( __call_rcClearCurAMPDUSched = 0x40000f34 ) ;
  PROVIDE ( __call_rcClearCurSched = 0x40000f38 ) ;
  PROVIDE ( __call_rcClearCurStat = 0x40000f3c ) ;
  PROVIDE ( __call_rcGetAmpduSched = 0x40000f1c ) ;
  PROVIDE ( __call_rcGetDCMMaxRate = 0x40000f68 ) ;
  PROVIDE ( __call_rcGetRate = 0x40000f70 ) ;
  PROVIDE ( __call_rcGetSMPDURate = 0x40000f6c ) ;
  PROVIDE ( __call_rcGetSched = 0x40000f40 ) ;
  PROVIDE ( __call_rcLowerSched = 0x40000f44 ) ;
  PROVIDE ( __call_rcReachRetryLimit = 0x40000f64 ) ;
  PROVIDE ( __call_rcSetTxAmpduLimit = 0x40000f48 ) ;
  PROVIDE ( __call_rcTxUpdatePer = 0x40000f4c ) ;
  PROVIDE ( __call_rcUpSched = 0x40000f60 ) ;
  PROVIDE ( __call_rcUpdateAckSnr = 0x40000f50 ) ;
  PROVIDE ( __call_rcUpdateRate = 0x40000f54 ) ;
  PROVIDE ( __call_rcUpdateRxDone = 0x40000f20 ) ;
  PROVIDE ( __call_rcUpdateTxDone = 0x40000f58 ) ;
  PROVIDE ( __call_rcUpdateTxDoneAmpdu2 = 0x40000f5c ) ;
  PROVIDE ( __call_rc_get_trc = 0x40000f24 ) ;
  PROVIDE ( __call_rc_get_trc_by_index = 0x40000f28 ) ;
  PROVIDE ( __call_rcampduuprate = 0x40000f30 ) ;
  PROVIDE ( __call_recv_packet = 0x400000b4 ) ;
  PROVIDE ( __call_roundup2 = 0x4000008c ) ;
  PROVIDE ( __call_rssi_margin = 0x40000f7c ) ;
  PROVIDE ( __call_rtc_get_reset_reason = 0x40000018 ) ;
  PROVIDE ( __call_rtc_get_wakeup_cause = 0x4000001c ) ;
  PROVIDE ( __call_rx11AXRate2AMPDULimit = 0x40000f74 ) ;
  PROVIDE ( __call_rx11NRate2AMPDULimit = 0x40000f78 ) ;
  PROVIDE ( __call_sbrk = 0x400004e8 ) ;
  PROVIDE ( __call_send_packet = 0x400000b0 ) ;
  PROVIDE ( __call_setjmp = 0x40000584 ) ;
  PROVIDE ( __call_sip_after_tx_complete = 0x40001550 ) ;
  PROVIDE ( __call_sip_alloc_to_host_evt = 0x40001554 ) ;
  PROVIDE ( __call_sip_download_begin = 0x40001558 ) ;
  PROVIDE ( __call_sip_get_ptr = 0x4000155c ) ;
  PROVIDE ( __call_sip_get_state = 0x40001560 ) ;
  PROVIDE ( __call_sip_init_attach = 0x40001564 ) ;
  PROVIDE ( __call_sip_install_rx_ctrl_cb = 0x40001568 ) ;
  PROVIDE ( __call_sip_install_rx_data_cb = 0x4000156c ) ;
  PROVIDE ( __call_sip_is_active = 0x40001570 ) ;
  PROVIDE ( __call_sip_post_init = 0x40001574 ) ;
  PROVIDE ( __call_sip_reclaim_from_host_cmd = 0x40001578 ) ;
  PROVIDE ( __call_sip_reclaim_tx_data_pkt = 0x4000157c ) ;
  PROVIDE ( __call_sip_send = 0x40001580 ) ;
  PROVIDE ( __call_sip_to_host_chain_append = 0x40001584 ) ;
  PROVIDE ( __call_sip_to_host_evt_send_done = 0x40001588 ) ;
  PROVIDE ( __call_siprintf = 0x40000618 ) ;
  PROVIDE ( __call_slc_add_credits = 0x4000158c ) ;
  PROVIDE ( __call_slc_enable = 0x40001590 ) ;
  PROVIDE ( __call_slc_from_host_chain_fetch = 0x40001594 ) ;
  PROVIDE ( __call_slc_from_host_chain_recycle = 0x40001598 ) ;
  PROVIDE ( __call_slc_has_pkt_to_host = 0x4000159c ) ;
  PROVIDE ( __call_slc_init_attach = 0x400015a0 ) ;
  PROVIDE ( __call_slc_init_credit = 0x400015a4 ) ;
  PROVIDE ( __call_slc_reattach = 0x400015a8 ) ;
  PROVIDE ( __call_slc_send_to_host_chain = 0x400015ac ) ;
  PROVIDE ( __call_slc_set_host_io_max_window = 0x400015b0 ) ;
  PROVIDE ( __call_slc_to_host_chain_recycle = 0x400015b4 ) ;
  PROVIDE ( __call_sniprintf = 0x4000061c ) ;
  PROVIDE ( __call_snprintf = 0x40000614 ) ;
  PROVIDE ( __call_software_reset = 0x40000094 ) ;
  PROVIDE ( __call_software_reset_cpu = 0x40000098 ) ;
  PROVIDE ( __call_spi_cache_mode_switch = 0x400001a0 ) ;
  PROVIDE ( __call_spi_common_set_dummy_output = 0x400001a4 ) ;
  PROVIDE ( __call_spi_common_set_flash_cs_timing = 0x400001a8 ) ;
  PROVIDE ( __call_spi_dummy_len_fix = 0x400001e4 ) ;
  PROVIDE ( __call_spi_flash_attach = 0x400001f0 ) ;
  PROVIDE ( __call_spi_flash_boot_attach = 0x40000280 ) ;
  PROVIDE ( __call_spi_flash_cache2phys = 0x40000238 ) ;
  PROVIDE ( __call_spi_flash_cache_enabled = 0x4000020c ) ;
  PROVIDE ( __call_spi_flash_check_and_flush_cache = 0x40000230 ) ;
  PROVIDE ( __call_spi_flash_chip_gd_get_io_mode = 0x40000304 ) ;
  PROVIDE ( __call_spi_flash_chip_gd_probe = 0x40000308 ) ;
  PROVIDE ( __call_spi_flash_chip_gd_set_io_mode = 0x4000030c ) ;
  PROVIDE ( __call_spi_flash_chip_generic_config_host_io_mode = 0x400002d4 ) ;
  PROVIDE ( __call_spi_flash_chip_generic_detect_size = 0x40000294 ) ;
  PROVIDE ( __call_spi_flash_chip_generic_erase_block = 0x400002b4 ) ;
  PROVIDE ( __call_spi_flash_chip_generic_erase_chip = 0x400002ac ) ;
  PROVIDE ( __call_spi_flash_chip_generic_erase_sector = 0x400002b0 ) ;
  PROVIDE ( __call_spi_flash_chip_generic_get_caps = 0x400002fc ) ;
  PROVIDE ( __call_spi_flash_chip_generic_get_io_mode = 0x400002e0 ) ;
  PROVIDE ( __call_spi_flash_chip_generic_get_write_protect = 0x400002bc ) ;
  PROVIDE ( __call_spi_flash_chip_generic_page_program = 0x400002b8 ) ;
  PROVIDE ( __call_spi_flash_chip_generic_probe = 0x40000290 ) ;
  PROVIDE ( __call_spi_flash_chip_generic_read = 0x400002d8 ) ;
  PROVIDE ( __call_spi_flash_chip_generic_read_reg = 0x400002c4 ) ;
  PROVIDE ( __call_spi_flash_chip_generic_read_unique_id = 0x400002f8 ) ;
  PROVIDE ( __call_spi_flash_chip_generic_reset = 0x400002a8 ) ;
  PROVIDE ( __call_spi_flash_chip_generic_set_io_mode = 0x400002f4 ) ;
  PROVIDE ( __call_spi_flash_chip_generic_set_write_protect = 0x400002a0 ) ;
  PROVIDE ( __call_spi_flash_chip_generic_suspend_cmd_conf = 0x40000300 ) ;
  PROVIDE ( __call_spi_flash_chip_generic_wait_idle = 0x400002d0 ) ;
  PROVIDE ( __call_spi_flash_chip_generic_write = 0x40000298 ) ;
  PROVIDE ( __call_spi_flash_chip_generic_write_encrypted = 0x4000029c ) ;
  PROVIDE ( __call_spi_flash_chip_generic_yield = 0x400002c8 ) ;
  PROVIDE ( __call_spi_flash_common_read_status_16b_rdsr_rdsr2 = 0x400002c0 ) ;
  PROVIDE ( __call_spi_flash_common_read_status_8b_rdsr = 0x400002e4 ) ;
  PROVIDE ( __call_spi_flash_common_read_status_8b_rdsr2 = 0x400002dc ) ;
  PROVIDE ( __call_spi_flash_common_set_io_mode = 0x400002f0 ) ;
  PROVIDE ( __call_spi_flash_common_write_status_16b_wrsr = 0x400002a4 ) ;
  PROVIDE ( __call_spi_flash_common_write_status_8b_wrsr = 0x400002e8 ) ;
  PROVIDE ( __call_spi_flash_common_write_status_8b_wrsr2 = 0x400002ec ) ;
  PROVIDE ( __call_spi_flash_disable_cache = 0x40000204 ) ;
  PROVIDE ( __call_spi_flash_enable_cache = 0x40000210 ) ;
  PROVIDE ( __call_spi_flash_encryption_hal_check = 0x400003a0 ) ;
  PROVIDE ( __call_spi_flash_encryption_hal_destroy = 0x4000039c ) ;
  PROVIDE ( __call_spi_flash_encryption_hal_disable = 0x40000390 ) ;
  PROVIDE ( __call_spi_flash_encryption_hal_done = 0x40000398 ) ;
  PROVIDE ( __call_spi_flash_encryption_hal_enable = 0x4000038c ) ;
  PROVIDE ( __call_spi_flash_encryption_hal_prepare = 0x40000394 ) ;
  PROVIDE ( __call_spi_flash_generic_wait_host_idle = 0x400002cc ) ;
  PROVIDE ( __call_spi_flash_get_chip_size = 0x400001f4 ) ;
  PROVIDE ( __call_spi_flash_guard_get = 0x400001fc ) ;
  PROVIDE ( __call_spi_flash_guard_set = 0x400001f8 ) ;
  PROVIDE ( __call_spi_flash_hal_check_status = 0x4000036c ) ;
  PROVIDE ( __call_spi_flash_hal_common_command = 0x4000034c ) ;
  PROVIDE ( __call_spi_flash_hal_configure_host_io_mode = 0x40000348 ) ;
  PROVIDE ( __call_spi_flash_hal_device_config = 0x40000344 ) ;
  PROVIDE ( __call_spi_flash_hal_disable_auto_resume_mode = 0x40000380 ) ;
  PROVIDE ( __call_spi_flash_hal_disable_auto_suspend_mode = 0x4000037c ) ;
  PROVIDE ( __call_spi_flash_hal_erase_block = 0x4000035c ) ;
  PROVIDE ( __call_spi_flash_hal_erase_chip = 0x40000354 ) ;
  PROVIDE ( __call_spi_flash_hal_erase_sector = 0x40000358 ) ;
  PROVIDE ( __call_spi_flash_hal_host_idle = 0x40000368 ) ;
  PROVIDE ( __call_spi_flash_hal_poll_cmd_done = 0x40000340 ) ;
  PROVIDE ( __call_spi_flash_hal_program_page = 0x40000360 ) ;
  PROVIDE ( __call_spi_flash_hal_read = 0x40000350 ) ;
  PROVIDE ( __call_spi_flash_hal_resume = 0x40000384 ) ;
  PROVIDE ( __call_spi_flash_hal_set_write_protect = 0x40000364 ) ;
  PROVIDE ( __call_spi_flash_hal_setup_auto_resume_mode = 0x40000378 ) ;
  PROVIDE ( __call_spi_flash_hal_setup_auto_suspend_mode = 0x40000374 ) ;
  PROVIDE ( __call_spi_flash_hal_setup_read_suspend = 0x40000370 ) ;
  PROVIDE ( __call_spi_flash_hal_suspend = 0x40000388 ) ;
  PROVIDE ( __call_spi_flash_mmap = 0x40000220 ) ;
  PROVIDE ( __call_spi_flash_mmap_dump = 0x4000022c ) ;
  PROVIDE ( __call_spi_flash_mmap_get_free_pages = 0x40000234 ) ;
  PROVIDE ( __call_spi_flash_mmap_os_func_set = 0x40000218 ) ;
  PROVIDE ( __call_spi_flash_mmap_page_num_init = 0x4000021c ) ;
  PROVIDE ( __call_spi_flash_mmap_pages = 0x40000224 ) ;
  PROVIDE ( __call_spi_flash_munmap = 0x40000228 ) ;
  PROVIDE ( __call_spi_flash_phys2cache = 0x4000023c ) ;
  PROVIDE ( __call_spi_flash_read_encrypted = 0x40000200 ) ;
  PROVIDE ( __call_spi_flash_restore_cache = 0x40000208 ) ;
  PROVIDE ( __call_sprintf = 0x40000610 ) ;
  PROVIDE ( __call_srand = 0x400005a4 ) ;
  PROVIDE ( __call_sta_get_beacon_timeout = 0x40000be0 ) ;
  PROVIDE ( __call_sta_input = 0x40000bd4 ) ;
  PROVIDE ( __call_sta_reset_beacon_timeout = 0x40000bdc ) ;
  PROVIDE ( __call_sta_rx_eapol = 0x40000bd8 ) ;
  PROVIDE ( __call_strcasecmp = 0x40000534 ) ;
  PROVIDE ( __call_strcasestr = 0x40000538 ) ;
  PROVIDE ( __call_strcat = 0x4000053c ) ;
  PROVIDE ( __call_strchr = 0x40000544 ) ;
  PROVIDE ( __call_strcmp = 0x400004d0 ) ;
  PROVIDE ( __call_strcoll = 0x4000054c ) ;
  PROVIDE ( __call_strcpy = 0x400004c8 ) ;
  PROVIDE ( __call_strcspn = 0x40000548 ) ;
  PROVIDE ( __call_strdup = 0x40000540 ) ;
  PROVIDE ( __call_strlcat = 0x40000550 ) ;
  PROVIDE ( __call_strlcpy = 0x40000554 ) ;
  PROVIDE ( __call_strlen = 0x400004d8 ) ;
  PROVIDE ( __call_strlwr = 0x40000558 ) ;
  PROVIDE ( __call_strncasecmp = 0x4000055c ) ;
  PROVIDE ( __call_strncat = 0x40000560 ) ;
  PROVIDE ( __call_strncmp = 0x400004d4 ) ;
  PROVIDE ( __call_strncpy = 0x400004cc ) ;
  PROVIDE ( __call_strndup = 0x40000564 ) ;
  PROVIDE ( __call_strnlen = 0x40000568 ) ;
  PROVIDE ( __call_strrchr = 0x4000056c ) ;
  PROVIDE ( __call_strsep = 0x40000570 ) ;
  PROVIDE ( __call_strspn = 0x40000574 ) ;
  PROVIDE ( __call_strstr = 0x400004dc ) ;
  PROVIDE ( __call_strtok_r = 0x40000578 ) ;
  PROVIDE ( __call_strtol = 0x400005b8 ) ;
  PROVIDE ( __call_strtoul = 0x400005bc ) ;
  PROVIDE ( __call_strupr = 0x4000057c ) ;
  PROVIDE ( __call_systimer_hal_connect_alarm_counter = 0x40000404 ) ;
  PROVIDE ( __call_systimer_hal_counter_can_stall_by_cpu = 0x40000408 ) ;
  PROVIDE ( __call_systimer_hal_counter_value_advance = 0x400003f8 ) ;
  PROVIDE ( __call_systimer_hal_deinit = 0x400003d4 ) ;
  PROVIDE ( __call_systimer_hal_enable_alarm_int = 0x400003f0 ) ;
  PROVIDE ( __call_systimer_hal_enable_counter = 0x400003fc ) ;
  PROVIDE ( __call_systimer_hal_get_alarm_value = 0x400003ec ) ;
  PROVIDE ( __call_systimer_hal_get_counter_value = 0x400003dc ) ;
  PROVIDE ( __call_systimer_hal_get_time = 0x400003e0 ) ;
  PROVIDE ( __call_systimer_hal_init = 0x400003d0 ) ;
  PROVIDE ( __call_systimer_hal_on_apb_freq_update = 0x400003f4 ) ;
  PROVIDE ( __call_systimer_hal_select_alarm_mode = 0x40000400 ) ;
  PROVIDE ( __call_systimer_hal_set_alarm_period = 0x400003e8 ) ;
  PROVIDE ( __call_systimer_hal_set_alarm_target = 0x400003e4 ) ;
  PROVIDE ( __call_systimer_hal_set_tick_rate_ops = 0x400003d8 ) ;
  PROVIDE ( __call_tbtt_adaptive_servo = 0x40000e2c ) ;
  PROVIDE ( __call_tbtt_adaptive_setup = 0x40000e28 ) ;
  PROVIDE ( __call_tdefl_compress = 0x400000d4 ) ;
  PROVIDE ( __call_tdefl_compress_buffer = 0x400000d8 ) ;
  PROVIDE ( __call_tdefl_compress_mem_to_heap = 0x400000dc ) ;
  PROVIDE ( __call_tdefl_compress_mem_to_mem = 0x400000e0 ) ;
  PROVIDE ( __call_tdefl_compress_mem_to_output = 0x400000e4 ) ;
  PROVIDE ( __call_tdefl_get_adler32 = 0x400000e8 ) ;
  PROVIDE ( __call_tdefl_get_prev_return_status = 0x400000ec ) ;
  PROVIDE ( __call_tdefl_init = 0x400000f0 ) ;
  PROVIDE ( __call_tdefl_write_image_to_png_file_in_memory = 0x400000f4 ) ;
  PROVIDE ( __call_tdefl_write_image_to_png_file_in_memory_ex = 0x400000f8 ) ;
  PROVIDE ( __call_test_get_nonmumimo_common = 0x400010a4 ) ;
  PROVIDE ( __call_test_mimo_update_user_info = 0x40001094 ) ;
  PROVIDE ( __call_test_mumimo_get_heltf_num = 0x40001090 ) ;
  PROVIDE ( __call_test_nonmimo_update_user_info = 0x4000109c ) ;
  PROVIDE ( __call_test_parse_rx_mu_mimo = 0x40001098 ) ;
  PROVIDE ( __call_test_rx_parse_mumimo_complete_sigb = 0x400010a0 ) ;
  PROVIDE ( __call_test_rx_parse_nonmumimo = 0x400010ac ) ;
  PROVIDE ( __call_test_rx_parse_nonmumimo_complete_sigb = 0x400010a8 ) ;
  PROVIDE ( __call_test_rx_process_complete_noeb = 0x40001088 ) ;
  PROVIDE ( __call_test_rx_process_complete_retry = 0x4000108c ) ;
  PROVIDE ( __call_test_tx_fail_statistics = 0x40001080 ) ;
  PROVIDE ( __call_test_tx_succ_statistics = 0x40001084 ) ;
  PROVIDE ( __call_tinfl_decompress = 0x400000fc ) ;
  PROVIDE ( __call_tinfl_decompress_mem_to_callback = 0x40000100 ) ;
  PROVIDE ( __call_tinfl_decompress_mem_to_heap = 0x40000104 ) ;
  PROVIDE ( __call_tinfl_decompress_mem_to_mem = 0x40000108 ) ;
  PROVIDE ( __call_tlsf_add_pool = 0x40000418 ) ;
  PROVIDE ( __call_tlsf_align_size = 0x4000043c ) ;
  PROVIDE ( __call_tlsf_alloc_overhead = 0x4000044c ) ;
  PROVIDE ( __call_tlsf_block_size = 0x40000434 ) ;
  PROVIDE ( __call_tlsf_block_size_max = 0x40000444 ) ;
  PROVIDE ( __call_tlsf_block_size_min = 0x40000440 ) ;
  PROVIDE ( __call_tlsf_check = 0x40000454 ) ;
  PROVIDE ( __call_tlsf_check_pool = 0x40000458 ) ;
  PROVIDE ( __call_tlsf_create = 0x4000040c ) ;
  PROVIDE ( __call_tlsf_create_with_pool = 0x40000410 ) ;
  PROVIDE ( __call_tlsf_free = 0x40000430 ) ;
  PROVIDE ( __call_tlsf_get_pool = 0x40000414 ) ;
  PROVIDE ( __call_tlsf_malloc = 0x40000420 ) ;
  PROVIDE ( __call_tlsf_memalign = 0x40000424 ) ;
  PROVIDE ( __call_tlsf_memalign_offs = 0x40000428 ) ;
  PROVIDE ( __call_tlsf_poison_check_pfunc_set = 0x40000460 ) ;
  PROVIDE ( __call_tlsf_poison_fill_pfunc_set = 0x4000045c ) ;
  PROVIDE ( __call_tlsf_pool_overhead = 0x40000448 ) ;
  PROVIDE ( __call_tlsf_realloc = 0x4000042c ) ;
  PROVIDE ( __call_tlsf_remove_pool = 0x4000041c ) ;
  PROVIDE ( __call_tlsf_size = 0x40000438 ) ;
  PROVIDE ( __call_tlsf_walk_pool = 0x40000450 ) ;
  PROVIDE ( __call_toascii = 0x40000524 ) ;
  PROVIDE ( __call_tolower = 0x40000520 ) ;
  PROVIDE ( __call_toupper = 0x4000051c ) ;
  PROVIDE ( __call_trcAmpduSetState = 0x40000fa0 ) ;
  PROVIDE ( __call_trc_SetTxAmpduState = 0x40000f98 ) ;
  PROVIDE ( __call_trc_calc_duration = 0x40000f8c ) ;
  PROVIDE ( __call_trc_isTxAmpduOperational = 0x40000f90 ) ;
  PROVIDE ( __call_trc_onAmpduOp = 0x40000f94 ) ;
  PROVIDE ( __call_trc_onPPTxDone = 0x40000fa8 ) ;
  PROVIDE ( __call_trc_set_bf_report_rate = 0x40000fa4 ) ;
  PROVIDE ( __call_trc_tid_isTxAmpduOperational = 0x40000f9c ) ;
  PROVIDE ( __call_tsf_hal_get_counter_value = 0x40001524 ) ;
  PROVIDE ( __call_tsf_hal_get_tbtt_interval = 0x40001510 ) ;
  PROVIDE ( __call_tsf_hal_get_time = 0x40001520 ) ;
  PROVIDE ( __call_uartAttach = 0x40000070 ) ;
  PROVIDE ( __call_uart_buff_switch = 0x40000088 ) ;
  PROVIDE ( __call_uart_div_modify = 0x4000007c ) ;
  PROVIDE ( __call_uart_rx_intr_handler = 0x40000068 ) ;
  PROVIDE ( __call_uart_rx_one_char = 0x40000060 ) ;
  PROVIDE ( __call_uart_rx_one_char_block = 0x40000064 ) ;
  PROVIDE ( __call_uart_rx_readbuff = 0x4000006c ) ;
  PROVIDE ( __call_uart_tx_flush = 0x40000074 ) ;
  PROVIDE ( __call_uart_tx_one_char = 0x40000054 ) ;
  PROVIDE ( __call_uart_tx_one_char2 = 0x40000058 ) ;
  PROVIDE ( __call_uart_tx_one_char3 = 0x4000005c ) ;
  PROVIDE ( __call_uart_tx_switch = 0x40000084 ) ;
  PROVIDE ( __call_uart_tx_wait_idle = 0x40000078 ) ;
  PROVIDE ( __call_usb_serial_device_rx_one_char = 0x40000ab8 ) ;
  PROVIDE ( __call_usb_serial_device_rx_one_char_block = 0x40000abc ) ;
  PROVIDE ( __call_usb_serial_device_tx_flush = 0x40000ac0 ) ;
  PROVIDE ( __call_usb_serial_device_tx_one_char = 0x40000ac4 ) ;
  PROVIDE ( __call_utoa = 0x400005a8 ) ;
  PROVIDE ( __call_vfiprintf = 0x40000604 ) ;
  PROVIDE ( __call_vfprintf = 0x40000608 ) ;
  PROVIDE ( __call_vht_get_min_subframe_len = 0x400010bc ) ;
  PROVIDE ( __call_viprintf = 0x40000624 ) ;
  PROVIDE ( __call_vprintf = 0x40000620 ) ;
  PROVIDE ( __call_vsniprintf = 0x4000062c ) ;
  PROVIDE ( __call_vsnprintf = 0x40000628 ) ;
  PROVIDE ( __call_wDevCheckBlockError = 0x40000fac ) ;
  PROVIDE ( __call_wDev_AppendRxBlocks = 0x40000fb0 ) ;
  PROVIDE ( __call_wDev_DiscardFrame = 0x40000fb4 ) ;
  PROVIDE ( __call_wDev_GetNoiseFloor = 0x40000fb8 ) ;
  PROVIDE ( __call_wDev_IndicateAmpdu = 0x40000fbc ) ;
  PROVIDE ( __call_wDev_IndicateBeaconMemoryFrame = 0x40000fec ) ;
  PROVIDE ( __call_wDev_IndicateFrame = 0x40000fc0 ) ;
  PROVIDE ( __call_wDev_ProcessBeaconMemoryRxSuc = 0x40000ff0 ) ;
  PROVIDE ( __call_wDev_ProcessFiq = 0x40000fdc ) ;
  PROVIDE ( __call_wDev_ProcessRxSucData = 0x40000fe0 ) ;
  PROVIDE ( __call_wdevProcessModemStateRxBeacon = 0x40000ff4 ) ;
  PROVIDE ( __call_wdevProcessRxSucDataAll = 0x40000fe4 ) ;
  PROVIDE ( __call_wdev_csi_len_align = 0x40000fe8 ) ;
  PROVIDE ( __call_wdev_is_data_in_rxlist = 0x40000ff8 ) ;
  PROVIDE ( __call_wdev_mac_reg_load = 0x40000fc4 ) ;
  PROVIDE ( __call_wdev_mac_reg_store = 0x40000fc8 ) ;
  PROVIDE ( __call_wdev_mac_sleep = 0x40000fd8 ) ;
  PROVIDE ( __call_wdev_mac_special_reg_load = 0x40000fcc ) ;
  PROVIDE ( __call_wdev_mac_special_reg_store = 0x40000fd0 ) ;
  PROVIDE ( __call_wdev_mac_wakeup = 0x40000fd4 ) ;
  PROVIDE ( __call_wdev_process_beacon_filter = 0x40001004 ) ;
  PROVIDE ( __call_wdev_process_mac_modem_beacon_miss = 0x40001008 ) ;
  PROVIDE ( __call_wdev_process_tbtt = 0x40000ffc ) ;
  PROVIDE ( __call_wdev_process_tsf_timer = 0x40001000 ) ;
  PROVIDE ( __call_wdt_hal_config_stage = 0x400003ac ) ;
  PROVIDE ( __call_wdt_hal_deinit = 0x400003a8 ) ;
  PROVIDE ( __call_wdt_hal_disable = 0x400003bc ) ;
  PROVIDE ( __call_wdt_hal_enable = 0x400003b8 ) ;
  PROVIDE ( __call_wdt_hal_feed = 0x400003c4 ) ;
  PROVIDE ( __call_wdt_hal_handle_intr = 0x400003c0 ) ;
  PROVIDE ( __call_wdt_hal_init = 0x400003a4 ) ;
  PROVIDE ( __call_wdt_hal_is_enabled = 0x400003cc ) ;
  PROVIDE ( __call_wdt_hal_set_flashboot_en = 0x400003c8 ) ;
  PROVIDE ( __call_wdt_hal_write_protect_disable = 0x400003b0 ) ;
  PROVIDE ( __call_wdt_hal_write_protect_enable = 0x400003b4 ) ;
  PROVIDE ( __call_wifi_get_macaddr = 0x40000bc4 ) ;
  PROVIDE ( __call_wifi_he_get_hetb_tid_bawin = 0x400010b4 ) ;
  PROVIDE ( __call_wifi_he_get_hetb_tid_bitmap = 0x400010b0 ) ;
  PROVIDE ( __call_wifi_is_started = 0x40000bd0 ) ;
  PROVIDE ( __call_wifi_rf_phy_disable = 0x40000bc8 ) ;
  PROVIDE ( __call_wifi_rf_phy_enable = 0x40000bcc ) ;
  PROVIDE ( __clear_cache = 0x4003101e ) ;
  PROVIDE ( __clrsbdi2 = 0x4003266c ) ;
  PROVIDE ( __clrsbsi2 = 0x40032622 ) ;
  PROVIDE ( __clz_tab = 0x40049e4c ) ;
  PROVIDE ( __clzdi2 = 0x40031334 ) ;
  PROVIDE ( __clzsi2 = 0x400312f8 ) ;
  PROVIDE ( __cmpdi2 = 0x40030fe6 ) ;
  PROVIDE ( __ctzdi2 = 0x400313ba ) ;
  PROVIDE ( __ctzsi2 = 0x4003137e ) ;
  PROVIDE ( __divdc3 = 0x40032108 ) ;
  PROVIDE ( __divdf3 = 0x40033ebe ) ;
  PROVIDE ( __divdi3 = 0x400326f6 ) ;
  PROVIDE ( __divsc3 = 0x40031db2 ) ;
  PROVIDE ( __divsf3 = 0x400358ce ) ;
  PROVIDE ( __divsi3 = 0x40036da4 ) ;
  PROVIDE ( __eqdf2 = 0x40034404 ) ;
  PROVIDE ( __eqsf2 = 0x40035b2c ) ;
  PROVIDE ( __errno = 0x4003a6fc ) ;
  PROVIDE ( __extenddftf2 = 0x4003680c ) ;
  PROVIDE ( __extendsfdf2 = 0x40036758 ) ;
  PROVIDE ( __ffsdi2 = 0x400312ac ) ;
  PROVIDE ( __ffssi2 = 0x4003126c ) ;
  PROVIDE ( __fixdfdi = 0x4003520c ) ;
  PROVIDE ( __fixdfsi = 0x40035064 ) ;
  PROVIDE ( __fixsfdi = 0x40036450 ) ;
  PROVIDE ( __fixsfsi = 0x40036216 ) ;
  PROVIDE ( __fixunsdfsi = 0x400350c8 ) ;
  PROVIDE ( __fixunssfdi = 0x400364d8 ) ;
  PROVIDE ( __fixunssfsi = 0x40036276 ) ;
  PROVIDE ( __floatdidf = 0x400352b0 ) ;
  PROVIDE ( __floatdisf = 0x40036538 ) ;
  PROVIDE ( __floatsidf = 0x40035124 ) ;
  PROVIDE ( __floatsisf = 0x400362ca ) ;
  PROVIDE ( __floatundidf = 0x4003544c ) ;
  PROVIDE ( __floatundisf = 0x40036660 ) ;
  PROVIDE ( __floatunsidf = 0x400351a6 ) ;
  PROVIDE ( __floatunsisf = 0x4003639c ) ;
  PROVIDE ( __func__.2319 = 0x4004b250 ) ;
  PROVIDE ( __func__.2964 = 0x4004e054 ) ;
  PROVIDE ( __func__.2991 = 0x4004e060 ) ;
  PROVIDE ( __func__.3002 = 0x4004e06c ) ;
  PROVIDE ( __func__.3034 = 0x4004e078 ) ;
  PROVIDE ( __func__.3043 = 0x4004e090 ) ;
  PROVIDE ( __func__.3051 = 0x4004e0a4 ) ;
  PROVIDE ( __func__.3074 = 0x4004e0b8 ) ;
  PROVIDE ( __func__.3079 = 0x4004e0c4 ) ;
  PROVIDE ( __func__.3085 = 0x4004e0d4 ) ;
  PROVIDE ( __func__.3091 = 0x4004e0e8 ) ;
  PROVIDE ( __func__.3097 = 0x4004e0fc ) ;
  PROVIDE ( __func__.3104 = 0x4004e10c ) ;
  PROVIDE ( __func__.3119 = 0x4004e11c ) ;
  PROVIDE ( __func__.3131 = 0x4004e130 ) ;
  PROVIDE ( __func__.3250 = 0x4004e144 ) ;
  PROVIDE ( __func__.3288 = 0x4004e158 ) ;
  PROVIDE ( __func__.3306 = 0x4004e16c ) ;
  PROVIDE ( __func__.3319 = 0x4004e178 ) ;
  PROVIDE ( __func__.3488 = 0x4004de80 ) ;
  PROVIDE ( __func__.3671 = 0x40049e3c ) ;
  PROVIDE ( __func__.3825 = 0x4004de8c ) ;
  PROVIDE ( __func__.3844 = 0x4004dea8 ) ;
  PROVIDE ( __func__.3851 = 0x4004dec4 ) ;
  PROVIDE ( __func__.3870 = 0x4004dee0 ) ;
  PROVIDE ( __func__.3890 = 0x4004def8 ) ;
  PROVIDE ( __func__.3896 = 0x4004dc0c ) ;
  PROVIDE ( __func__.3900 = 0x4004df0c ) ;
  PROVIDE ( __func__.5137 = 0x4004dc90 ) ;
  PROVIDE ( __func__.5170 = 0x4004dca8 ) ;
  PROVIDE ( __func__.5181 = 0x4004dcb8 ) ;
  PROVIDE ( __func__.5182 = 0x4004b4dc ) ;
  PROVIDE ( __func__.5196 = 0x4004b4f4 ) ;
  PROVIDE ( __func__.5205 = 0x4004b514 ) ;
  PROVIDE ( __func__.5260 = 0x4004b528 ) ;
  PROVIDE ( __func__.5519 = 0x4004da64 ) ;
  PROVIDE ( __func__.5877 = 0x4004dba8 ) ;
  PROVIDE ( __func__.7436 = 0x4004add4 ) ;
  PROVIDE ( __func__.7454 = 0x4004ade4 ) ;
  PROVIDE ( __func__.7536 = 0x4004adf4 ) ;
  PROVIDE ( __func__.7999 = 0x4004db28 ) ;
  PROVIDE ( __gcc_bcmp = 0x400326d0 ) ;
  PROVIDE ( __gedf2 = 0x4003446e ) ;
  PROVIDE ( __gesf2 = 0x40035b82 ) ;
  PROVIDE ( __getreent = 0x40026d08 ) ;
  PROVIDE ( __gtdf2 = 0x4003446e ) ;
  PROVIDE ( __gtsf2 = 0x40035b82 ) ;
  PROVIDE ( __init_end = 0x40001830 ) ;
  PROVIDE ( __init_start = 0x40001610 ) ;
  PROVIDE ( __itoa = 0x400382ca ) ;
  PROVIDE ( __ledf2 = 0x40034512 ) ;
  PROVIDE ( __lesf2 = 0x40035bfa ) ;
  PROVIDE ( __lock___arc4random_mutex = 0x4085fba4 ) ;
  PROVIDE ( __lock___at_quick_exit_mutex = 0x4085fba4 ) ;
  PROVIDE ( __lock___atexit_recursive_mutex = 0x4085fba8 ) ;
  PROVIDE ( __lock___dd_hash_mutex = 0x4085fba4 ) ;
  PROVIDE ( __lock___env_recursive_mutex = 0x4085fba8 ) ;
  PROVIDE ( __lock___malloc_recursive_mutex = 0x4085fba8 ) ;
  PROVIDE ( __lock___sfp_recursive_mutex = 0x4085fba8 ) ;
  PROVIDE ( __lock___sinit_recursive_mutex = 0x4085fba8 ) ;
  PROVIDE ( __lock___tz_mutex = 0x4085fba4 ) ;
  PROVIDE ( __lshrdi3 = 0x40030f66 ) ;
  PROVIDE ( __ltdf2 = 0x40034512 ) ;
  PROVIDE ( __ltsf2 = 0x40035bfa ) ;
  PROVIDE ( __moddi3 = 0x40032a92 ) ;
  PROVIDE ( __modsi3 = 0x40036dfc ) ;
  PROVIDE ( __mtvec_base = 0x40001600 ) ;
  PROVIDE ( __muldc3 = 0x40031922 ) ;
  PROVIDE ( __muldf3 = 0x400345b6 ) ;
  PROVIDE ( __muldi3 = 0x40036d56 ) ;
  PROVIDE ( __mulsc3 = 0x400315ca ) ;
  PROVIDE ( __mulsf3 = 0x40035c72 ) ;
  PROVIDE ( __mulsi3 = 0x40036d40 ) ;
  PROVIDE ( __mulvdi3 = 0x4003112c ) ;
  PROVIDE ( __mulvsi3 = 0x40031110 ) ;
  PROVIDE ( __nedf2 = 0x40034404 ) ;
  PROVIDE ( __negdf2 = 0x40034a02 ) ;
  PROVIDE ( __negdi2 = 0x40030f54 ) ;
  PROVIDE ( __negsf2 = 0x40035ea2 ) ;
  PROVIDE ( __negvdi2 = 0x40031236 ) ;
  PROVIDE ( __negvsi2 = 0x40031218 ) ;
  PROVIDE ( __nesf2 = 0x40035b2c ) ;
  PROVIDE ( __paritysi2 = 0x400314a4 ) ;
  PROVIDE ( __popcountdi2 = 0x40031446 ) ;
  PROVIDE ( __popcountsi2 = 0x40031404 ) ;
  PROVIDE ( __powidf2 = 0x40031536 ) ;
  PROVIDE ( __powisf2 = 0x400314c8 ) ;
  PROVIDE ( __retarget_lock_acquire = 0x40026846 ) ;
  PROVIDE ( __retarget_lock_acquire_recursive = 0x4002685a ) ;
  PROVIDE ( __retarget_lock_close = 0x4002681e ) ;
  PROVIDE ( __retarget_lock_close_recursive = 0x40026832 ) ;
  PROVIDE ( __retarget_lock_init = 0x400267f6 ) ;
  PROVIDE ( __retarget_lock_init_recursive = 0x4002680a ) ;
  PROVIDE ( __retarget_lock_release = 0x40026896 ) ;
  PROVIDE ( __retarget_lock_release_recursive = 0x400268ac ) ;
  PROVIDE ( __retarget_lock_try_acquire = 0x4002686e ) ;
  PROVIDE ( __retarget_lock_try_acquire_recursive = 0x40026882 ) ;
  PROVIDE ( __riscv_restore_0 = 0x40036d34 ) ;
  PROVIDE ( __riscv_restore_1 = 0x40036d34 ) ;
  PROVIDE ( __riscv_restore_10 = 0x40036d20 ) ;
  PROVIDE ( __riscv_restore_11 = 0x40036d20 ) ;
  PROVIDE ( __riscv_restore_12 = 0x40036d1c ) ;
  PROVIDE ( __riscv_restore_2 = 0x40036d34 ) ;
  PROVIDE ( __riscv_restore_3 = 0x40036d34 ) ;
  PROVIDE ( __riscv_restore_4 = 0x40036d2a ) ;
  PROVIDE ( __riscv_restore_5 = 0x40036d2a ) ;
  PROVIDE ( __riscv_restore_6 = 0x40036d2a ) ;
  PROVIDE ( __riscv_restore_7 = 0x40036d2a ) ;
  PROVIDE ( __riscv_restore_8 = 0x40036d20 ) ;
  PROVIDE ( __riscv_restore_9 = 0x40036d20 ) ;
  PROVIDE ( __riscv_save_0 = 0x40036d10 ) ;
  PROVIDE ( __riscv_save_1 = 0x40036d10 ) ;
  PROVIDE ( __riscv_save_10 = 0x40036ce8 ) ;
  PROVIDE ( __riscv_save_11 = 0x40036ce8 ) ;
  PROVIDE ( __riscv_save_12 = 0x40036ce0 ) ;
  PROVIDE ( __riscv_save_2 = 0x40036d10 ) ;
  PROVIDE ( __riscv_save_3 = 0x40036d10 ) ;
  PROVIDE ( __riscv_save_4 = 0x40036cf6 ) ;
  PROVIDE ( __riscv_save_5 = 0x40036cf6 ) ;
  PROVIDE ( __riscv_save_6 = 0x40036cf6 ) ;
  PROVIDE ( __riscv_save_7 = 0x40036cf6 ) ;
  PROVIDE ( __riscv_save_8 = 0x40036ce8 ) ;
  PROVIDE ( __riscv_save_9 = 0x40036ce8 ) ;
  PROVIDE ( __sf_fake_stderr = 0x4004d8e0 ) ;
  PROVIDE ( __sf_fake_stdin = 0x4004d900 ) ;
  PROVIDE ( __sf_fake_stdout = 0x4004d920 ) ;
  PROVIDE ( __sflush_r = 0x40037e92 ) ;
  PROVIDE ( __sfputc_r = 0x40038b58 ) ;
  PROVIDE ( __sfputs_r = 0x40038b82 ) ;
  PROVIDE ( __sfvwrite_r = 0x4003a70a ) ;
  PROVIDE ( __sinit = 0x40026dd0 ) ;
  PROVIDE ( __smakebuf_r = 0x400383c2 ) ;
  PROVIDE ( __sprint_r = 0x40038bc4 ) ;
  PROVIDE ( __ssprint_r = 0x400387a6 ) ;
  PROVIDE ( __ssputs_r = 0x400386b8 ) ;
  PROVIDE ( __stack = 0x4085e5a0 ) ;
  PROVIDE ( __stack_chk_fail = 0x40026adc ) ;
  PROVIDE ( __stack_chk_guard = 0x4085fbac ) ;
  PROVIDE ( __strtok_r = 0x40039fd4 ) ;
  PROVIDE ( __subdf3 = 0x40034a10 ) ;
  PROVIDE ( __subsf3 = 0x40035eba ) ;
  PROVIDE ( __subvdi3 = 0x400310d0 ) ;
  PROVIDE ( __subvsi3 = 0x400310b2 ) ;
  PROVIDE ( __swbuf = 0x4003a5d2 ) ;
  PROVIDE ( __swbuf_r = 0x4003a50c ) ;
  PROVIDE ( __swhatbuf_r = 0x40038346 ) ;
  PROVIDE ( __swsetup_r = 0x4003a5ec ) ;
  PROVIDE ( __truncdfsf2 = 0x4003696a ) ;
  PROVIDE ( __trunctfdf2 = 0x40036a9a ) ;
  PROVIDE ( __ucmpdi2 = 0x40031002 ) ;
  PROVIDE ( __udiv_w_sdiv = 0x400338b2 ) ;
  PROVIDE ( __udivdi3 = 0x40032e24 ) ;
  PROVIDE ( __udivmoddi4 = 0x400334d4 ) ;
  PROVIDE ( __udivsi3 = 0x40036dac ) ;
  PROVIDE ( __umoddi3 = 0x40033182 ) ;
  PROVIDE ( __umodsi3 = 0x40036dd8 ) ;
  PROVIDE ( __unorddf2 = 0x4003502c ) ;
  PROVIDE ( __unordsf2 = 0x400361e2 ) ;
  PROVIDE ( __utoa = 0x4003a390 ) ;
  PROVIDE ( _asiprintf_r = 0x40037dac ) ;
  PROVIDE ( _asprintf_r = 0x40037dac ) ;
  PROVIDE ( _at_text = 0x4003b9a8 ) ;
  PROVIDE ( _atoi_r = 0x40037e46 ) ;
  PROVIDE ( _atol_r = 0x40037e56 ) ;
  PROVIDE ( _bss_end = 0x4003b480 ) ;
  PROVIDE ( _bss_end_all_pro = 0x4085fbb4 ) ;
  PROVIDE ( _bss_end_btbbrom = 0x4085fae4 ) ;
  PROVIDE ( _bss_end_btdm = 0x4085fae4 ) ;
  PROVIDE ( _bss_end_c = 0x4085fbb0 ) ;
  PROVIDE ( _bss_end_cache = 0x4085fb8c ) ;
  PROVIDE ( _bss_end_coexist_rom = 0x4085f538 ) ;
  PROVIDE ( _bss_end_ets = 0x4085efc0 ) ;
  PROVIDE ( _bss_end_ets_apb_backup = 0x4085fba4 ) ;
  PROVIDE ( _bss_end_ets_delay = 0x4085fba4 ) ;
  PROVIDE ( _bss_end_ets_printf = 0x4085fba0 ) ;
  PROVIDE ( _bss_end_ets_rtc = 0x4085fba4 ) ;
  PROVIDE ( _bss_end_fft_table = 0x4085fba4 ) ;
  PROVIDE ( _bss_end_hal = 0x4085f3f8 ) ;
  PROVIDE ( _bss_end_heap = 0x4085fb64 ) ;
  PROVIDE ( _bss_end_hwcrypto = 0x4085fba4 ) ;
  PROVIDE ( _bss_end_interface_cache = 0x4085ffd0 ) ;
  PROVIDE ( _bss_end_interface_common = 0x40860000 ) ;
  PROVIDE ( _bss_end_interface_crc = 0x4085ffc8 ) ;
  PROVIDE ( _bss_end_interface_esp_flash = 0x4085ffec ) ;
  PROVIDE ( _bss_end_interface_heap = 0x4085ffdc ) ;
  PROVIDE ( _bss_end_interface_newlib = 0x4085ffd8 ) ;
  PROVIDE ( _bss_end_interface_rom_coexist = 0x4085ffc8 ) ;
  PROVIDE ( _bss_end_interface_rom_net80211 = 0x4085ffb0 ) ;
  PROVIDE ( _bss_end_interface_rom_phy = 0x4085fc74 ) ;
  PROVIDE ( _bss_end_interface_rom_phy_eco1 = 0x4085fc70 ) ;
  PROVIDE ( _bss_end_interface_rom_pp = 0x4085ff78 ) ;
  PROVIDE ( _bss_end_interface_rom_pp_eco2 = 0x4085fc6c ) ;
  PROVIDE ( _bss_end_interface_spi_flash_chips = 0x4085ffe4 ) ;
  PROVIDE ( _bss_end_interface_spiflash_legacy = 0x4085fff8 ) ;
  PROVIDE ( _bss_end_key_mgr = 0x4085fbb4 ) ;
  PROVIDE ( _bss_end_mbedtls = 0x4085fae4 ) ;
  PROVIDE ( _bss_end_net80211_rom = 0x4085f540 ) ;
  PROVIDE ( _bss_end_newlib = 0x4085fbb0 ) ;
  PROVIDE ( _bss_end_opi_flash = 0x4085fb8c ) ;
  PROVIDE ( _bss_end_phyrom = 0x4085fae4 ) ;
  PROVIDE ( _bss_end_pp_rom = 0x4085faac ) ;
  PROVIDE ( _bss_end_riscv = 0x4085f4f8 ) ;
  PROVIDE ( _bss_end_shared_bufs = 0x4085c5a0 ) ;
  PROVIDE ( _bss_end_sip = 0x4085f2ac ) ;
  PROVIDE ( _bss_end_slc = 0x4085f3f8 ) ;
  PROVIDE ( _bss_end_spi_flash = 0x4085fb58 ) ;
  PROVIDE ( _bss_end_spi_slave = 0x4085efc0 ) ;
  PROVIDE ( _bss_end_uart = 0x4085f534 ) ;
  PROVIDE ( _bss_end_usb_dwcotg = 0x4085f4f8 ) ;
  PROVIDE ( _bss_start = 0x4003b340 ) ;
  PROVIDE ( _bss_start_all_pro = 0x4085fbb4 ) ;
  PROVIDE ( _bss_start_btbbrom = 0x4085fae4 ) ;
  PROVIDE ( _bss_start_btdm = 0x4085fae4 ) ;
  PROVIDE ( _bss_start_c = 0x4085fbb0 ) ;
  PROVIDE ( _bss_start_cache = 0x4085fb6c ) ;
  PROVIDE ( _bss_start_coexist_rom = 0x4085f538 ) ;
  PROVIDE ( _bss_start_ets = 0x4085e5a4 ) ;
  PROVIDE ( _bss_start_ets_apb_backup = 0x4085fba4 ) ;
  PROVIDE ( _bss_start_ets_delay = 0x4085fba4 ) ;
  PROVIDE ( _bss_start_ets_printf = 0x4085fb8c ) ;
  PROVIDE ( _bss_start_ets_rtc = 0x4085fba4 ) ;
  PROVIDE ( _bss_start_fft_table = 0x4085fba4 ) ;
  PROVIDE ( _bss_start_hal = 0x4085f3f8 ) ;
  PROVIDE ( _bss_start_heap = 0x4085fb58 ) ;
  PROVIDE ( _bss_start_hwcrypto = 0x4085fba4 ) ;
  PROVIDE ( _bss_start_interface_cache = 0x4085ffcc ) ;
  PROVIDE ( _bss_start_interface_common = 0x4085fffc ) ;
  PROVIDE ( _bss_start_interface_crc = 0x4085ffc8 ) ;
  PROVIDE ( _bss_start_interface_esp_flash = 0x4085ffe8 ) ;
  PROVIDE ( _bss_start_interface_heap = 0x4085ffdc ) ;
  PROVIDE ( _bss_start_interface_newlib = 0x4085ffd0 ) ;
  PROVIDE ( _bss_start_interface_rom_coexist = 0x4085ffb0 ) ;
  PROVIDE ( _bss_start_interface_rom_net80211 = 0x4085ff78 ) ;
  PROVIDE ( _bss_start_interface_rom_phy = 0x4085fc70 ) ;
  PROVIDE ( _bss_start_interface_rom_phy_eco1 = 0x4085fc70 ) ;
  PROVIDE ( _bss_start_interface_rom_pp = 0x4085fc8c ) ;
  PROVIDE ( _bss_start_interface_rom_pp_eco2 = 0x4085fc60 ) ;
  PROVIDE ( _bss_start_interface_spi_flash_chips = 0x4085ffe4 ) ;
  PROVIDE ( _bss_start_interface_spiflash_legacy = 0x4085fff4 ) ;
  PROVIDE ( _bss_start_key_mgr = 0x4085fbb0 ) ;
  PROVIDE ( _bss_start_mbedtls = 0x4085fae4 ) ;
  PROVIDE ( _bss_start_net80211_rom = 0x4085f540 ) ;
  PROVIDE ( _bss_start_newlib = 0x4085fba4 ) ;
  PROVIDE ( _bss_start_opi_flash = 0x4085fb8c ) ;
  PROVIDE ( _bss_start_phyrom = 0x4085fae4 ) ;
  PROVIDE ( _bss_start_pp_rom = 0x4085f980 ) ;
  PROVIDE ( _bss_start_riscv = 0x4085f3f8 ) ;
  PROVIDE ( _bss_start_shared_bufs = 0x4084e5a0 ) ;
  PROVIDE ( _bss_start_sip = 0x4085efc0 ) ;
  PROVIDE ( _bss_start_slc = 0x4085f2ac ) ;
  PROVIDE ( _bss_start_spi_flash = 0x4085fb3c ) ;
  PROVIDE ( _bss_start_spi_slave = 0x4085efc0 ) ;
  PROVIDE ( _bss_start_uart = 0x4085f4fc ) ;
  PROVIDE ( _bss_start_usb_dwcotg = 0x4085f4f8 ) ;
  PROVIDE ( _bss_table_end = 0x4003b480 ) ;
  PROVIDE ( _bss_table_start = 0x4003b340 ) ;
  PROVIDE ( _calloc_r = 0x40026b42 ) ;
  PROVIDE ( _cleanup_r = 0x40026de6 ) ;
  PROVIDE ( _close_r = 0x40026c5a ) ;
  PROVIDE ( _common_light_sleep = 0x4000169a ) ;
  PROVIDE ( _ctype_ = 0x4004a03c ) ;
  PROVIDE ( _cvt = 0x4001d68c ) ;
  PROVIDE ( _data_end_all_pro = 0x4085fbb4 ) ;
  PROVIDE ( _data_end_btbbrom = 0x4085fae4 ) ;
  PROVIDE ( _data_end_btdm = 0x4085fae4 ) ;
  PROVIDE ( _data_end_c = 0x4085fbb0 ) ;
  PROVIDE ( _data_end_cache = 0x4085fb6c ) ;
  PROVIDE ( _data_end_coexist_rom = 0x4085f538 ) ;
  PROVIDE ( _data_end_ets = 0x4085e5a4 ) ;
  PROVIDE ( _data_end_ets_apb_backup = 0x4085fba4 ) ;
  PROVIDE ( _data_end_ets_delay = 0x4085fba4 ) ;
  PROVIDE ( _data_end_ets_printf = 0x4085fb8c ) ;
  PROVIDE ( _data_end_ets_rtc = 0x4085fba4 ) ;
  PROVIDE ( _data_end_fft_table = 0x4085fba4 ) ;
  PROVIDE ( _data_end_hal = 0x4085f3f8 ) ;
  PROVIDE ( _data_end_heap = 0x4085fb58 ) ;
  PROVIDE ( _data_end_hwcrypto = 0x4085fba4 ) ;
  PROVIDE ( _data_end_interface = 0x40860000 ) ;
  PROVIDE ( _data_end_interface_cache = 0x4085ffcc ) ;
  PROVIDE ( _data_end_interface_common = 0x4085fffc ) ;
  PROVIDE ( _data_end_interface_crc = 0x4085ffc8 ) ;
  PROVIDE ( _data_end_interface_esp_flash = 0x4085ffe8 ) ;
  PROVIDE ( _data_end_interface_heap = 0x4085ffdc ) ;
  PROVIDE ( _data_end_interface_newlib = 0x4085ffd0 ) ;
  PROVIDE ( _data_end_interface_rom_coexist = 0x4085ffb0 ) ;
  PROVIDE ( _data_end_interface_rom_net80211 = 0x4085ff78 ) ;
  PROVIDE ( _data_end_interface_rom_phy = 0x4085fc70 ) ;
  PROVIDE ( _data_end_interface_rom_phy_eco1 = 0x4085fc70 ) ;
  PROVIDE ( _data_end_interface_rom_pp = 0x4085fc8c ) ;
  PROVIDE ( _data_end_interface_rom_pp_eco2 = 0x4085fc60 ) ;
  PROVIDE ( _data_end_interface_spi_flash_chips = 0x4085ffe4 ) ;
  PROVIDE ( _data_end_interface_spiflash_legacy = 0x4085fff4 ) ;
  PROVIDE ( _data_end_key_mgr = 0x4085fbb0 ) ;
  PROVIDE ( _data_end_mbedtls = 0x4085fae4 ) ;
  PROVIDE ( _data_end_net80211_rom = 0x4085f540 ) ;
  PROVIDE ( _data_end_newlib = 0x4085fba4 ) ;
  PROVIDE ( _data_end_opi_flash = 0x4085fb8c ) ;
  PROVIDE ( _data_end_phyrom = 0x4085fae4 ) ;
  PROVIDE ( _data_end_pp_rom = 0x4085f97c ) ;
  PROVIDE ( _data_end_riscv = 0x4085f3f8 ) ;
  PROVIDE ( _data_end_sip = 0x4085efc0 ) ;
  PROVIDE ( _data_end_slc = 0x4085f2ac ) ;
  PROVIDE ( _data_end_spi_flash = 0x4085fb3c ) ;
  PROVIDE ( _data_end_spi_slave = 0x4085efc0 ) ;
  PROVIDE ( _data_end_uart = 0x4085f4fc ) ;
  PROVIDE ( _data_end_usb_dwcotg = 0x4085f4f8 ) ;
  PROVIDE ( _data_start_all_pro = 0x4085fbb4 ) ;
  PROVIDE ( _data_start_btbbrom = 0x4085fae4 ) ;
  PROVIDE ( _data_start_btdm = 0x4085fae4 ) ;
  PROVIDE ( _data_start_btdm_rom = 0x4003b150 ) ;
  PROVIDE ( _data_start_c = 0x4085fbb0 ) ;
  PROVIDE ( _data_start_cache = 0x4085fb64 ) ;
  PROVIDE ( _data_start_coexist_rom = 0x4085f534 ) ;
  PROVIDE ( _data_start_ets = 0x4085e5a0 ) ;
  PROVIDE ( _data_start_ets_apb_backup = 0x4085fba4 ) ;
  PROVIDE ( _data_start_ets_delay = 0x4085fba0 ) ;
  PROVIDE ( _data_start_ets_printf = 0x4085fb8c ) ;
  PROVIDE ( _data_start_ets_rtc = 0x4085fba4 ) ;
  PROVIDE ( _data_start_fft_table = 0x4085fba4 ) ;
  PROVIDE ( _data_start_hal = 0x4085f3f8 ) ;
  PROVIDE ( _data_start_heap = 0x4085fb58 ) ;
  PROVIDE ( _data_start_hwcrypto = 0x4085fba4 ) ;
  PROVIDE ( _data_start_interface = 0x4085fc60 ) ;
  PROVIDE ( _data_start_interface_cache = 0x4085ffc8 ) ;
  PROVIDE ( _data_start_interface_common = 0x4085fff8 ) ;
  PROVIDE ( _data_start_interface_crc = 0x4085ffc8 ) ;
  PROVIDE ( _data_start_interface_esp_flash = 0x4085ffe4 ) ;
  PROVIDE ( _data_start_interface_heap = 0x4085ffd8 ) ;
  PROVIDE ( _data_start_interface_newlib = 0x4085ffd0 ) ;
  PROVIDE ( _data_start_interface_rom_coexist = 0x4085ffb0 ) ;
  PROVIDE ( _data_start_interface_rom_net80211 = 0x4085ff78 ) ;
  PROVIDE ( _data_start_interface_rom_phy = 0x4085fc70 ) ;
  PROVIDE ( _data_start_interface_rom_phy_eco1 = 0x4085fc6c ) ;
  PROVIDE ( _data_start_interface_rom_pp = 0x4085fc74 ) ;
  PROVIDE ( _data_start_interface_rom_pp_eco2 = 0x4085fc60 ) ;
  PROVIDE ( _data_start_interface_spi_flash_chips = 0x4085ffdc ) ;
  PROVIDE ( _data_start_interface_spiflash_legacy = 0x4085ffec ) ;
  PROVIDE ( rom_spiflash_legacy_data = 0x4085ffec ) ;
  PROVIDE ( _data_start_key_mgr = 0x4085fbb0 ) ;
  PROVIDE ( _data_start_mbedtls = 0x4085fae4 ) ;
  PROVIDE ( _data_start_net80211_rom = 0x4085f538 ) ;
  PROVIDE ( _data_start_newlib = 0x4085fba4 ) ;
  PROVIDE ( _data_start_opi_flash = 0x4085fb8c ) ;
  PROVIDE ( _data_start_phyrom = 0x4085faac ) ;
  PROVIDE ( _data_start_pp_rom = 0x4085f540 ) ;
  PROVIDE ( _data_start_riscv = 0x4085f3f8 ) ;
  PROVIDE ( _data_start_sip = 0x4085efc0 ) ;
  PROVIDE ( _data_start_slc = 0x4085f2ac ) ;
  PROVIDE ( _data_start_spi_flash = 0x4085fae4 ) ;
  PROVIDE ( _data_start_spi_slave = 0x4085efc0 ) ;
  PROVIDE ( _data_start_uart = 0x4085f4f8 ) ;
  PROVIDE ( _data_start_usb_dwcotg = 0x4085f4f8 ) ;
  PROVIDE ( _data_table_end = 0x4003b340 ) ;
  PROVIDE ( _data_table_start = 0x4003b154 ) ;
  PROVIDE ( _do_enable_sw_pwr_glitch = 0x40001636 ) ;
  PROVIDE ( _dram0_0_start = 0x4084e5a0 ) ;
  PROVIDE ( _dram0_stack_shared_mem_reserved_start = 0x4085c5a0 ) ;
  PROVIDE ( _dram_end_pp_rom = 0x4085faac ) ;
  PROVIDE ( _dram_end_uart_rom = 0x4085f534 ) ;
  PROVIDE ( _dram_end_usb_dwcotg_rom = 0x4085f4f8 ) ;
  PROVIDE ( _dram_start_coexist_rom = 0x4085f534 ) ;
  PROVIDE ( _dram_start_phyrom = 0x4085faac ) ;
  PROVIDE ( _dram_start_uart_rom = 0x4085f4f8 ) ;
  PROVIDE ( _dram_start_usb_dwcotg_rom = 0x4085f4f8 ) ;
  PROVIDE ( _esp_rom_spiflash_erase_block = 0x40029996 ) ;
  PROVIDE ( _esp_rom_spiflash_erase_sector = 0x40029a0e ) ;
  PROVIDE ( _esp_rom_spiflash_read = 0x40029b64 ) ;
  PROVIDE ( _esp_rom_spiflash_unlock = 0x4002975e ) ;
  PROVIDE ( _esp_rom_spiflash_write = 0x40029a86 ) ;
  PROVIDE ( _etext = 0x4003b480 ) ;
  PROVIDE ( _exit_r = 0x40026c46 ) ;
  PROVIDE ( _fflush_r = 0x40037ffe ) ;
  PROVIDE ( _fiprintf_r = 0x400380c6 ) ;
  PROVIDE ( _fprintf_r = 0x400380c6 ) ;
  PROVIDE ( _free_r = 0x40026b1a ) ;
  PROVIDE ( _fstat_r = 0x40026bf6 ) ;
  PROVIDE ( _fwalk = 0x40038114 ) ;
  PROVIDE ( _fwalk_reent = 0x40038176 ) ;
  PROVIDE ( _getpid_r = 0x40026c1e ) ;
  PROVIDE ( _gettimeofday_r = 0x40026b92 ) ;
  PROVIDE ( _global_interrupt_handler = 0x4001bd74 ) ;
  PROVIDE ( _init = 0x40001610 ) ;
  PROVIDE ( _interrupt_exit = 0x400017e2 ) ;
  PROVIDE ( _interrupt_handler = 0x4000175c ) ;
  PROVIDE ( _iprintf_r = 0x400392b4 ) ;
  PROVIDE ( _isatty_r = 0x400267ba ) ;
  PROVIDE ( _kill_r = 0x40026c32 ) ;
  PROVIDE ( _link_r = 0x40026bce ) ;
  PROVIDE ( _lseek_r = 0x40026c96 ) ;
  PROVIDE ( _malloc_r = 0x40026b06 ) ;
  PROVIDE ( _open_r = 0x40026c6e ) ;
  PROVIDE ( _panic_handler = 0x4000175c ) ;
  PROVIDE ( _printf_common = 0x40038f08 ) ;
  PROVIDE ( _printf_float = 0x40026da4 ) ;
  PROVIDE ( _printf_i = 0x40039014 ) ;
  PROVIDE ( _printf_r = 0x400392b4 ) ;
  PROVIDE ( _putc1 = 0x4085fb8c ) ;
  PROVIDE ( _putc2 = 0x4085fb90 ) ;
  PROVIDE ( _raise_r = 0x40026ba6 ) ;
  PROVIDE ( _read_r = 0x40026caa ) ;
  PROVIDE ( _realloc_r = 0x40026b2e ) ;
  PROVIDE ( _rename_r = 0x40026b6a ) ;
  PROVIDE ( _rodata_end = 0x4004e968 ) ;
  PROVIDE ( _rodata_end_interface = 0x40050000 ) ;
  PROVIDE ( _rodata_end_interface_cache = 0x4004fffc ) ;
  PROVIDE ( _rodata_end_interface_common = 0x40050000 ) ;
  PROVIDE ( _rodata_end_interface_crc = 0x4004fffc ) ;
  PROVIDE ( _rodata_end_interface_esp_flash = 0x4004fffc ) ;
  PROVIDE ( _rodata_end_interface_heap = 0x4004fffc ) ;
  PROVIDE ( _rodata_end_interface_newlib = 0x4004fffc ) ;
  PROVIDE ( _rodata_end_interface_rom_coexist = 0x4004ffe4 ) ;
  PROVIDE ( _rodata_end_interface_rom_net80211 = 0x4004ffe4 ) ;
  PROVIDE ( _rodata_end_interface_rom_phy = 0x4004fd40 ) ;
  PROVIDE ( _rodata_end_interface_rom_phy_eco1 = 0x4004fd40 ) ;
  PROVIDE ( _rodata_end_interface_rom_pp = 0x4004ffe4 ) ;
  PROVIDE ( _rodata_end_interface_rom_pp_eco2 = 0x4004fd40 ) ;
  PROVIDE ( _rodata_end_interface_spi_flash_chips = 0x4004fffc ) ;
  PROVIDE ( _rodata_end_interface_spiflash_legacy = 0x4004fffc ) ;
  PROVIDE ( _rodata_start = 0x40049c00 ) ;
  PROVIDE ( _rodata_start_interface = 0x4004fd40 ) ;
  PROVIDE ( _rodata_start_interface_cache = 0x4004fffc ) ;
  PROVIDE ( _rodata_start_interface_common = 0x4004fffc ) ;
  PROVIDE ( _rodata_start_interface_crc = 0x4004ffe4 ) ;
  PROVIDE ( _rodata_start_interface_esp_flash = 0x4004fffc ) ;
  PROVIDE ( _rodata_start_interface_heap = 0x4004fffc ) ;
  PROVIDE ( _rodata_start_interface_newlib = 0x4004fffc ) ;
  PROVIDE ( _rodata_start_interface_rom_coexist = 0x4004ffe4 ) ;
  PROVIDE ( _rodata_start_interface_rom_net80211 = 0x4004ffe4 ) ;
  PROVIDE ( _rodata_start_interface_rom_phy = 0x4004fd40 ) ;
  PROVIDE ( _rodata_start_interface_rom_phy_eco1 = 0x4004fd40 ) ;
  PROVIDE ( _rodata_start_interface_rom_pp = 0x4004fd40 ) ;
  PROVIDE ( _rodata_start_interface_rom_pp_eco2 = 0x4004fd40 ) ;
  PROVIDE ( _rodata_start_interface_spi_flash_chips = 0x4004fffc ) ;
  PROVIDE ( _rodata_start_interface_spiflash_legacy = 0x4004fffc ) ;
  PROVIDE ( _rom_chip_id = 0x40000010 ) ;
  PROVIDE ( _rom_eco_version = 0x40000014 ) ;
  PROVIDE ( _rom_eh_frame_end = 0x00010210 ) ;
  PROVIDE ( _rom_eh_frame_hdr_end = 0x000031c4 ) ;
  PROVIDE ( _rom_eh_frame_hdr_start = 0x00000000 ) ;
  PROVIDE ( _rom_eh_frame_start = 0x000031c4 ) ;
  PROVIDE ( _rom_wrapper_functions_end = 0x400015dc ) ;
  PROVIDE ( _rom_wrapper_functions_start = 0x40000010 ) ;
  PROVIDE ( _rvfp__adddf3 = 0x40037634 ) ;
  PROVIDE ( _rvfp__addsf3 = 0x40036ff8 ) ;
  PROVIDE ( _rvfp__eqdf2 = 0x40037cca ) ;
  PROVIDE ( _rvfp__eqsf2 = 0x400375aa ) ;
  PROVIDE ( _rvfp__extendsfdf2 = 0x40037138 ) ;
  PROVIDE ( _rvfp__fixdfdi = 0x40037b4a ) ;
  PROVIDE ( _rvfp__fixdfsi = 0x40037a62 ) ;
  PROVIDE ( _rvfp__fixsfdi = 0x40036f7a ) ;
  PROVIDE ( _rvfp__fixsfsi = 0x40037570 ) ;
  PROVIDE ( _rvfp__fixunsdfsi = 0x40037950 ) ;
  PROVIDE ( _rvfp__fixunssfdi = 0x40037aa0 ) ;
  PROVIDE ( _rvfp__fixunssfsi = 0x40036e22 ) ;
  PROVIDE ( _rvfp__floatdidf = 0x40037986 ) ;
  PROVIDE ( _rvfp__floatdisf = 0x400379f8 ) ;
  PROVIDE ( _rvfp__floatsidf = 0x40037c08 ) ;
  PROVIDE ( _rvfp__floatsisf = 0x40037c34 ) ;
  PROVIDE ( _rvfp__floatundidf = 0x40037af0 ) ;
  PROVIDE ( _rvfp__floatundisf = 0x400371ee ) ;
  PROVIDE ( _rvfp__floatunsidf = 0x40036e54 ) ;
  PROVIDE ( _rvfp__floatunsisf = 0x40036f12 ) ;
  PROVIDE ( _rvfp__gedf2 = 0x40037d06 ) ;
  PROVIDE ( _rvfp__gesf2 = 0x40037bcc ) ;
  PROVIDE ( _rvfp__gtdf2 = 0x40037c70 ) ;
  PROVIDE ( _rvfp__gtsf2 = 0x40037d6e ) ;
  PROVIDE ( _rvfp__ledf2 = 0x400375ce ) ;
  PROVIDE ( _rvfp__lesf2 = 0x40037914 ) ;
  PROVIDE ( _rvfp__ltdf2 = 0x40037190 ) ;
  PROVIDE ( _rvfp__ltsf2 = 0x40036f42 ) ;
  PROVIDE ( _rvfp__muldf3 = 0x40037376 ) ;
  PROVIDE ( _rvfp__mulsf3 = 0x40037240 ) ;
  PROVIDE ( _rvfp__nedf2 = 0x40037cca ) ;
  PROVIDE ( _rvfp__nesf2 = 0x400375aa ) ;
  PROVIDE ( _rvfp__subdf3 = 0x4003762e ) ;
  PROVIDE ( _rvfp__subsf3 = 0x40036ff2 ) ;
  PROVIDE ( _rvfp__truncdfsf2 = 0x40036e74 ) ;
  PROVIDE ( _sbrk_r = 0x40026c0a ) ;
  PROVIDE ( _scanf_float = 0x40026dba ) ;
  PROVIDE ( _sip_from_host_isr = 0x4085efc0 ) ;
  PROVIDE ( _sip_init_evt_desc_space = 0x4085f22c ) ;
  PROVIDE ( _sip_init_evt_mblk_space = 0x4085f02c ) ;
  PROVIDE ( _sip_proc_ctrl_pkt = 0x4085efc8 ) ;
  PROVIDE ( _sip_proc_data_pkt = 0x4085efc4 ) ;
  PROVIDE ( _siprintf_r = 0x4003993c ) ;
  PROVIDE ( _skip_enable_sw_pwr_glitch = 0x40001662 ) ;
  PROVIDE ( _slc_init_cmd_desc_space = 0x4085f3ec ) ;
  PROVIDE ( _slc_init_cmd_mblk_space = 0x4085f2e0 ) ;
  PROVIDE ( _sniprintf_r = 0x40039858 ) ;
  PROVIDE ( _snprintf_r = 0x40039858 ) ;
  PROVIDE ( _sprintf_r = 0x4003993c ) ;
  PROVIDE ( _stack_sentry = 0x4085c5a0 ) ;
  PROVIDE ( _start = 0x40000000 ) ;
  PROVIDE ( _stat_r = 0x40026be2 ) ;
  PROVIDE ( _stext = 0x40001830 ) ;
  PROVIDE ( _strdup_r = 0x40039c8c ) ;
  PROVIDE ( _strndup_r = 0x40039edc ) ;
  PROVIDE ( _strtol_l.isra.0 = 0x4003a034 ) ;
  PROVIDE ( _strtol_r = 0x4003a174 ) ;
  PROVIDE ( _strtoul_l.isra.0 = 0x4003a1b6 ) ;
  PROVIDE ( _strtoul_r = 0x4003a2d2 ) ;
  PROVIDE ( _svfiprintf_r = 0x400388da ) ;
  PROVIDE ( _svfprintf_r = 0x400388da ) ;
  PROVIDE ( _system_r = 0x40026b56 ) ;
  PROVIDE ( _text_end = 0x4003b480 ) ;
  PROVIDE ( _text_start = 0x40001830 ) ;
  PROVIDE ( _times_r = 0x40026b7e ) ;
  PROVIDE ( _unlink_r = 0x40026bba ) ;
  PROVIDE ( _vector_table = 0x40001600 ) ;
  PROVIDE ( _vfiprintf_r = 0x40038bec ) ;
  PROVIDE ( _vfprintf_r = 0x40038bec ) ;
  PROVIDE ( _viprintf_r = 0x4003a45a ) ;
  PROVIDE ( _vprintf_r = 0x4003a45a ) ;
  PROVIDE ( _vsniprintf_r = 0x4003a486 ) ;
  PROVIDE ( _vsnprintf_r = 0x4003a486 ) ;
  PROVIDE ( _write_r = 0x40026c82 ) ;
  PROVIDE ( abort = 0x40026af2 ) ;
  PROVIDE ( abs = 0x40037da2 ) ;
  PROVIDE ( adjust = 0x4003707a ) ;
  PROVIDE ( alloc_pool = 0x40024f8a ) ;
  PROVIDE ( ampdu_dispatch = 0x4001abb0 ) ;
  PROVIDE ( ampdu_dispatch_all = 0x4001ac9a ) ;
  PROVIDE ( ampdu_dispatch_as_many_as_possible = 0x4001abe8 ) ;
  PROVIDE ( ampdu_dispatch_movement = 0x4001ac62 ) ;
  PROVIDE ( ampdu_dispatch_upto = 0x4001ad10 ) ;
  PROVIDE ( ampdu_process_multicast_address_qos_frame = 0x4001b902 ) ;
  PROVIDE ( asiprintf = 0x40037dee ) ;
  PROVIDE ( asprintf = 0x40037dee ) ;
  PROVIDE ( assert_valid_block = 0x4002d522 ) ;
  PROVIDE ( atoi = 0x40037e3e ) ;
  PROVIDE ( atol = 0x40037e4e ) ;
  PROVIDE ( bitext = 0x40024fa6 ) ;
  PROVIDE ( block_absorb_post_hook = 0x4002da02 ) ;
  PROVIDE ( both_denormal = 0x400370d4 ) ;
  PROVIDE ( both_denormal_zero = 0x400370e2 ) ;
  PROVIDE ( bzero = 0x40037e5e ) ;
  PROVIDE ( calculate_shaX.constprop.0 = 0x4001e24c ) ;
  PROVIDE ( calloc = 0x40026d80 ) ;
  PROVIDE ( check_bss_queue = 0x4001a374 ) ;
  PROVIDE ( check_chip_pointer_default = 0x4002a406 ) ;
  PROVIDE ( check_condCOUNTER.1922 = 0x4003a9f4 ) ;
  PROVIDE ( check_condCOUNTER.1933 = 0x4003a9f4 ) ;
  PROVIDE ( check_condCOUNTER.1945 = 0x4003aa28 ) ;
  PROVIDE ( check_condCOUNTER.1956 = 0x4003aa28 ) ;
  PROVIDE ( check_condCOUNTER.1968 = 0x4003aa5a ) ;
  PROVIDE ( check_condCOUNTER.1979 = 0x4003aa5a ) ;
  PROVIDE ( check_condCOUNTER.1991 = 0x4003aa8c ) ;
  PROVIDE ( check_condCOUNTER.2002 = 0x4003aa8c ) ;
  PROVIDE ( check_condCOUNTER.2007 = 0x4001be44 ) ;
  PROVIDE ( check_condCOUNTER.2017 = 0x4003aabe ) ;
  PROVIDE ( check_condCOUNTER.2028 = 0x4003aabe ) ;
  PROVIDE ( check_condCOUNTER.2040 = 0x4003aaf0 ) ;
  PROVIDE ( check_condCOUNTER.2051 = 0x4003aaf0 ) ;
  PROVIDE ( check_condCOUNTER.2075 = 0x4003ab22 ) ;
  PROVIDE ( check_condCOUNTER.2086 = 0x4003ab22 ) ;
  PROVIDE ( check_condCOUNTER.3105 = 0x400268c2 ) ;
  PROVIDE ( check_condCOUNTER.3109 = 0x400268f6 ) ;
  PROVIDE ( check_condCOUNTER.3113 = 0x40026920 ) ;
  PROVIDE ( check_condCOUNTER.3116 = 0x4002694a ) ;
  PROVIDE ( check_condCOUNTER.3119 = 0x4002697a ) ;
  PROVIDE ( check_condCOUNTER.3724 = 0x400308ee ) ;
  PROVIDE ( check_condCOUNTER.3805 = 0x4002ccee ) ;
  PROVIDE ( check_condCOUNTER.3838 = 0x4002cea2 ) ;
  PROVIDE ( check_condCOUNTER.3841 = 0x4002ced4 ) ;
  PROVIDE ( check_condCOUNTER.3844 = 0x4002cef6 ) ;
  PROVIDE ( check_condCOUNTER.3850 = 0x4002cf18 ) ;
  PROVIDE ( check_condCOUNTER.3853 = 0x4002cf3a ) ;
  PROVIDE ( check_condCOUNTER.4135 = 0x4001df9a ) ;
  PROVIDE ( check_condCOUNTER.4138 = 0x4001dfbc ) ;
  PROVIDE ( check_condCOUNTER.4158 = 0x4001dfe0 ) ;
  PROVIDE ( check_condCOUNTER.4170 = 0x4001e19c ) ;
  PROVIDE ( check_condCOUNTER.4178 = 0x4001e01c ) ;
  PROVIDE ( check_condCOUNTER.4198 = 0x4001e042 ) ;
  PROVIDE ( check_condCOUNTER.4206 = 0x4001e07e ) ;
  PROVIDE ( check_condCOUNTER.4213 = 0x4001e0a4 ) ;
  PROVIDE ( check_condCOUNTER.4216 = 0x4001e1e4 ) ;
  PROVIDE ( check_condCOUNTER.4220 = 0x4001e0ca ) ;
  PROVIDE ( check_condCOUNTER.4227 = 0x4001e0a4 ) ;
  PROVIDE ( check_condCOUNTER.4286 = 0x4001e0f0 ) ;
  PROVIDE ( check_condCOUNTER.4291 = 0x4001e128 ) ;
  PROVIDE ( check_condCOUNTER.4294 = 0x4001e154 ) ;
  PROVIDE ( check_condCOUNTER.4297 = 0x4001e178 ) ;
  PROVIDE ( check_condCOUNTER.4314 = 0x4001e22e ) ;
  PROVIDE ( check_condCOUNTER.5207 = 0x4001f306 ) ;
  PROVIDE ( check_condCOUNTER.5227 = 0x4001f2e0 ) ;
  PROVIDE ( check_condCOUNTER.5231 = 0x4001f36e ) ;
  PROVIDE ( check_condCOUNTER.5255 = 0x4001f29c ) ;
  PROVIDE ( check_condCOUNTER.5268 = 0x4001f328 ) ;
  PROVIDE ( check_condCOUNTER.5922 = 0x4002f468 ) ;
  PROVIDE ( check_condCOUNTER.5932 = 0x4002f51c ) ;
  PROVIDE ( check_condCOUNTER.5947 = 0x4002f48c ) ;
  PROVIDE ( check_condCOUNTER.5950 = 0x4002f4ac ) ;
  PROVIDE ( check_condCOUNTER.5956 = 0x4002f4c0 ) ;
  PROVIDE ( check_condCOUNTER.5959 = 0x4002f4e0 ) ;
  PROVIDE ( check_condCOUNTER.5970 = 0x4002f500 ) ;
  PROVIDE ( check_condCOUNTER.5973 = 0x4002f500 ) ;
  PROVIDE ( check_condCOUNTER.5976 = 0x4002f500 ) ;
  PROVIDE ( check_condCOUNTER.5979 = 0x4002f500 ) ;
  PROVIDE ( check_condCOUNTER.5982 = 0x4002f48c ) ;
  PROVIDE ( check_condCOUNTER.6125 = 0x4001fbea ) ;
  PROVIDE ( check_condCOUNTER.6128 = 0x4001fc0c ) ;
  PROVIDE ( check_condCOUNTER.6132 = 0x4001fc2e ) ;
  PROVIDE ( check_condCOUNTER.6354 = 0x4001bfdc ) ;
  PROVIDE ( check_condCOUNTER.7452 = 0x4001cdfe ) ;
  PROVIDE ( check_condCOUNTER.7464 = 0x4001cca8 ) ;
  PROVIDE ( check_condCOUNTER.7469 = 0x4001cca8 ) ;
  PROVIDE ( check_condCOUNTER.7478 = 0x4001cdd4 ) ;
  PROVIDE ( check_condCOUNTER.7487 = 0x4001cd20 ) ;
  PROVIDE ( check_condCOUNTER.7503 = 0x4001ccc4 ) ;
  PROVIDE ( check_condCOUNTER.7513 = 0x4001ccc4 ) ;
  PROVIDE ( check_condCOUNTER.7517 = 0x4001cd06 ) ;
  PROVIDE ( check_condCOUNTER.7527 = 0x4001cd20 ) ;
  PROVIDE ( check_condCOUNTER.7530 = 0x4001ccc4 ) ;
  PROVIDE ( check_condCOUNTER.7533 = 0x4001cd20 ) ;
  PROVIDE ( check_condCOUNTER.7541 = 0x4001ccc4 ) ;
  PROVIDE ( check_condCOUNTER.8001 = 0x40027eca ) ;
  PROVIDE ( check_condCOUNTER.8024 = 0x40027eca ) ;
  PROVIDE ( check_condCOUNTER.8107 = 0x40027eca ) ;
  PROVIDE ( check_condCOUNTER.8119 = 0x40027eca ) ;
  PROVIDE ( chip752_phyrom_version = 0x400031bc ) ;
  PROVIDE ( chip752_phyrom_version_num = 0x400031e0 ) ;
  PROVIDE ( chm_is_at_home_channel = 0x40018e28 ) ;
  PROVIDE ( clear_super_wdt_reset_flag = 0x4001deee ) ;
  PROVIDE ( clearloop = 0x40001736 ) ;
  PROVIDE ( clz_loop = 0x4003717a ) ;
  PROVIDE ( cnx_node_is_existing = 0x40018d5c ) ;
  PROVIDE ( cnx_node_search = 0x40018db4 ) ;
  PROVIDE ( coex_bt_release = 0x4001bc62 ) ;
  PROVIDE ( coex_bt_request = 0x4001bc4c ) ;
  PROVIDE ( coex_core_ble_conn_dyn_prio_get = 0x4001bb9e ) ;
  PROVIDE ( coex_core_event_duration_get = 0x4001bba2 ) ;
  PROVIDE ( coex_core_pti_get = 0x4001ba96 ) ;
  PROVIDE ( coex_core_release = 0x4001bb6a ) ;
  PROVIDE ( coex_core_request = 0x4001baee ) ;
  PROVIDE ( coex_core_status_get = 0x4001bc12 ) ;
  PROVIDE ( coex_core_timer_idx_get = 0x4001bab4 ) ;
  PROVIDE ( coex_event_duration_get = 0x4001bc2c ) ;
  PROVIDE ( coex_hw_timer_disable = 0x4001bd3e ) ;
  PROVIDE ( coex_hw_timer_enable = 0x4001bd1c ) ;
  PROVIDE ( coex_hw_timer_set = 0x4001bc82 ) ;
  PROVIDE ( coex_schm_interval_set = 0x4001ba56 ) ;
  PROVIDE ( coex_schm_lock = 0x4001b9ec ) ;
  PROVIDE ( coex_schm_unlock = 0x4001ba22 ) ;
  PROVIDE ( coex_status_get = 0x4001bc74 ) ;
  PROVIDE ( coex_wifi_release = 0x4001bc3a ) ;
  PROVIDE ( common_mutex = 0x4085fba4 ) ;
  PROVIDE ( common_recursive_mutex = 0x4085fba8 ) ;
  PROVIDE ( complete_sum = 0x40037790 ) ;
  PROVIDE ( config_is_cache_tx_buf_enabled = 0x40016ff0 ) ;
  PROVIDE ( copy_to_hardware = 0x4001bffc ) ;
  PROVIDE ( crc16_be = 0x40021522 ) ;
  PROVIDE ( crc16_be_table = 0x4004ba28 ) ;
  PROVIDE ( crc16_le = 0x400214e4 ) ;
  PROVIDE ( crc16_le_table = 0x4004bc28 ) ;
  PROVIDE ( crc32_be = 0x400214ae ) ;
  PROVIDE ( crc32_be_table = 0x4004be28 ) ;
  PROVIDE ( crc32_le = 0x40021412 ) ;
  PROVIDE ( crc32_le_table = 0x4004c228 ) ;
  PROVIDE ( crc8_be = 0x4002159a ) ;
  PROVIDE ( crc8_be_table = 0x4004c628 ) ;
  PROVIDE ( crc8_le = 0x40021566 ) ;
  PROVIDE ( crc8_le_table = 0x4004c728 ) ;
  PROVIDE ( default_walker = 0x4002da90 ) ;
  PROVIDE ( denormal = 0x40037878 ) ;
  PROVIDE ( denormal_canc = 0x40037848 ) ;
  PROVIDE ( denormal_cancellation = 0x400370be ) ;
  PROVIDE ( denormal_end = 0x40037470 ) ;
  PROVIDE ( denormal_or_str_canc = 0x400377b6 ) ;
  PROVIDE ( denormal_or_strong_cancellation = 0x400370b4 ) ;
  PROVIDE ( detect_spi_flash_chip = 0x4002a52a ) ;
  PROVIDE ( detect_uart_usb_spi_sdio_boot_mode = 0x4001cd42 ) ;
  PROVIDE ( diff_sign = 0x40037098 ) ;
  PROVIDE ( digest_matches = 0x4001df44 ) ;
  PROVIDE ( disable_default_watchdog = 0x400213ce ) ;
  PROVIDE ( div = 0x40037e66 ) ;
  PROVIDE ( do_sleep_wake = 0x40001682 ) ;
  PROVIDE ( ds_wait_idle = 0x40027144 ) ;
  PROVIDE ( ebuf_list_remove = 0x4000f428 ) ;
  PROVIDE ( end = 0x40037cae ) ;
  PROVIDE ( eq_63_end = 0x40037aec ) ;
  PROVIDE ( equal = 0x4003789a ) ;
  PROVIDE ( equal_nodenormal = 0x400378c0 ) ;
  PROVIDE ( equal_samesign = 0x400378a4 ) ;
  PROVIDE ( esf_buf_alloc = 0x4000f62c ) ;
  PROVIDE ( esf_buf_alloc_dynamic = 0x4000f436 ) ;
  PROVIDE ( esf_buf_recycle = 0x4000f2c4 ) ;
  PROVIDE ( esp_coex_ble_conn_dynamic_prio_get = 0x4001bc28 ) ;
  PROVIDE ( esp_coex_rom_version_get = 0x4001bc1e ) ;
  PROVIDE ( esp_crc8 = 0x400215ce ) ;
  PROVIDE ( esp_enable_cache_flash_wrap = 0x40029ed4 ) ;
  PROVIDE ( esp_flash_chip_driver_initialized = 0x4002a4d8 ) ;
  PROVIDE ( esp_flash_default_api_funcs = 0x4004dbc4 ) ;
  PROVIDE ( esp_flash_erase_chip = 0x4002a5ee ) ;
  PROVIDE ( esp_flash_erase_region = 0x4002a67e ) ;
  PROVIDE ( esp_flash_get_chip_write_protect = 0x4002a832 ) ;
  PROVIDE ( esp_flash_get_io_mode = 0x4002add2 ) ;
  PROVIDE ( esp_flash_get_protectable_regions = 0x4002a8d4 ) ;
  PROVIDE ( esp_flash_get_protected_region = 0x4002a922 ) ;
  PROVIDE ( esp_flash_get_size = 0x4002a586 ) ;
  PROVIDE ( esp_flash_read = 0x4002aa56 ) ;
  PROVIDE ( esp_flash_read_chip_id = 0x4002a51c ) ;
  PROVIDE ( esp_flash_read_encrypted = 0x4002ada8 ) ;
  PROVIDE ( esp_flash_read_id = 0x4002a4e0 ) ;
  PROVIDE ( esp_flash_set_chip_write_protect = 0x4002a888 ) ;
  PROVIDE ( esp_flash_set_io_mode = 0x4002ae2c ) ;
  PROVIDE ( esp_flash_set_protected_region = 0x4002a9b6 ) ;
  PROVIDE ( esp_flash_suspend_cmd_init = 0x4002ae80 ) ;
  PROVIDE ( esp_flash_write = 0x4002ab46 ) ;
  PROVIDE ( esp_flash_write_encrypted = 0x4002ac66 ) ;
  PROVIDE ( esp_net80211_rom_version_get = 0x40018d52 ) ;
  PROVIDE ( esp_pp_rom_version_get = 0x40015c68 ) ;
  PROVIDE ( esp_rom_check_recover_key = 0x4002f710 ) ;
  PROVIDE ( esp_rom_get_rtc_wake_addr = 0x4001deae ) ;
  PROVIDE ( esp_rom_km_huk_conf = 0x4002f53c ) ;
  PROVIDE ( esp_rom_km_huk_risk = 0x4002faaa ) ;
  PROVIDE ( esp_rom_newlib_init_common_mutexes = 0x400267e0 ) ;
  PROVIDE ( esp_rom_opiflash_backup_reg = 0x4002c3fe ) ;
  PROVIDE ( esp_rom_opiflash_exec_cmd = 0x4002c42a ) ;
  PROVIDE ( esp_rom_opiflash_recover_reg = 0x4002c414 ) ;
  PROVIDE ( esp_rom_set_rtc_wake_addr = 0x4001de52 ) ;
  PROVIDE ( esp_rom_spi_cmd_config = 0x4002c23c ) ;
  PROVIDE ( esp_rom_spi_cmd_start = 0x4002c4a8 ) ;
  PROVIDE ( esp_rom_spi_flash_auto_sus_res = 0x40029dbc ) ;
  PROVIDE ( esp_rom_spi_flash_send_resume = 0x40029d7e ) ;
  PROVIDE ( esp_rom_spi_flash_update_id = 0x400296f0 ) ;
  PROVIDE ( esp_rom_spi_reset_rw_mode = 0x4002c144 ) ;
  PROVIDE ( esp_rom_spi_set_address_bit_len = 0x40028a32 ) ;
  PROVIDE ( esp_rom_spi_set_op_mode = 0x4002c168 ) ;
  PROVIDE ( esp_rom_spi_set_rd_cmd_bit_len = 0x40028a78 ) ;
  PROVIDE ( esp_rom_spiflash_config_clk = 0x40029924 ) ;
  PROVIDE ( esp_rom_spiflash_config_param = 0x40029d5a ) ;
  PROVIDE ( esp_rom_spiflash_config_readmode = 0x4002980e ) ;
  PROVIDE ( esp_rom_spiflash_erase_block = 0x400299f2 ) ;
  PROVIDE ( esp_rom_spiflash_erase_chip = 0x40029970 ) ;
  PROVIDE ( esp_rom_spiflash_erase_sector = 0x40029a6a ) ;
  PROVIDE ( esp_rom_spiflash_read = 0x40029c7a ) ;
  PROVIDE ( esp_rom_spiflash_read_status = 0x40028dc0 ) ;
  PROVIDE ( esp_rom_spiflash_read_statushigh = 0x40028f62 ) ;
  PROVIDE ( esp_rom_spiflash_read_user_cmd = 0x40028d4a ) ;
  PROVIDE ( esp_rom_spiflash_select_qio_pins = 0x40028af0 ) ;
  PROVIDE ( esp_rom_spiflash_unlock = 0x400297aa ) ;
  PROVIDE ( esp_rom_spiflash_wait_idle = 0x40029348 ) ;
  PROVIDE ( esp_rom_spiflash_write = 0x40029b48 ) ;
  PROVIDE ( esp_rom_spiflash_write_disable = 0x40028e34 ) ;
  PROVIDE ( esp_rom_spiflash_write_encrypted = 0x4002a0b2 ) ;
  PROVIDE ( esp_rom_spiflash_write_encrypted_dest = 0x40029f1e ) ;
  PROVIDE ( esp_rom_spiflash_write_encrypted_disable = 0x40029f12 ) ;
  PROVIDE ( esp_rom_spiflash_write_encrypted_enable = 0x40029efa ) ;
  PROVIDE ( esp_rom_spiflash_write_status = 0x40028f88 ) ;
  PROVIDE ( esp_test_clr_rx_error_occurs = 0x40018294 ) ;
  PROVIDE ( esp_test_clr_rx_mu_statistics = 0x40017604 ) ;
  PROVIDE ( esp_test_clr_rx_statistics = 0x40018188 ) ;
  PROVIDE ( esp_test_clr_tx_statistics = 0x4001857c ) ;
  PROVIDE ( esp_test_clr_tx_tb_statistics = 0x40018642 ) ;
  PROVIDE ( esp_test_disable_rx_mu_statistics = 0x4001762e ) ;
  PROVIDE ( esp_test_disable_rx_statistics = 0x400182ba ) ;
  PROVIDE ( esp_test_disable_tx_statistics = 0x400183de ) ;
  PROVIDE ( esp_test_enable_rx_mu_statistics = 0x4001765a ) ;
  PROVIDE ( esp_test_enable_rx_statistics = 0x4001831a ) ;
  PROVIDE ( esp_test_enable_tx_statistics = 0x40018492 ) ;
  PROVIDE ( esp_test_get_rx_error_occurs = 0x40018274 ) ;
  PROVIDE ( esp_test_get_rx_mu_statistics = 0x400175b6 ) ;
  PROVIDE ( esp_test_get_rx_statistics = 0x400181e8 ) ;
  PROVIDE ( esp_test_get_tx_statistics = 0x400185d8 ) ;
  PROVIDE ( esp_test_get_tx_tb_statistics = 0x4001867a ) ;
  PROVIDE ( esp_test_rx_parse_mu = 0x40017578 ) ;
  PROVIDE ( esp_test_rx_process_complete = 0x400180a2 ) ;
  PROVIDE ( esp_test_set_rx_error_occurs = 0x40018234 ) ;
  PROVIDE ( esp_test_tx_count_collision = 0x40018cda ) ;
  PROVIDE ( esp_test_tx_count_retry = 0x40018cb8 ) ;
  PROVIDE ( esp_test_tx_count_timeout = 0x40018cf2 ) ;
  PROVIDE ( esp_test_tx_enab_statistics = 0x40018aca ) ;
  PROVIDE ( esp_test_tx_process_complete = 0x40018918 ) ;
  PROVIDE ( esp_test_tx_process_txq_state = 0x40018a28 ) ;
  PROVIDE ( esp_test_tx_tb_complete = 0x40018bfe ) ;
  PROVIDE ( esp_wifi_internal_tx = 0x400191de ) ;
  PROVIDE ( esprv_intc_int_disable = 0x4001bdc2 ) ;
  PROVIDE ( esprv_intc_int_enable = 0x4001bd96 ) ;
  PROVIDE ( esprv_intc_int_set_priority = 0x4001be20 ) ;
  PROVIDE ( esprv_intc_int_set_threshold = 0x4001be38 ) ;
  PROVIDE ( esprv_intc_int_set_type = 0x4001bdec ) ;
  PROVIDE ( ets_aes_block = 0x40026ebc ) ;
  PROVIDE ( ets_aes_disable = 0x40026e34 ) ;
  PROVIDE ( ets_aes_enable = 0x40026dfc ) ;
  PROVIDE ( ets_aes_setkey = 0x40026e54 ) ;
  PROVIDE ( ets_aes_setkey_dec = 0x40026eaa ) ;
  PROVIDE ( ets_aes_setkey_enc = 0x40026e98 ) ;
  PROVIDE ( ets_bigint_disable = 0x40027014 ) ;
  PROVIDE ( ets_bigint_enable = 0x40026fb0 ) ;
  PROVIDE ( ets_bigint_getz = 0x4002710e ) ;
  PROVIDE ( ets_bigint_modcommon = 0x40026eea ) ;
  PROVIDE ( ets_bigint_modexp = 0x400270d8 ) ;
  PROVIDE ( ets_bigint_modmult = 0x400270b6 ) ;
  PROVIDE ( ets_bigint_multiply = 0x40027040 ) ;
  PROVIDE ( ets_bigint_wait_finish = 0x400270fa ) ;
  PROVIDE ( ets_clk_assist_debug_clock_enable = 0x4001f0a6 ) ;
  PROVIDE ( ets_clk_get_cpu_freq = 0x4001f02c ) ;
  PROVIDE ( ets_clk_get_xtal_freq = 0x4001f00c ) ;
  PROVIDE ( ets_clock_init = 0x4001f0d2 ) ;
  PROVIDE ( ets_config_flash_by_image_hdr = 0x4001f4b4 ) ;
  PROVIDE ( ets_delay_us = 0x4001bfac ) ;
  PROVIDE ( ets_ds_disable = 0x40027198 ) ;
  PROVIDE ( ets_ds_enable = 0x4002715e ) ;
  PROVIDE ( ets_ds_encrypt_params = 0x400272ee ) ;
  PROVIDE ( ets_ds_finish_sign = 0x40027286 ) ;
  PROVIDE ( ets_ds_is_busy = 0x400271b8 ) ;
  PROVIDE ( ets_ds_start_sign = 0x400271c6 ) ;
  PROVIDE ( ets_ecdsa_verify = 0x4001c02a ) ;
  PROVIDE ( ets_efuse_cache_encryption_enabled = 0x40020206 ) ;
  PROVIDE ( ets_efuse_check_secure_version = 0x400202d6 ) ;
  PROVIDE ( ets_efuse_clear_program_registers = 0x4001fc9c ) ;
  PROVIDE ( ets_efuse_config_wr_tim = 0x40020282 ) ;
  PROVIDE ( ets_efuse_count_unused_key_blocks = 0x4001fe68 ) ;
  PROVIDE ( ets_efuse_direct_boot_mode_disabled = 0x400200e6 ) ;
  PROVIDE ( ets_efuse_download_modes_disabled = 0x400200d8 ) ;
  PROVIDE ( ets_efuse_fe_use_km_key = 0x40020272 ) ;
  PROVIDE ( ets_efuse_find_purpose = 0x4001fdac ) ;
  PROVIDE ( ets_efuse_find_unused_key_block = 0x4001fe4a ) ;
  PROVIDE ( ets_efuse_force_send_resume = 0x4002015a ) ;
  PROVIDE ( ets_efuse_get_flash_delay_us = 0x40020224 ) ;
  PROVIDE ( ets_efuse_get_force_use_km_key = 0x40020242 ) ;
  PROVIDE ( ets_efuse_get_key_purpose = 0x4001fd64 ) ;
  PROVIDE ( ets_efuse_get_km_key_lock = 0x40020262 ) ;
  PROVIDE ( ets_efuse_get_read_register_address = 0x4001fd48 ) ;
  PROVIDE ( ets_efuse_get_uart_print_control = 0x400200f6 ) ;
  PROVIDE ( ets_efuse_jtag_disabled = 0x4002004a ) ;
  PROVIDE ( ets_efuse_key_block_unused = 0x4001fdde ) ;
  PROVIDE ( ets_efuse_ll_bootloader_anti_rollback_secure_version = 0x4001fbd4 ) ;
  PROVIDE ( ets_efuse_program = 0x4001fcd6 ) ;
  PROVIDE ( ets_efuse_read = 0x4001fc5c ) ;
  PROVIDE ( ets_efuse_rs_calculate = 0x4001c1da ) ;
  PROVIDE ( ets_efuse_secure_boot_aggressive_revoke_enabled = 0x400201a4 ) ;
  PROVIDE ( ets_efuse_secure_boot_enabled = 0x40020186 ) ;
  PROVIDE ( ets_efuse_secure_boot_fast_wake_enabled = 0x400201f2 ) ;
  PROVIDE ( ets_efuse_secure_boot_key_revoked = 0x400201b4 ) ;
  PROVIDE ( ets_efuse_secure_boot_sha384_enabled = 0x40020196 ) ;
  PROVIDE ( ets_efuse_security_download_modes_enabled = 0x4002016a ) ;
  PROVIDE ( ets_efuse_update_secure_version = 0x400203c2 ) ;
  PROVIDE ( ets_efuse_usb_device_disabled = 0x4002014a ) ;
  PROVIDE ( ets_efuse_usb_download_mode_disabled = 0x40020120 ) ;
  PROVIDE ( ets_efuse_usb_print_is_disabled = 0x40020106 ) ;
  PROVIDE ( ets_efuse_write_key = 0x4001fe88 ) ;
  PROVIDE ( ets_efuse_xts_key_length_256 = 0x40020252 ) ;
  PROVIDE ( ets_emsa_pss_verify = 0x4001dbe4 ) ;
  PROVIDE ( ets_fatal_exception_handler = 0x4001be5e ) ;
  PROVIDE ( ets_get_bootloader_offset = 0x4001ce36 ) ;
  PROVIDE ( ets_get_cpu_frequency = 0x4001bfd2 ) ;
  PROVIDE ( ets_get_printf_channel = 0x4001db4c ) ;
  PROVIDE ( ets_get_secure_boot_version = 0x4001f002 ) ;
  PROVIDE ( ets_hmac_calculate_downstream = 0x4002777c ) ;
  PROVIDE ( ets_hmac_calculate_message = 0x4002764e ) ;
  PROVIDE ( ets_hmac_disable = 0x4002762e ) ;
  PROVIDE ( ets_hmac_enable = 0x400275ec ) ;
  PROVIDE ( ets_hmac_invalidate_downstream = 0x4002779c ) ;
  PROVIDE ( ets_idle_arg = 0x4085edb4 ) ;
  PROVIDE ( ets_idle_cb = 0x4085edb8 ) ;
  PROVIDE ( ets_install_lock = 0x4001da94 ) ;
  PROVIDE ( ets_install_putc1 = 0x4001daa6 ) ;
  PROVIDE ( ets_install_putc2 = 0x4001dab0 ) ;
  PROVIDE ( ets_install_uart_printf = 0x4001daba ) ;
  PROVIDE ( ets_install_usb_printf = 0x4001dacc ) ;
  PROVIDE ( ets_intr_lock = 0x4001cc3c ) ;
  PROVIDE ( ets_intr_register_ctx = 0x4001cc32 ) ;
  PROVIDE ( ets_intr_unlock = 0x4001cc56 ) ;
  PROVIDE ( ets_isr_attach = 0x4001cc76 ) ;
  PROVIDE ( ets_isr_mask = 0x4001cc82 ) ;
  PROVIDE ( ets_isr_unmask = 0x4001cc8e ) ;
  PROVIDE ( ets_jtag_enable_temporarily = 0x40020082 ) ;
  PROVIDE ( ets_loader_is_direct_boot_jump = 0x4001f578 ) ;
  PROVIDE ( ets_loader_map_range = 0x4001f38c ) ;
  PROVIDE ( ets_mgf1_sha256 = 0x4001db56 ) ;
  PROVIDE ( ets_ops_default_table = 0x4004adb8 ) ;
  PROVIDE ( ets_post = 0x4001f1c4 ) ;
  PROVIDE ( ets_printf = 0x4001dade ) ;
  PROVIDE ( ets_printf_lock = 0x4085fb94 ) ;
  PROVIDE ( ets_printf_uart = 0x4085fb98 ) ;
  PROVIDE ( ets_printf_unlock = 0x4085fb9c ) ;
  PROVIDE ( ets_readySet_ = 0x4085edbc ) ;
  PROVIDE ( ets_rom_layout = 0x4004b468 ) ;
  PROVIDE ( ets_rsa_pss_verify = 0x4001dd68 ) ;
  PROVIDE ( ets_run = 0x4001f118 ) ;
  PROVIDE ( ets_run_direct_boot = 0x4001f59c ) ;
  PROVIDE ( ets_run_flash_bootloader = 0x4001f628 ) ;
  PROVIDE ( ets_secure_boot_read_key_digests = 0x4001e29a ) ;
  PROVIDE ( ets_secure_boot_revoke_public_key_digest = 0x4001e34e ) ;
  PROVIDE ( ets_secure_boot_verify_bootloader_with_keys = 0x4001ee92 ) ;
  PROVIDE ( ets_secure_boot_verify_bootloader_with_keys_sha256 = 0x4001e6da ) ;
  PROVIDE ( ets_secure_boot_verify_bootloader_with_keys_sha384 = 0x4001ea6e ) ;
  PROVIDE ( ets_secure_boot_verify_signature = 0x4001e3a4 ) ;
  PROVIDE ( ets_secure_boot_verify_stage_bootloader = 0x4001eed4 ) ;
  PROVIDE ( ets_set_bootloader_offset = 0x4001ce40 ) ;
  PROVIDE ( ets_set_printf_channel = 0x4001db42 ) ;
  PROVIDE ( ets_set_user_start = 0x4001ce4a ) ;
  PROVIDE ( ets_sha_clone = 0x4002795e ) ;
  PROVIDE ( ets_sha_disable = 0x4002781e ) ;
  PROVIDE ( ets_sha_enable = 0x400277d2 ) ;
  PROVIDE ( ets_sha_finish = 0x40027b3e ) ;
  PROVIDE ( ets_sha_get_state = 0x4002791e ) ;
  PROVIDE ( ets_sha_init = 0x4002783e ) ;
  PROVIDE ( ets_sha_process = 0x4002799e ) ;
  PROVIDE ( ets_sha_starts = 0x4002786c ) ;
  PROVIDE ( ets_sha_update = 0x40027a48 ) ;
  PROVIDE ( ets_spi_download_disabled = 0x4001ccde ) ;
  PROVIDE ( ets_stack_guard_setup = 0x400269a8 ) ;
  PROVIDE ( ets_startup_callback = 0x4085e5a8 ) ;
  PROVIDE ( ets_task = 0x4001f0ee ) ;
  PROVIDE ( ets_uart_download = 0x4001cd9a ) ;
  PROVIDE ( ets_update_cpu_frequency = 0x4001bfc8 ) ;
  PROVIDE ( ets_vprintf = 0x4001d712 ) ;
  PROVIDE ( ets_waiti0 = 0x4001cc70 ) ;
  PROVIDE ( ets_write_char = 0x4001d624 ) ;
  PROVIDE ( ets_write_char_uart = 0x4001d648 ) ;
  PROVIDE ( ets_write_char_usb = 0x4001d66a ) ;
  PROVIDE ( exc_cause_table.2004 = 0x4004aad4 ) ;
  PROVIDE ( exit = 0x40037c6e ) ;
  PROVIDE ( exp_sign_and_exit = 0x40037090 ) ;
  PROVIDE ( explicit_bzero = 0x40037e8e ) ;
  PROVIDE ( fflush = 0x400380a0 ) ;
  PROVIDE ( find_region.isra.0 = 0x4002a490 ) ;
  PROVIDE ( fiprintf = 0x400380e2 ) ;
  PROVIDE ( flash2spiram_instruction_offset = 0x4002d020 ) ;
  PROVIDE ( flash2spiram_rodata_offset = 0x4002d02a ) ;
  PROVIDE ( flash_end_flush_cache = 0x4002a3b8 ) ;
  PROVIDE ( flash_instr_rodata_end_page = 0x4002d04a ) ;
  PROVIDE ( flash_instr_rodata_start_page = 0x4002d034 ) ;
  PROVIDE ( flash_mmap_free_internal_cb = 0x4085fb40 ) ;
  PROVIDE ( flash_mmap_malloc_internal_cb = 0x4085fb44 ) ;
  PROVIDE ( fprintf = 0x400380e2 ) ;
  PROVIDE ( free = 0x40026d3c ) ;
  PROVIDE ( g_offset_of_active_bootloader = 0x4085e5ac ) ;
  PROVIDE ( g_shared_buffers = 0x4084e5a0 ) ;
  PROVIDE ( g_sip = 0x4085efcc ) ;
  PROVIDE ( g_wdev_last_desc_reset = 0x4085faa4 ) ;
  PROVIDE ( ge_32 = 0x40037b8e ) ;
  PROVIDE ( get_estimated_batime = 0x4000e462 ) ;
  PROVIDE ( get_sublen_offset = 0x4001654e ) ;
  PROVIDE ( gpio_bypass_matrix_in = 0x40026604 ) ;
  PROVIDE ( gpio_get_input_level = 0x400265e2 ) ;
  PROVIDE ( gpio_matrix_in = 0x4002661a ) ;
  PROVIDE ( gpio_matrix_out = 0x4002663e ) ;
  PROVIDE ( gpio_output_disable = 0x400266a8 ) ;
  PROVIDE ( gpio_output_enable = 0x40026680 ) ;
  PROVIDE ( gpio_pad_hold = 0x400267a2 ) ;
  PROVIDE ( gpio_pad_input_disable = 0x4002676e ) ;
  PROVIDE ( gpio_pad_input_enable = 0x40026756 ) ;
  PROVIDE ( gpio_pad_pulldown = 0x40026736 ) ;
  PROVIDE ( gpio_pad_pullup = 0x40026716 ) ;
  PROVIDE ( gpio_pad_select_gpio = 0x400266d0 ) ;
  PROVIDE ( gpio_pad_set_drv = 0x400266ee ) ;
  PROVIDE ( gpio_pad_unhold = 0x40026786 ) ;
  PROVIDE ( gpio_set_output_level = 0x4002659a ) ;
  PROVIDE ( hal_ba_session_restore = 0x40015d0e ) ;
  PROVIDE ( hal_ba_session_store = 0x40015cc0 ) ;
  PROVIDE ( hal_enable_rx_statistics = 0x40018380 ) ;
  PROVIDE ( hal_enable_tsf_timer = 0x40008e34 ) ;
  PROVIDE ( hal_enable_tx_statistics = 0x40018d0e ) ;
  PROVIDE ( hal_get_sta_tsf = 0x4000966a ) ;
  PROVIDE ( hal_get_tsf_time = 0x40008df6 ) ;
  PROVIDE ( hal_he_get_aid = 0x400165d8 ) ;
  PROVIDE ( hal_he_get_bss_color = 0x4001216c ) ;
  PROVIDE ( hal_he_get_mplen_addr_end = 0x40013fea ) ;
  PROVIDE ( hal_he_get_mplen_addr_start = 0x40013f98 ) ;
  PROVIDE ( hal_he_set_bf_report_rate = 0x40014706 ) ;
  PROVIDE ( hal_he_set_ersu = 0x400146dc ) ;
  PROVIDE ( hal_he_set_ersu_ack_rate = 0x4001467e ) ;
  PROVIDE ( hal_he_set_htc = 0x400127a4 ) ;
  PROVIDE ( hal_he_set_tx_protection = 0x400118be ) ;
  PROVIDE ( hal_mac_clr_txq_state = 0x400142e8 ) ;
  PROVIDE ( hal_mac_deinit = 0x400096fa ) ;
  PROVIDE ( hal_mac_deinit_twt_tx = 0x4000969e ) ;
  PROVIDE ( hal_mac_get_txq_complete = 0x4001432e ) ;
  PROVIDE ( hal_mac_get_txq_state = 0x4001427e ) ;
  PROVIDE ( hal_mac_interrupt_clr_bsscolor = 0x40015e20 ) ;
  PROVIDE ( hal_mac_interrupt_clr_rx_evm = 0x40015e32 ) ;
  PROVIDE ( hal_mac_is_dma_enable = 0x40015d74 ) ;
  PROVIDE ( hal_mac_is_low_rate_enabled = 0x400147a4 ) ;
  PROVIDE ( hal_mac_rx_disable = 0x40015ca8 ) ;
  PROVIDE ( hal_mac_rx_enable = 0x40015c94 ) ;
  PROVIDE ( hal_mac_rx_get_last_dscr = 0x40015c72 ) ;
  PROVIDE ( hal_mac_rx_is_dscr_reload = 0x40016092 ) ;
  PROVIDE ( hal_mac_rx_set_dscr_reload = 0x40016080 ) ;
  PROVIDE ( hal_mac_tx_clr_mplen = 0x40014198 ) ;
  PROVIDE ( hal_mac_tx_get_blockack = 0x40012e30 ) ;
  PROVIDE ( hal_mac_tx_set_ppdu = 0x400127d6 ) ;
  PROVIDE ( hal_mac_txq_enable = 0x40011512 ) ;
  PROVIDE ( hal_now = 0x400112cc ) ;
  PROVIDE ( hal_random = 0x40011620 ) ;
  PROVIDE ( hal_tsf_clear_soc_wakeup_request = 0x4000923a ) ;
  PROVIDE ( hal_tsf_timer_set_target = 0x40008dd2 ) ;
  PROVIDE ( hal_vht_sta_get_aid = 0x400165e4 ) ;
  PROVIDE ( hal_wdev_timer_set_target = 0x40008d7e ) ;
  PROVIDE ( hal_wdev_timer_target_enable = 0x40008d9a ) ;
  PROVIDE ( he_get_min_subframe_len = 0x4000e006 ) ;
  PROVIDE ( he_get_min_subframe_len_dcm = 0x4000df46 ) ;
  PROVIDE ( he_rates_dcm_ru_106 = 0x4004a6d4 ) ;
  PROVIDE ( he_rates_dcm_ru_242 = 0x4004a710 ) ;
  PROVIDE ( he_rates_dcm_ru_26 = 0x4004a74c ) ;
  PROVIDE ( he_rates_dcm_ru_52 = 0x4004a788 ) ;
  PROVIDE ( hmac_start = 0x400275a0 ) ;
  PROVIDE ( hmac_wait_idle = 0x40027566 ) ;
  PROVIDE ( hmac_write_block = 0x40027570 ) ;
  PROVIDE ( ht_get_min_subframe_len = 0x4000e0dc ) ;
  PROVIDE ( huffext = 0x4002502a ) ;
  PROVIDE ( ic_ebuf_alloc = 0x400191c2 ) ;
  PROVIDE ( ic_ebuf_recycle_rx = 0x4001a3e6 ) ;
  PROVIDE ( ic_ebuf_recycle_tx = 0x400191d0 ) ;
  PROVIDE ( ic_get_he_rts_threshold_bytes = 0x40010c84 ) ;
  PROVIDE ( ic_get_trc = 0x40015a7a ) ;
  PROVIDE ( ic_interface_enabled = 0x4001699c ) ;
  PROVIDE ( ic_mac_deinit = 0x400097ce ) ;
  PROVIDE ( ic_mac_init = 0x4000979c ) ;
  PROVIDE ( ic_reset_extra_softap_rx_ba = 0x4001aec4 ) ;
  PROVIDE ( ic_reset_rx_ba = 0x4001ae32 ) ;
  PROVIDE ( ieee80211_align_eb = 0x400198c6 ) ;
  PROVIDE ( ieee80211_alloc_tx_buf = 0x40019272 ) ;
  PROVIDE ( ieee80211_ampdu_reorder = 0x4001af5a ) ;
  PROVIDE ( ieee80211_ampdu_start_age_timer = 0x4001adf4 ) ;
  PROVIDE ( ieee80211_classify = 0x40019054 ) ;
  PROVIDE ( ieee80211_copy_eb_header = 0x400191f4 ) ;
  PROVIDE ( ieee80211_crypto_decap = 0x4001b384 ) ;
  PROVIDE ( ieee80211_crypto_encap = 0x4001b318 ) ;
  PROVIDE ( ieee80211_decap = 0x4001b428 ) ;
  PROVIDE ( ieee80211_encap_esfbuf = 0x4001994a ) ;
  PROVIDE ( ieee80211_encap_esfbuf_htc = 0x4001b616 ) ;
  PROVIDE ( ieee80211_find_elem = 0x4001b732 ) ;
  PROVIDE ( ieee80211_find_elem_match = 0x4001b6a4 ) ;
  PROVIDE ( ieee80211_find_ext_elem = 0x4001b746 ) ;
  PROVIDE ( ieee80211_find_ext_ie = 0x4001b782 ) ;
  PROVIDE ( ieee80211_find_ie = 0x4001b76e ) ;
  PROVIDE ( ieee80211_find_ie_match = 0x4001b720 ) ;
  PROVIDE ( ieee80211_gettid = 0x4001a33c ) ;
  PROVIDE ( ieee80211_is_tx_allowed = 0x4001986a ) ;
  PROVIDE ( ieee80211_merge_mbssid_profile = 0x4001b7aa ) ;
  PROVIDE ( ieee80211_output_do = 0x40019390 ) ;
  PROVIDE ( ieee80211_output_pending_eb = 0x40018e40 ) ;
  PROVIDE ( ieee80211_output_process = 0x40019584 ) ;
  PROVIDE ( ieee80211_post_hmac_tx = 0x400192f8 ) ;
  PROVIDE ( ieee80211_recycle_cache_eb = 0x40018ef2 ) ;
  PROVIDE ( ieee80211_search_node = 0x40018f3c ) ;
  PROVIDE ( ieee80211_set_tx_desc = 0x4001a0b0 ) ;
  PROVIDE ( ieee80211_set_tx_pti = 0x4001b5de ) ;
  PROVIDE ( inf = 0x400378dc ) ;
  PROVIDE ( inf_inf = 0x4003712e ) ;
  PROVIDE ( inf_nan = 0x4003751e ) ;
  PROVIDE ( infnan = 0x400378f0 ) ;
  PROVIDE ( infnan_B_only = 0x400378e8 ) ;
  PROVIDE ( infnan_end = 0x400378f8 ) ;
  PROVIDE ( instr_offset = 0x4085fb6c ) ;
  PROVIDE ( instr_page_cnt = 0x4085fb70 ) ;
  PROVIDE ( instr_start_page = 0x4085fb74 ) ;
  PROVIDE ( integrity_walker = 0x4002da32 ) ;
  PROVIDE ( intr_handler_set = 0x4001bd60 ) ;
  PROVIDE ( intr_matrix_set = 0x4001cc9a ) ;
  PROVIDE ( iprintf = 0x400392ec ) ;
  PROVIDE ( is_lmac_idle = 0x400113ac ) ;
  PROVIDE ( is_ndpa_to_dut = 0x400165f2 ) ;
  PROVIDE ( is_use_muedca = 0x4001162e ) ;
  PROVIDE ( isalnum = 0x400381e2 ) ;
  PROVIDE ( isalpha = 0x400381f4 ) ;
  PROVIDE ( isascii = 0x40038206 ) ;
  PROVIDE ( isblank = 0x4003820c ) ;
  PROVIDE ( iscntrl = 0x4003822a ) ;
  PROVIDE ( isdigit = 0x4003823e ) ;
  PROVIDE ( isgraph = 0x40038268 ) ;
  PROVIDE ( islower = 0x40038250 ) ;
  PROVIDE ( isprint = 0x4003827a ) ;
  PROVIDE ( ispunct = 0x4003828e ) ;
  PROVIDE ( isspace = 0x400382a0 ) ;
  PROVIDE ( isupper = 0x400382b2 ) ;
  PROVIDE ( itoa = 0x40038312 ) ;
  PROVIDE ( jd_decomp = 0x40025534 ) ;
  PROVIDE ( jd_prepare = 0x400250d2 ) ;
  PROVIDE ( km_key_recover.constprop.2 = 0x4002f61c ) ;
  PROVIDE ( km_log = 0x4085fbb0 ) ;
  PROVIDE ( l_taskCB = 0x4085edc0 ) ;
  PROVIDE ( labs = 0x40038314 ) ;
  PROVIDE ( ldiv = 0x4003831e ) ;
  PROVIDE ( lldesc_build_chain = 0x4002fab6 ) ;
  PROVIDE ( lldesc_num2link = 0x4002fbce ) ;
  PROVIDE ( lldesc_set_owner = 0x4002fbfe ) ;
  PROVIDE ( lmacAdjustTimestamp = 0x4001133e ) ;
  PROVIDE ( lmacDisableTransmit = 0x40013230 ) ;
  PROVIDE ( lmacDiscardAgedMSDU = 0x40012c92 ) ;
  PROVIDE ( lmacDiscardFrameExchangeSequence = 0x40013398 ) ;
  PROVIDE ( lmacDiscardMSDU = 0x40012ca4 ) ;
  PROVIDE ( lmacEndFrameExchangeSequence = 0x40012f80 ) ;
  PROVIDE ( lmacEndRetryAMPDUFail = 0x40012ec0 ) ;
  PROVIDE ( lmacIsIdle = 0x40011390 ) ;
  PROVIDE ( lmacIsLongFrame = 0x400115f8 ) ;
  PROVIDE ( lmacMSDUAged = 0x400112d6 ) ;
  PROVIDE ( lmacPostTxComplete = 0x40015db4 ) ;
  PROVIDE ( lmacProcessAckTimeout = 0x400137f2 ) ;
  PROVIDE ( lmacProcessAllTxTimeout = 0x40015dc6 ) ;
  PROVIDE ( lmacProcessCollision = 0x40013c80 ) ;
  PROVIDE ( lmacProcessCollisions = 0x40015dd8 ) ;
  PROVIDE ( lmacProcessCollisions_task = 0x40013bbc ) ;
  PROVIDE ( lmacProcessCtsTimeout = 0x400137b6 ) ;
  PROVIDE ( lmacProcessLongFrameSuccess = 0x40013358 ) ;
  PROVIDE ( lmacProcessLongRetryFail = 0x40013564 ) ;
  PROVIDE ( lmacProcessModemStateRxBeacon = 0x40015da0 ) ;
  PROVIDE ( lmacProcessRxSucData = 0x40015d78 ) ;
  PROVIDE ( lmacProcessShortFrameSuccess = 0x40013318 ) ;
  PROVIDE ( lmacProcessShortRetryFail = 0x400138d4 ) ;
  PROVIDE ( lmacProcessTxComplete = 0x400144f8 ) ;
  PROVIDE ( lmacProcessTxError = 0x40013ece ) ;
  PROVIDE ( lmacProcessTxRtsError = 0x40013ce8 ) ;
  PROVIDE ( lmacProcessTxSuccess = 0x40013d8e ) ;
  PROVIDE ( lmacProcessTxseckiderr = 0x40013e94 ) ;
  PROVIDE ( lmacReachLongLimit = 0x40012e84 ) ;
  PROVIDE ( lmacReachShortLimit = 0x40012e6e ) ;
  PROVIDE ( lmacRecycleMPDU = 0x400112aa ) ;
  PROVIDE ( lmacRetryTxFrame = 0x4001345a ) ;
  PROVIDE ( lmacRxDone = 0x400132f0 ) ;
  PROVIDE ( lmacSetTxFrame = 0x400129aa ) ;
  PROVIDE ( lmacTxDone = 0x40011414 ) ;
  PROVIDE ( lmacTxFrame = 0x40011652 ) ;
  PROVIDE ( longjmp = 0x4003981c ) ;
  PROVIDE ( lower_denormal = 0x400370c8 ) ;
  PROVIDE ( mac_tx_set_duration = 0x40011b8e ) ;
  PROVIDE ( mac_tx_set_hesig = 0x400122c6 ) ;
  PROVIDE ( mac_tx_set_htsig = 0x40011d30 ) ;
  PROVIDE ( mac_tx_set_len = 0x40011bc8 ) ;
  PROVIDE ( mac_tx_set_mplen = 0x4001403e ) ;
  PROVIDE ( mac_tx_set_plcp0 = 0x40011906 ) ;
  PROVIDE ( mac_tx_set_plcp1 = 0x40011a20 ) ;
  PROVIDE ( mac_tx_set_plcp2 = 0x40011b56 ) ;
  PROVIDE ( mac_tx_set_pti = 0x4001207a ) ;
  PROVIDE ( mac_tx_set_tb = 0x40012196 ) ;
  PROVIDE ( mac_tx_set_txop_q = 0x40011f44 ) ;
  PROVIDE ( mac_tx_set_vhtsig = 0x400124f2 ) ;
  PROVIDE ( main = 0x4001ce54 ) ;
  PROVIDE ( malloc = 0x40026d1c ) ;
  PROVIDE ( md5_vector = 0x4002209c ) ;
  PROVIDE ( med3.isra.1 = 0x40039370 ) ;
  PROVIDE ( memccpy = 0x40038462 ) ;
  PROVIDE ( memchr = 0x40038482 ) ;
  PROVIDE ( memcmp = 0x4003849c ) ;
  PROVIDE ( memcpy = 0x400384e4 ) ;
  PROVIDE ( memmove = 0x400385a2 ) ;
  PROVIDE ( memrchr = 0x400385ec ) ;
  PROVIDE ( memset = 0x40038610 ) ;
  PROVIDE ( memspi_host_erase_block = 0x4002a216 ) ;
  PROVIDE ( memspi_host_erase_chip = 0x4002a1b8 ) ;
  PROVIDE ( memspi_host_erase_sector = 0x4002a1e2 ) ;
  PROVIDE ( memspi_host_flush_cache = 0x4002a192 ) ;
  PROVIDE ( memspi_host_program_page = 0x4002a24a ) ;
  PROVIDE ( memspi_host_read = 0x4002a288 ) ;
  PROVIDE ( memspi_host_read_data_slicer = 0x4002a338 ) ;
  PROVIDE ( memspi_host_read_id_hs = 0x4002a0ee ) ;
  PROVIDE ( memspi_host_read_status_hs = 0x4002a154 ) ;
  PROVIDE ( memspi_host_set_max_read_len = 0x4002a2f8 ) ;
  PROVIDE ( memspi_host_set_write_protect = 0x4002a2c8 ) ;
  PROVIDE ( memspi_host_write_data_slicer = 0x4002a302 ) ;
  PROVIDE ( multi_heap_aligned_alloc_impl = 0x4002d88c ) ;
  PROVIDE ( multi_heap_aligned_alloc_impl_offs = 0x4002d816 ) ;
  PROVIDE ( multi_heap_check = 0x4002d89a ) ;
  PROVIDE ( multi_heap_dump = 0x4002d8fa ) ;
  PROVIDE ( multi_heap_dump_tlsf = 0x4002d4f6 ) ;
  PROVIDE ( multi_heap_free_impl = 0x4002d730 ) ;
  PROVIDE ( multi_heap_free_size_impl = 0x4002d95a ) ;
  PROVIDE ( multi_heap_get_allocated_size_impl = 0x4002d56a ) ;
  PROVIDE ( multi_heap_get_block_address_impl = 0x4002d566 ) ;
  PROVIDE ( multi_heap_get_first_block = 0x4002d62e ) ;
  PROVIDE ( multi_heap_get_info_impl = 0x4002d96e ) ;
  PROVIDE ( multi_heap_get_info_tlsf = 0x4002d4d6 ) ;
  PROVIDE ( multi_heap_get_next_block = 0x4002d668 ) ;
  PROVIDE ( multi_heap_internal_lock = 0x4002d5f6 ) ;
  PROVIDE ( multi_heap_internal_unlock = 0x4002d612 ) ;
  PROVIDE ( multi_heap_is_free = 0x4002d6ca ) ;
  PROVIDE ( multi_heap_malloc_impl = 0x4002d6d0 ) ;
  PROVIDE ( multi_heap_minimum_free_size_impl = 0x4002d964 ) ;
  PROVIDE ( multi_heap_os_funcs_init = 0x4002d5ec ) ;
  PROVIDE ( multi_heap_realloc_impl = 0x4002d782 ) ;
  PROVIDE ( multi_heap_register_impl = 0x4002d580 ) ;
  PROVIDE ( multi_heap_set_lock = 0x4002d5e8 ) ;
  PROVIDE ( multofup = 0x4002ff80 ) ;
  PROVIDE ( mz_adler32 = 0x4002344c ) ;
  PROVIDE ( mz_bitmasks = 0x4004c900 ) ;
  PROVIDE ( mz_free = 0x40023500 ) ;
  PROVIDE ( nan = 0x40037d64 ) ;
  PROVIDE ( nn = 0x40037d9c ) ;
  PROVIDE ( normal_boot = 0x400016b2 ) ;
  PROVIDE ( normal_case = 0x40037398 ) ;
  PROVIDE ( normal_end = 0x40037d00 ) ;
  PROVIDE ( num_canc = 0x40037796 ) ;
  PROVIDE ( opi_flash_conf_cmd = 0x4002c3b4 ) ;
  PROVIDE ( our_instances = 0x4085f98c ) ;
  PROVIDE ( ovf = 0x4003755a ) ;
  PROVIDE ( ovflow = 0x40037bba ) ;
  PROVIDE ( phy_abs_temp = 0x40001e36 ) ;
  PROVIDE ( phy_adc_rate_set = 0x40007c0e ) ;
  PROVIDE ( phy_agc_max_gain_set = 0x400050fe ) ;
  PROVIDE ( phy_agc_reg_init = 0x4000519e ) ;
  PROVIDE ( phy_ant_btrx_cfg = 0x4000335c ) ;
  PROVIDE ( phy_ant_bttx_cfg = 0x40003332 ) ;
  PROVIDE ( phy_ant_dft_cfg = 0x4000327a ) ;
  PROVIDE ( phy_ant_init = 0x400056fa ) ;
  PROVIDE ( phy_ant_wifirx_cfg = 0x400032ca ) ;
  PROVIDE ( phy_ant_wifitx_cfg = 0x4000329c ) ;
  PROVIDE ( phy_band_reg = 0x40002072 ) ;
  PROVIDE ( phy_bb_bss_cbw40 = 0x40001f18 ) ;
  PROVIDE ( phy_bb_bss_cbw40_dig = 0x40004e86 ) ;
  PROVIDE ( phy_bb_cbw_chan_cfg = 0x40005bfc ) ;
  PROVIDE ( phy_bb_cfo_cfg = 0x40005ce4 ) ;
  PROVIDE ( phy_bb_gain_index = 0x400073d2 ) ;
  PROVIDE ( phy_bb_reg_init = 0x400051de ) ;
  PROVIDE ( phy_bb_wdg_cfg = 0x40005070 ) ;
  PROVIDE ( phy_bb_wdg_test_en = 0x40005638 ) ;
  PROVIDE ( phy_bb_wdt_get_status = 0x40005fb8 ) ;
  PROVIDE ( phy_bb_wdt_int_enable = 0x40005f84 ) ;
  PROVIDE ( phy_bb_wdt_rst_enable = 0x40005f68 ) ;
  PROVIDE ( phy_bb_wdt_timeout_clear = 0x40005fa4 ) ;
  PROVIDE ( phy_bbpll_cal = 0x400056de ) ;
  PROVIDE ( phy_bbtx_outfilter = 0x40005f2a ) ;
  PROVIDE ( phy_bt_chan_pwr_interp = 0x4000451a ) ;
  PROVIDE ( phy_bt_filter_reg = 0x40005796 ) ;
  PROVIDE ( phy_bt_gain_offset = 0x40004f24 ) ;
  PROVIDE ( phy_bt_get_tx_gain = 0x400048a6 ) ;
  PROVIDE ( phy_bt_get_tx_tab_ = 0x40004cba ) ;
  PROVIDE ( phy_bt_set_tx_gain = 0x40004d42 ) ;
  PROVIDE ( phy_bt_tx_gain_init = 0x40004d9a ) ;
  PROVIDE ( phy_bt_tx_pwctrl_init = 0x40008ccc ) ;
  PROVIDE ( phy_bt_txdc_cal = 0x40007e74 ) ;
  PROVIDE ( phy_bt_txiq_cal = 0x40007ca2 ) ;
  PROVIDE ( phy_byte_to_word = 0x40001ec4 ) ;
  PROVIDE ( phy_chan14_mic_cfg = 0x4000200c ) ;
  PROVIDE ( phy_chan14_mic_enable = 0x4000204e ) ;
  PROVIDE ( phy_chan_dump_cfg = 0x400033b0 ) ;
  PROVIDE ( phy_chan_dump_cfg_752 = 0x400033ea ) ;
  PROVIDE ( phy_chan_filt_set = 0x40003566 ) ;
  PROVIDE ( phy_chan_to_freq = 0x40001dca ) ;
  PROVIDE ( phy_chip_i2c_readReg = 0x4000758e ) ;
  PROVIDE ( phy_chip_i2c_readReg_org = 0x4000754a ) ;
  PROVIDE ( phy_chip_i2c_writeReg = 0x40007832 ) ;
  PROVIDE ( phy_chip_set_chan_ana_ = 0x40001df0 ) ;
  PROVIDE ( phy_ckgen_2g_cal = 0x40007bd0 ) ;
  PROVIDE ( phy_ckgen_5g_cal = 0x40007ba4 ) ;
  PROVIDE ( phy_close_pa = 0x40005856 ) ;
  PROVIDE ( phy_code_to_temp = 0x40003cc4 ) ;
  PROVIDE ( phy_csidump_force_lltf_cfg = 0x40005c8a ) ;
  PROVIDE ( phy_dac_rate_set = 0x40007c56 ) ;
  PROVIDE ( phy_dc_iq_est = 0x40006074 ) ;
  PROVIDE ( phy_dig_gain_check = 0x400044a2 ) ;
  PROVIDE ( phy_dig_reg_backup = 0x40003486 ) ;
  PROVIDE ( phy_dis_hw_set_freq = 0x40003c3e ) ;
  PROVIDE ( phy_disable_agc = 0x40004dcc ) ;
  PROVIDE ( phy_disable_cca = 0x40004e04 ) ;
  PROVIDE ( phy_disable_low_rate = 0x4000345a ) ;
  PROVIDE ( phy_en_hw_set_freq = 0x40003c2c ) ;
  PROVIDE ( phy_en_pwdet = 0x400018ea ) ;
  PROVIDE ( phy_enable_agc = 0x40004ddc ) ;
  PROVIDE ( phy_enable_cca = 0x40004e36 ) ;
  PROVIDE ( phy_enable_low_rate = 0x4000343a ) ;
  PROVIDE ( phy_encode_i2c_master = 0x40007c8a ) ;
  PROVIDE ( phy_fe_adc_on = 0x40005ae2 ) ;
  PROVIDE ( phy_fe_reg_init = 0x40004f7e ) ;
  PROVIDE ( phy_fe_txrx_reset = 0x4000509c ) ;
  PROVIDE ( phy_fft_scale_force = 0x40005b7a ) ;
  PROVIDE ( phy_filter_dcap_set = 0x400079c2 ) ;
  PROVIDE ( phy_force_pwr_index = 0x40005b40 ) ;
  PROVIDE ( phy_force_rx_gain = 0x40005bb8 ) ;
  PROVIDE ( phy_force_txrx_off = 0x4000538e ) ;
  PROVIDE ( phy_freq_band_reg_set = 0x40005cca ) ;
  PROVIDE ( phy_freq_chan_en_sw = 0x4000386a ) ;
  PROVIDE ( phy_freq_correct = 0x400058b4 ) ;
  PROVIDE ( phy_freq_i2c_mem_write = 0x40003940 ) ;
  PROVIDE ( phy_freq_i2c_num_addr = 0x400039ee ) ;
  PROVIDE ( phy_freq_i2c_write_set = 0x40003a52 ) ;
  PROVIDE ( phy_freq_module_resetn = 0x4000384e ) ;
  PROVIDE ( phy_freq_num_get_data = 0x400039ca ) ;
  PROVIDE ( phy_freq_to_chan = 0x40001d94 ) ;
  PROVIDE ( phy_freq_to_index = 0x40001df2 ) ;
  PROVIDE ( phy_freq_to_mbgain = 0x4000890e ) ;
  PROVIDE ( phy_gen_rx_gain_table = 0x40004134 ) ;
  PROVIDE ( phy_get_cal_chan = 0x40008784 ) ;
  PROVIDE ( phy_get_chan_cal_index = 0x400087d2 ) ;
  PROVIDE ( phy_get_chan_cap = 0x40008820 ) ;
  PROVIDE ( phy_get_chan_target_power = 0x4000477e ) ;
  PROVIDE ( phy_get_data_sat = 0x40001eb4 ) ;
  PROVIDE ( phy_get_dco_comp = 0x40006480 ) ;
  PROVIDE ( phy_get_fm_sar_dout = 0x40001b46 ) ;
  PROVIDE ( phy_get_freq_mem_addr = 0x400038f8 ) ;
  PROVIDE ( phy_get_freq_mem_param = 0x400038ba ) ;
  PROVIDE ( phy_get_i2c_hostid_ = 0x4000750c ) ;
  PROVIDE ( phy_get_i2c_mst0_mask = 0x400074f4 ) ;
  PROVIDE ( phy_get_i2c_read_mask_ = 0x400074ce ) ;
  PROVIDE ( phy_get_mac_addr = 0x40002112 ) ;
  PROVIDE ( phy_get_max_pwr = 0x400040ca ) ;
  PROVIDE ( phy_get_most_tpw = 0x400031fa ) ;
  PROVIDE ( phy_get_pkdet_data = 0x40001cf6 ) ;
  PROVIDE ( phy_get_power_atten = 0x4000828a ) ;
  PROVIDE ( phy_get_power_db = 0x40001b64 ) ;
  PROVIDE ( phy_get_pwdet_offset_ = 0x40008b12 ) ;
  PROVIDE ( phy_get_pwr_index = 0x40004106 ) ;
  PROVIDE ( phy_get_rate_fcc_index = 0x40004700 ) ;
  PROVIDE ( phy_get_rc_dout = 0x40003e76 ) ;
  PROVIDE ( phy_get_rfcal_rxiq_data = 0x40006382 ) ;
  PROVIDE ( phy_get_romfuncs = 0x400031a8 ) ;
  PROVIDE ( phy_get_rx_freq = 0x40001ee2 ) ;
  PROVIDE ( phy_get_rx_pbus_freq = 0x40002eda ) ;
  PROVIDE ( phy_get_rxbb_dc = 0x4000427a ) ;
  PROVIDE ( phy_get_sar2_vol = 0x40001c54 ) ;
  PROVIDE ( phy_get_sar_sig_ref = 0x4000190e ) ;
  PROVIDE ( phy_get_target_pwr = 0x4000404e ) ;
  PROVIDE ( phy_get_tone_sar_dout = 0x40001ad8 ) ;
  PROVIDE ( phy_get_tsens_value_ = 0x40003e42 ) ;
  PROVIDE ( phy_get_tx_gain_value = 0x40004810 ) ;
  PROVIDE ( phy_hemu_ru26_good_res = 0x40005ca6 ) ;
  PROVIDE ( phy_i2c_clk_sel = 0x4000745e ) ;
  PROVIDE ( phy_i2c_enter_critical_ = 0x4000745a ) ;
  PROVIDE ( phy_i2c_exit_critical_ = 0x4000745c ) ;
  PROVIDE ( phy_i2c_master_fill = 0x40007c94 ) ;
  PROVIDE ( phy_i2c_master_reset = 0x40001f98 ) ;
  PROVIDE ( phy_i2c_paral_read = 0x40007656 ) ;
  PROVIDE ( phy_i2c_paral_set_mst0 = 0x400075de ) ;
  PROVIDE ( phy_i2c_paral_set_read = 0x4000761a ) ;
  PROVIDE ( phy_i2c_paral_write = 0x400076ac ) ;
  PROVIDE ( phy_i2c_paral_write_mask = 0x40007778 ) ;
  PROVIDE ( phy_i2c_paral_write_num = 0x400076fc ) ;
  PROVIDE ( phy_i2c_pkdet_set = 0x40007984 ) ;
  PROVIDE ( phy_i2c_rc_cal_set = 0x40007b5a ) ;
  PROVIDE ( phy_i2c_readReg = 0x4000782e ) ;
  PROVIDE ( phy_i2c_readReg_Mask = 0x400078ac ) ;
  PROVIDE ( phy_i2c_sar2_init_code = 0x40007952 ) ;
  PROVIDE ( phy_i2c_writeReg = 0x400078a8 ) ;
  PROVIDE ( phy_i2c_writeReg_Mask = 0x400078d8 ) ;
  PROVIDE ( phy_i2cmst_reg_init = 0x40004f02 ) ;
  PROVIDE ( phy_index_to_txbbgain = 0x4000448a ) ;
  PROVIDE ( phy_iq_corr_enable = 0x400056ae ) ;
  PROVIDE ( phy_iq_est_disable = 0x40006048 ) ;
  PROVIDE ( phy_iq_est_enable = 0x40005fc2 ) ;
  PROVIDE ( phy_is_low_rate_enabled = 0x4000347a ) ;
  PROVIDE ( phy_linear_to_db = 0x400019d2 ) ;
  PROVIDE ( phy_loop_clk_en = 0x40001e9c ) ;
  PROVIDE ( phy_mac_enable_bb = 0x40005042 ) ;
  PROVIDE ( phy_meas_tone_pwr_db = 0x40001b9c ) ;
  PROVIDE ( phy_noise_floor_auto_set = 0x4000565e ) ;
  PROVIDE ( phy_nrx_freq_set = 0x40005a90 ) ;
  PROVIDE ( phy_open_fe_bb_clk = 0x400020ea ) ;
  PROVIDE ( phy_open_i2c_xpd = 0x40005316 ) ;
  PROVIDE ( phy_param_addr = 0x400031b2 ) ;
  PROVIDE ( phy_pbus_clear_reg = 0x40002494 ) ;
  PROVIDE ( phy_pbus_debugmode = 0x4000248c ) ;
  PROVIDE ( phy_pbus_force_mode = 0x4000227c ) ;
  PROVIDE ( phy_pbus_force_test = 0x4000241c ) ;
  PROVIDE ( phy_pbus_rd = 0x4000245e ) ;
  PROVIDE ( phy_pbus_rd_addr_ = 0x4000230c ) ;
  PROVIDE ( phy_pbus_reg_store = 0x40002e9c ) ;
  PROVIDE ( phy_pbus_rx_dco_cal = 0x400064e2 ) ;
  PROVIDE ( phy_pbus_set_dco = 0x40002642 ) ;
  PROVIDE ( phy_pbus_set_rftx1_5g = 0x4000318c ) ;
  PROVIDE ( phy_pbus_set_rxgain = 0x40002508 ) ;
  PROVIDE ( phy_pbus_workmode = 0x40002490 ) ;
  PROVIDE ( phy_pbus_xpd_iq_path = 0x40003124 ) ;
  PROVIDE ( phy_pbus_xpd_rx_off = 0x40002568 ) ;
  PROVIDE ( phy_pbus_xpd_rx_on = 0x40002678 ) ;
  PROVIDE ( phy_pbus_xpd_tx_off = 0x400025f0 ) ;
  PROVIDE ( phy_pbus_xpd_tx_on = 0x4000279c ) ;
  PROVIDE ( phy_pkdadc_set = 0x40005a54 ) ;
  PROVIDE ( phy_pkdet_vol_start = 0x40001a62 ) ;
  PROVIDE ( phy_pll_cap_mem_update = 0x40003b84 ) ;
  PROVIDE ( phy_pwdet_code_cal = 0x400085a2 ) ;
  PROVIDE ( phy_pwdet_ref_code = 0x40008522 ) ;
  PROVIDE ( phy_pwdet_reg_init = 0x40001830 ) ;
  PROVIDE ( phy_pwdet_sar2_init = 0x4000189e ) ;
  PROVIDE ( phy_pwdet_tone_start = 0x4000195c ) ;
  PROVIDE ( phy_pwdet_wait_idle = 0x40001a4e ) ;
  PROVIDE ( phy_rate_to_index = 0x40004008 ) ;
  PROVIDE ( phy_rc_cal = 0x40003f0c ) ;
  PROVIDE ( phy_read_hw_noisefloor = 0x40005694 ) ;
  PROVIDE ( phy_read_rf_freq_mem = 0x40003906 ) ;
  PROVIDE ( phy_read_sar2_code = 0x40001c40 ) ;
  PROVIDE ( phy_read_sar_dout = 0x40001aaa ) ;
  PROVIDE ( phy_rf_cal_data_backup = 0x40002200 ) ;
  PROVIDE ( phy_rf_cal_data_recovery = 0x400021fc ) ;
  PROVIDE ( phy_rfagc_disable = 0x40005a26 ) ;
  PROVIDE ( phy_rfcal_data_check = 0x40002210 ) ;
  PROVIDE ( phy_rfcal_data_sub = 0x4000219e ) ;
  PROVIDE ( phy_rfcal_pwrctrl = 0x40008950 ) ;
  PROVIDE ( phy_rfcal_rxiq = 0x40006314 ) ;
  PROVIDE ( phy_rfcal_txcap = 0x400085c2 ) ;
  PROVIDE ( phy_rfcal_txiq = 0x400083a0 ) ;
  PROVIDE ( phy_rfrx_gain_index = 0x400073f6 ) ;
  PROVIDE ( phy_rx11blr_cfg = 0x400035ba ) ;
  PROVIDE ( phy_rx_dco_cal_1step = 0x400067a6 ) ;
  PROVIDE ( phy_rx_gain_force = 0x400054b0 ) ;
  PROVIDE ( phy_rx_pkdet_dc_cal = 0x40001d12 ) ;
  PROVIDE ( phy_rx_sense_set = 0x400057ca ) ;
  PROVIDE ( phy_rxdc_est_min = 0x40006730 ) ;
  PROVIDE ( phy_rxiq_cover_mg_mp = 0x4000626e ) ;
  PROVIDE ( phy_rxiq_get_mis = 0x40006136 ) ;
  PROVIDE ( phy_rxiq_opt = 0x40006af2 ) ;
  PROVIDE ( phy_rxiq_set_reg = 0x4000545c ) ;
  PROVIDE ( phy_set_bb_wdg = 0x40005e3a ) ;
  PROVIDE ( phy_set_cal_rxdc = 0x400060ea ) ;
  PROVIDE ( phy_set_cca = 0x400035f2 ) ;
  PROVIDE ( phy_set_chan_interp = 0x40001e40 ) ;
  PROVIDE ( phy_set_chan_reg = 0x40001f50 ) ;
  PROVIDE ( phy_set_lb_txiq = 0x40006ad0 ) ;
  PROVIDE ( phy_set_loopback_gain = 0x40002904 ) ;
  PROVIDE ( phy_set_mac_data = 0x40002156 ) ;
  PROVIDE ( phy_set_most_tpw = 0x400031e4 ) ;
  PROVIDE ( phy_set_pbus_mem = 0x400030d6 ) ;
  PROVIDE ( phy_set_pbus_mem_2g = 0x40002ca2 ) ;
  PROVIDE ( phy_set_pbus_mem_5g = 0x40002f38 ) ;
  PROVIDE ( phy_set_pbus_reg = 0x400059d4 ) ;
  PROVIDE ( phy_set_rx_comp_ = 0x400050c0 ) ;
  PROVIDE ( phy_set_rx_gain_cal_dc = 0x40006e3c ) ;
  PROVIDE ( phy_set_rx_gain_cal_iq = 0x40006b66 ) ;
  PROVIDE ( phy_set_rx_pbus_freq = 0x400030ea ) ;
  PROVIDE ( phy_set_rx_sense = 0x40003624 ) ;
  PROVIDE ( phy_set_rxclk_en = 0x40005548 ) ;
  PROVIDE ( phy_set_tsens_power_ = 0x40003c6a ) ;
  PROVIDE ( phy_set_tx_gain_mem = 0x4000456a ) ;
  PROVIDE ( phy_set_txcap_reg = 0x40007930 ) ;
  PROVIDE ( phy_set_txclk_en = 0x40005524 ) ;
  PROVIDE ( phy_sifs_reg_init = 0x40005ee6 ) ;
  PROVIDE ( phy_spur_cal = 0x40007294 ) ;
  PROVIDE ( phy_spur_coef_cfg = 0x400072e4 ) ;
  PROVIDE ( phy_spur_reg_write = 0x40007030 ) ;
  PROVIDE ( phy_start_tx_tone_step = 0x40005568 ) ;
  PROVIDE ( phy_stop_tx_tone = 0x4000560c ) ;
  PROVIDE ( phy_temp_to_power_ = 0x40003e44 ) ;
  PROVIDE ( phy_tsens_attribute = 0x4004a1d4 ) ;
  PROVIDE ( phy_tsens_code_read = 0x40003dac ) ;
  PROVIDE ( phy_tsens_dac_cal = 0x40003d3e ) ;
  PROVIDE ( phy_tsens_dac_to_index = 0x40003d0e ) ;
  PROVIDE ( phy_tsens_read_init = 0x40003c86 ) ;
  PROVIDE ( phy_tsens_temp_read = 0x40003db8 ) ;
  PROVIDE ( phy_tsens_temp_read_local = 0x40003dea ) ;
  PROVIDE ( phy_tx_paon_set = 0x40004e9c ) ;
  PROVIDE ( phy_tx_pwctrl_init = 0x40008c7e ) ;
  PROVIDE ( phy_tx_pwctrl_init_cal = 0x40008b50 ) ;
  PROVIDE ( phy_tx_state_out = 0x40003274 ) ;
  PROVIDE ( phy_tx_state_set = 0x4000580a ) ;
  PROVIDE ( phy_txbbgain_to_index = 0x40004470 ) ;
  PROVIDE ( phy_txcal_debuge_mode_ = 0x40002a4e ) ;
  PROVIDE ( phy_txcal_work_mode = 0x40002af8 ) ;
  PROVIDE ( phy_txcap_setting = 0x4000872e ) ;
  PROVIDE ( phy_txdc_cal = 0x40007ca4 ) ;
  PROVIDE ( phy_txdc_cal_pwdet = 0x40007f18 ) ;
  PROVIDE ( phy_txiq_cover = 0x40008132 ) ;
  PROVIDE ( phy_txiq_get_mis_pwr = 0x4000808a ) ;
  PROVIDE ( phy_txiq_set_reg = 0x400053f4 ) ;
  PROVIDE ( phy_txtone_linear_pwr = 0x40001bea ) ;
  PROVIDE ( phy_vht_support = 0x40005c70 ) ;
  PROVIDE ( phy_wait_freq_set_busy = 0x40003c5c ) ;
  PROVIDE ( phy_wifi_11g_rate_chg = 0x400044fa ) ;
  PROVIDE ( phy_wifi_agc_sat_gain = 0x400056d2 ) ;
  PROVIDE ( phy_wifi_enable_set = 0x40005be4 ) ;
  PROVIDE ( phy_wifi_fbw_sel = 0x4000573e ) ;
  PROVIDE ( phy_wifi_get_target_power = 0x40004b02 ) ;
  PROVIDE ( phy_wifi_get_tx_gain = 0x400049f4 ) ;
  PROVIDE ( phy_wifi_get_tx_tab_ = 0x40004b24 ) ;
  PROVIDE ( phy_wifi_rifs_mode_en = 0x40005a12 ) ;
  PROVIDE ( phy_wifi_set_tx_gain = 0x40004c52 ) ;
  PROVIDE ( phy_wr_freq_mem = 0x4000397c ) ;
  PROVIDE ( phy_wr_rx_gain_mem = 0x400042ac ) ;
  PROVIDE ( phy_write_chan_freq = 0x400038a4 ) ;
  PROVIDE ( phy_write_gain_mem = 0x40004e5c ) ;
  PROVIDE ( phy_write_pbus_mem = 0x40002b28 ) ;
  PROVIDE ( pm_allow_tx = 0x4000c248 ) ;
  PROVIDE ( pm_beacon_monitor_tbtt_start = 0x40009e5e ) ;
  PROVIDE ( pm_beacon_monitor_tbtt_timeout_process = 0x4000bac6 ) ;
  PROVIDE ( pm_beacon_offset_add_loss_counter = 0x4000aa04 ) ;
  PROVIDE ( pm_beacon_offset_add_total_counter = 0x4000a9f4 ) ;
  PROVIDE ( pm_beacon_offset_check = 0x4000aa14 ) ;
  PROVIDE ( pm_beacon_offset_get_average = 0x4000a516 ) ;
  PROVIDE ( pm_beacon_offset_get_expect = 0x4000a646 ) ;
  PROVIDE ( pm_beacon_offset_get_params = 0x4000a7f4 ) ;
  PROVIDE ( pm_beacon_offset_get_rx_beacon_success_rate = 0x4000a9be ) ;
  PROVIDE ( pm_beacon_offset_is_enabled = 0x4000a9ac ) ;
  PROVIDE ( pm_beacon_offset_is_sampling = 0x4000a99a ) ;
  PROVIDE ( pm_check_state = 0x40009cc2 ) ;
  PROVIDE ( pm_clear_wakeup_signal = 0x40009dfa ) ;
  PROVIDE ( pm_coex_pwr_update = 0x4000b7fe ) ;
  PROVIDE ( pm_coex_schm_overall_period_get = 0x4000b7c6 ) ;
  PROVIDE ( pm_disable_dream_timer = 0x40009650 ) ;
  PROVIDE ( pm_disable_sleep_delay_timer = 0x40009a02 ) ;
  PROVIDE ( pm_disconnected_wake = 0x4000bcd6 ) ;
  PROVIDE ( pm_dream = 0x4000988c ) ;
  PROVIDE ( pm_enable_active_timer = 0x4000954c ) ;
  PROVIDE ( pm_enable_max_idle_timer = 0x4000c008 ) ;
  PROVIDE ( pm_enable_sleep_delay_timer = 0x4000b368 ) ;
  PROVIDE ( pm_enable_twt_keep_alive = 0x4000c428 ) ;
  PROVIDE ( pm_enable_twt_keep_alive_timer = 0x4000c3b2 ) ;
  PROVIDE ( pm_extend_tbtt_adaptive_servo = 0x4000c34c ) ;
  PROVIDE ( pm_get_null_max_tx_time = 0x400110ce ) ;
  PROVIDE ( pm_get_tbtt_count = 0x4000ab38 ) ;
  PROVIDE ( pm_handle_tbtt_interval = 0x4000b8b2 ) ;
  PROVIDE ( pm_is_in_wifi_slice_threshold = 0x4000a2f4 ) ;
  PROVIDE ( pm_is_twt_awake = 0x4000c4be ) ;
  PROVIDE ( pm_is_twt_start = 0x4000c4e2 ) ;
  PROVIDE ( pm_is_waked = 0x400094b8 ) ;
  PROVIDE ( pm_keep_alive = 0x4000aeaa ) ;
  PROVIDE ( pm_local_tsf_process = 0x4000a1d0 ) ;
  PROVIDE ( pm_mac_disable_tsf_tbtt_modem_wakeup = 0x4000b424 ) ;
  PROVIDE ( pm_mac_disable_tsf_tbtt_soc_wakeup = 0x4000b3fe ) ;
  PROVIDE ( pm_mac_enable_tsf_tbtt_modem_wakeup = 0x4000b4fe ) ;
  PROVIDE ( pm_mac_enable_tsf_tbtt_soc_wakeup = 0x4000b45e ) ;
  PROVIDE ( pm_mac_modem_params_rt_update = 0x4000b5d6 ) ;
  PROVIDE ( pm_mac_sleep = 0x4000987e ) ;
  PROVIDE ( pm_mac_try_enable_modem_state = 0x4000b6aa ) ;
  PROVIDE ( pm_mac_wakeup = 0x40009870 ) ;
  PROVIDE ( pm_on_beacon_rx = 0x4000baf0 ) ;
  PROVIDE ( pm_on_data_rx = 0x4000bc94 ) ;
  PROVIDE ( pm_on_data_tx = 0x4000bffa ) ;
  PROVIDE ( pm_on_isr = 0x4000ca48 ) ;
  PROVIDE ( pm_on_isr_set_twt_target = 0x4000c6ce ) ;
  PROVIDE ( pm_on_isr_sleep = 0x4000caca ) ;
  PROVIDE ( pm_on_isr_twt_wake = 0x4000c9b8 ) ;
  PROVIDE ( pm_on_tbtt = 0x4000b3c2 ) ;
  PROVIDE ( pm_on_tsf_timer = 0x4000cb1e ) ;
  PROVIDE ( pm_on_twt_force_tx = 0x4000d982 ) ;
  PROVIDE ( pm_parse_beacon = 0x4000ac04 ) ;
  PROVIDE ( pm_parse_mbssid_element = 0x4000a350 ) ;
  PROVIDE ( pm_process_tim = 0x4000af76 ) ;
  PROVIDE ( pm_rx_beacon_process = 0x4000b194 ) ;
  PROVIDE ( pm_rx_data_process = 0x4000b2ac ) ;
  PROVIDE ( pm_save_tbtt_info = 0x40009e30 ) ;
  PROVIDE ( pm_scale_listen_interval = 0x4000aa84 ) ;
  PROVIDE ( pm_set_beacon_filter = 0x4000a23e ) ;
  PROVIDE ( pm_sleep = 0x40009a20 ) ;
  PROVIDE ( pm_sleep_for = 0x400094ca ) ;
  PROVIDE ( pm_tbtt_adaptive_update_target = 0x400094ac ) ;
  PROVIDE ( pm_tbtt_process = 0x40009f7a ) ;
  PROVIDE ( pm_twt_disallow_tx = 0x4000dcb4 ) ;
  PROVIDE ( pm_twt_on_tsf_timer = 0x4000cb88 ) ;
  PROVIDE ( pm_twt_process = 0x40009d26 ) ;
  PROVIDE ( pm_twt_set_target_tsf = 0x4000c762 ) ;
  PROVIDE ( pm_twt_set_target_wdev_time = 0x4000c4f6 ) ;
  PROVIDE ( pm_tx_data_done_process = 0x4000c0b6 ) ;
  PROVIDE ( pm_tx_data_process = 0x4000bd22 ) ;
  PROVIDE ( pm_update_at_next_beacon = 0x4000b788 ) ;
  PROVIDE ( pm_update_next_tbtt = 0x4000b926 ) ;
  PROVIDE ( pmu_enable_unhold_pads = 0x4001df22 ) ;
  PROVIDE ( pn_np = 0x40037d66 ) ;
  PROVIDE ( pos_or_zero = 0x40037746 ) ;
  PROVIDE ( ppAMPDU2Normal = 0x4000db26 ) ;
  PROVIDE ( ppAdd2AMPDUTail = 0x4000e2d8 ) ;
  PROVIDE ( ppAssembleAMPDU = 0x4000e36a ) ;
  PROVIDE ( ppCalDeliNum = 0x4000e14c ) ;
  PROVIDE ( ppCalFrameTimes = 0x4000d116 ) ;
  PROVIDE ( ppCalPreFecPaddingFactor = 0x4000e47a ) ;
  PROVIDE ( ppCalSubFrameLength = 0x4000d118 ) ;
  PROVIDE ( ppCalTxAMPDULength = 0x4000e53c ) ;
  PROVIDE ( ppCalTxHEAMPDULength = 0x40010cec ) ;
  PROVIDE ( ppCalTxHESMPDULength = 0x40010c1e ) ;
  PROVIDE ( ppCalTxVHTSMPDULength = 0x4000e4d4 ) ;
  PROVIDE ( ppCalTxopDur = 0x4000ce9c ) ;
  PROVIDE ( ppCalVHTDeliNum = 0x4000e47e ) ;
  PROVIDE ( ppCertSetRate = 0x40010854 ) ;
  PROVIDE ( ppCheckTxAMPDUlength = 0x4000e22a ) ;
  PROVIDE ( ppCheckTxHEAMPDUlength = 0x40010a1e ) ;
  PROVIDE ( ppCheckTxRTS = 0x40010988 ) ;
  PROVIDE ( ppDequeueRxq_Locked = 0x4000fe3a ) ;
  PROVIDE ( ppDequeueTxDone_Locked = 0x4000ffe4 ) ;
  PROVIDE ( ppDequeueTxQ = 0x40012dfa ) ;
  PROVIDE ( ppDirectRecycleAmpdu = 0x40010616 ) ;
  PROVIDE ( ppDisableQueue = 0x4001036e ) ;
  PROVIDE ( ppEmptyDelimiterLength = 0x4000d3a4 ) ;
  PROVIDE ( ppEnqueueRxq = 0x4000fe1e ) ;
  PROVIDE ( ppEnqueueTxDone = 0x400113e0 ) ;
  PROVIDE ( ppFillAMPDUBar = 0x4000e918 ) ;
  PROVIDE ( ppGetTxframe = 0x4000d54a ) ;
  PROVIDE ( ppHEAMPDU2Normal = 0x40010758 ) ;
  PROVIDE ( ppMapTxQueue = 0x4000d9b2 ) ;
  PROVIDE ( ppMapWaitTxq = 0x4001041e ) ;
  PROVIDE ( ppProcTxCallback = 0x40010008 ) ;
  PROVIDE ( ppProcTxDone = 0x40010176 ) ;
  PROVIDE ( ppProcTxSecFrame = 0x4000d158 ) ;
  PROVIDE ( ppProcessLifeTime = 0x40011176 ) ;
  PROVIDE ( ppProcessRxPktHdr = 0x4000f7ac ) ;
  PROVIDE ( ppProcessTxQ = 0x4000dcfe ) ;
  PROVIDE ( ppProcessWaitingQueue = 0x4001039e ) ;
  PROVIDE ( ppReSendBar = 0x4000ea38 ) ;
  PROVIDE ( ppRecordBarRRC = 0x40012be0 ) ;
  PROVIDE ( ppRecycleAmpdu = 0x40012bf8 ) ;
  PROVIDE ( ppRecycleRxPkt = 0x4000fe0a ) ;
  PROVIDE ( ppRegressAmpdu = 0x4001068c ) ;
  PROVIDE ( ppRemoveHEAMPDUflags = 0x4001055c ) ;
  PROVIDE ( ppRemoveHTC = 0x400105ba ) ;
  PROVIDE ( ppResortTxAMPDU = 0x4000eade ) ;
  PROVIDE ( ppResumeTxAMPDU = 0x4000def6 ) ;
  PROVIDE ( ppRxFragmentProc = 0x4000f986 ) ;
  PROVIDE ( ppRxPkt = 0x4000fe5e ) ;
  PROVIDE ( ppRxProtoProc = 0x4000f814 ) ;
  PROVIDE ( ppSearchTxQueue = 0x4000d7e6 ) ;
  PROVIDE ( ppSearchTxframe = 0x4000d5e6 ) ;
  PROVIDE ( ppSelectNextQueue = 0x4000d738 ) ;
  PROVIDE ( ppSelectTxFormat = 0x4001090a ) ;
  PROVIDE ( ppSubFromAMPDU = 0x4000dee0 ) ;
  PROVIDE ( ppTask = 0x4000f070 ) ;
  PROVIDE ( ppTxPkt = 0x4000d3c2 ) ;
  PROVIDE ( ppTxProtoProc = 0x4000d30c ) ;
  PROVIDE ( ppTxqUpdateBitmap = 0x40012e9a ) ;
  PROVIDE ( pp_coex_tx_release = 0x4001007c ) ;
  PROVIDE ( pp_coex_tx_request = 0x4000db34 ) ;
  PROVIDE ( pp_hdrsize = 0x4000f7ee ) ;
  PROVIDE ( pp_nn_h_eq = 0x40037d4e ) ;
  PROVIDE ( pp_post = 0x4000cc8e ) ;
  PROVIDE ( pp_process_hmac_waiting_txq = 0x4000f048 ) ;
  PROVIDE ( pp_timer_do_process = 0x400100f2 ) ;
  PROVIDE ( pre_ovf = 0x40037556 ) ;
  PROVIDE ( print_hash = 0x4001f258 ) ;
  PROVIDE ( printf = 0x400392ec ) ;
  PROVIDE ( produce_nan = 0x4003790c ) ;
  PROVIDE ( pthread_setcancelstate = 0x40026aee ) ;
  PROVIDE ( pwr_hal_clear_mac_modem_state_wakeup_protect_signal = 0x40009466 ) ;
  PROVIDE ( pwr_hal_get_intr_raw_signal = 0x4000928c ) ;
  PROVIDE ( pwr_hal_get_mac_modem_beacon_miss_limit_exceeded_status = 0x40009318 ) ;
  PROVIDE ( pwr_hal_get_mac_modem_state_sleep_limit_exceeded_status = 0x40008f3c ) ;
  PROVIDE ( pwr_hal_set_beacon_filter_abort_enable = 0x40009400 ) ;
  PROVIDE ( pwr_hal_set_beacon_filter_abort_length = 0x40009412 ) ;
  PROVIDE ( pwr_hal_set_beacon_filter_broadcast_wakeup_disable = 0x400093de ) ;
  PROVIDE ( pwr_hal_set_beacon_filter_broadcast_wakeup_enable = 0x400093cc ) ;
  PROVIDE ( pwr_hal_set_beacon_filter_enable = 0x400093ba ) ;
  PROVIDE ( pwr_hal_set_beacon_filter_force_dump_enable = 0x4000937c ) ;
  PROVIDE ( pwr_hal_set_beacon_filter_force_dump_limit = 0x40009356 ) ;
  PROVIDE ( pwr_hal_set_beacon_filter_force_sync_enable = 0x400093a8 ) ;
  PROVIDE ( pwr_hal_set_beacon_filter_force_sync_limit = 0x40009390 ) ;
  PROVIDE ( pwr_hal_set_beacon_filter_frame_crc_state = 0x40009430 ) ;
  PROVIDE ( pwr_hal_set_beacon_filter_unicast_wakeup_enable = 0x400093ee ) ;
  PROVIDE ( pwr_hal_set_mac_modem_beacon_miss_intr_disable = 0x400092e0 ) ;
  PROVIDE ( pwr_hal_set_mac_modem_beacon_miss_intr_enable = 0x400092c2 ) ;
  PROVIDE ( pwr_hal_set_mac_modem_beacon_miss_limit = 0x400092ae ) ;
  PROVIDE ( pwr_hal_set_mac_modem_beacon_miss_limit_exceeded_wakeup_disable = 0x40009308 ) ;
  PROVIDE ( pwr_hal_set_mac_modem_beacon_miss_limit_exceeded_wakeup_enable = 0x400092f6 ) ;
  PROVIDE ( pwr_hal_set_mac_modem_beacon_miss_timeout = 0x40009296 ) ;
  PROVIDE ( pwr_hal_set_mac_modem_state_sleep_limit = 0x40009326 ) ;
  PROVIDE ( pwr_hal_set_mac_modem_state_sleep_limit_exceeded_wakeup_disable = 0x40008f28 ) ;
  PROVIDE ( pwr_hal_set_mac_modem_state_sleep_limit_exceeded_wakeup_enable = 0x40009344 ) ;
  PROVIDE ( pwr_hal_set_mac_modem_state_wakeup_protect_disable = 0x4000944c ) ;
  PROVIDE ( pwr_hal_set_mac_modem_state_wakeup_protect_early_time = 0x4000944e ) ;
  PROVIDE ( pwr_hal_set_mac_modem_state_wakeup_protect_enable = 0x4000944a ) ;
  PROVIDE ( pwr_hal_set_mac_modem_tbtt_auto_period_enable = 0x40009478 ) ;
  PROVIDE ( pwr_hal_set_mac_modem_tbtt_auto_period_interval = 0x4000948c ) ;
  PROVIDE ( qsort = 0x400393c8 ) ;
  PROVIDE ( rand = 0x400396e6 ) ;
  PROVIDE ( rand_r = 0x40039790 ) ;
  PROVIDE ( rcAmpduLowerRate = 0x400153b8 ) ;
  PROVIDE ( rcClearCurAMPDUSched = 0x40015344 ) ;
  PROVIDE ( rcClearCurSched = 0x40014a94 ) ;
  PROVIDE ( rcClearCurStat = 0x40014a86 ) ;
  PROVIDE ( rcGetAmpduSched = 0x4000e2e6 ) ;
  PROVIDE ( rcGetDCMMaxRate = 0x40015b40 ) ;
  PROVIDE ( rcGetRate = 0x40015a88 ) ;
  PROVIDE ( rcGetSMPDURate = 0x40015b92 ) ;
  PROVIDE ( rcGetSched = 0x400148f6 ) ;
  PROVIDE ( rcLowerSched = 0x40014acc ) ;
  PROVIDE ( rcReachRetryLimit = 0x400151cc ) ;
  PROVIDE ( rcSetTxAmpduLimit = 0x40015372 ) ;
  PROVIDE ( rcTxUpdatePer = 0x40014b46 ) ;
  PROVIDE ( rcUpSched = 0x40014886 ) ;
  PROVIDE ( rcUpdateAckSnr = 0x40014a44 ) ;
  PROVIDE ( rcUpdateRate = 0x40014e62 ) ;
  PROVIDE ( rcUpdateRxDone = 0x40014c86 ) ;
  PROVIDE ( rcUpdateTxDone = 0x40014bc6 ) ;
  PROVIDE ( rcUpdateTxDoneAmpdu2 = 0x400156ba ) ;
  PROVIDE ( rc_get_trc = 0x40015994 ) ;
  PROVIDE ( rc_get_trc_by_index = 0x40015a02 ) ;
  PROVIDE ( rcampduuprate = 0x40015596 ) ;
  PROVIDE ( read_hw_noisefloor = 0x4003a9f0 ) ;
  PROVIDE ( read_id_core = 0x4002a424 ) ;
  PROVIDE ( realloc = 0x40026d5c ) ;
  PROVIDE ( recv_packet = 0x400263c2 ) ;
  PROVIDE ( reset_reasons = 0x4004b090 ) ;
  PROVIDE ( ret_0 = 0x40037d98 ) ;
  PROVIDE ( ret_1 = 0x40037942 ) ;
  PROVIDE ( ret_m1 = 0x40037bfc ) ;
  PROVIDE ( return_a0 = 0x40037082 ) ;
  PROVIDE ( return_greater = 0x400370e8 ) ;
  PROVIDE ( riscv_pma_deep_sleep_wakeup_x_enable = 0x4003ad62 ) ;
  PROVIDE ( riscv_pma_direct_boot_cfg = 0x4003ad26 ) ;
  PROVIDE ( riscv_pma_flash_boot_cfg = 0x4003ac88 ) ;
  PROVIDE ( riscv_pma_init_cfg = 0x4003ab56 ) ;
  PROVIDE ( riscv_pma_ram_boot_cfg = 0x4003ad3c ) ;
  PROVIDE ( rodata_offset = 0x4085fb78 ) ;
  PROVIDE ( rodata_page_cnt = 0x4085fb7c ) ;
  PROVIDE ( rodata_reserved_end = 0x4085fb80 ) ;
  PROVIDE ( rodata_reserved_start = 0x4085fb84 ) ;
  PROVIDE ( rodata_start_page = 0x4085fb88 ) ;
  PROVIDE ( rom_default_cache_internal_table = 0x4004de5c ) ;
  PROVIDE ( rom_default_heap_tlsf_table = 0x4004e004 ) ;
  PROVIDE ( rom_default_spi_usr_cmd_legacy_funcs = 0x4004de38 ) ;
  PROVIDE ( rom_get_mmu_region.part.1 = 0x4002b8c4 ) ;
  PROVIDE ( rom_intr_op_cb = 0x4085e5a4 ) ;
  PROVIDE ( round = 0x40036ea2 ) ;
  PROVIDE ( rounding = 0x40037776 ) ;
  PROVIDE ( roundup2 = 0x4002ff74 ) ;
  PROVIDE ( rssi_margin = 0x40014cf4 ) ;
  PROVIDE ( rtc_get_reset_reason = 0x4001de2a ) ;
  PROVIDE ( rtc_get_wakeup_cause = 0x4001de36 ) ;
  PROVIDE ( rtc_is_deep_sleep_reset = 0x4001de40 ) ;
  PROVIDE ( rx11AXRate2AMPDULimit = 0x40015c3a ) ;
  PROVIDE ( rx11NRate2AMPDULimit = 0x40015396 ) ;
  PROVIDE ( s_dist_base.2933 = 0x4004c944 ) ;
  PROVIDE ( s_dist_extra.2934 = 0x4004c9c4 ) ;
  PROVIDE ( s_flash_op_cache_state = 0x4085fb3c ) ;
  PROVIDE ( s_intr_handlers = 0x4085f3f8 ) ;
  PROVIDE ( s_length_base.2931 = 0x4004ca44 ) ;
  PROVIDE ( s_length_dezigzag.2935 = 0x4004cac0 ) ;
  PROVIDE ( s_length_extra.2932 = 0x4004cad4 ) ;
  PROVIDE ( s_min_table_sizes.2936 = 0x4004cb50 ) ;
  PROVIDE ( s_mmap_entries_head = 0x4085fb48 ) ;
  PROVIDE ( s_mmap_last_handle = 0x4085fb4c ) ;
  PROVIDE ( s_mmap_page_num = 0x4085fb50 ) ;
  PROVIDE ( s_mmap_page_refcnt = 0x4085fb54 ) ;
  PROVIDE ( s_multi_heap_os_funcs = 0x4085fb58 ) ;
  PROVIDE ( s_poison_check_region = 0x4085fb5c ) ;
  PROVIDE ( s_poison_fill_region = 0x4085fb60 ) ;
  PROVIDE ( s_tdefl_large_dist_extra = 0x4004cb5c ) ;
  PROVIDE ( s_tdefl_large_dist_sym = 0x4004cbdc ) ;
  PROVIDE ( s_tdefl_len_extra = 0x4004cc5c ) ;
  PROVIDE ( s_tdefl_len_sym = 0x4004cd5c ) ;
  PROVIDE ( s_tdefl_packed_code_size_syms_swizzle = 0x4004cac0 ) ;
  PROVIDE ( s_tdefl_small_dist_extra = 0x4004cf5c ) ;
  PROVIDE ( s_tdefl_small_dist_sym = 0x4004d15c ) ;
  PROVIDE ( sbrk = 0x4003a340 ) ;
  PROVIDE ( sdesc.2005 = 0x4004ab18 ) ;
  PROVIDE ( sdio_slave_mode_init = 0x40030ae0 ) ;
  PROVIDE ( sdio_slave_pads_init = 0x40030a2c ) ;
  PROVIDE ( send_packet = 0x400262ba ) ;
  PROVIDE ( setjmp = 0x400397e4 ) ;
  PROVIDE ( sha_block_bytes = 0x4004d940 ) ;
  PROVIDE ( sha_padding = 0x4004d948 ) ;
  PROVIDE ( sha_result_bytes = 0x4004d9c8 ) ;
  PROVIDE ( sha_state_bytes = 0x4004d9d0 ) ;
  PROVIDE ( sign_and_exit = 0x40037094 ) ;
  PROVIDE ( sign_exit = 0x40036eae ) ;
  PROVIDE ( sip_after_tx_complete = 0x40030834 ) ;
  PROVIDE ( sip_alloc_to_host_evt = 0x4002ff8a ) ;
  PROVIDE ( sip_boot_rx_ctrl = 0x40030460 ) ;
  PROVIDE ( sip_download_begin = 0x4003024e ) ;
  PROVIDE ( sip_from_host_avail_cb = 0x4002fc88 ) ;
  PROVIDE ( sip_from_host_process = 0x400305e6 ) ;
  PROVIDE ( sip_get_ptr = 0x4003082a ) ;
  PROVIDE ( sip_get_send_length = 0x4002fc20 ) ;
  PROVIDE ( sip_get_state = 0x4003025c ) ;
  PROVIDE ( sip_init_attach = 0x40030266 ) ;
  PROVIDE ( sip_install_rx_ctrl_cb = 0x40030236 ) ;
  PROVIDE ( sip_install_rx_data_cb = 0x40030242 ) ;
  PROVIDE ( sip_is_active = 0x400308a6 ) ;
  PROVIDE ( sip_post_init = 0x4003031a ) ;
  PROVIDE ( sip_reclaim_from_host_cmd = 0x40030200 ) ;
  PROVIDE ( sip_reclaim_tx_data_pkt = 0x400301ae ) ;
  PROVIDE ( sip_send = 0x400303a0 ) ;
  PROVIDE ( sip_start_send = 0x4002fdf2 ) ;
  PROVIDE ( sip_task = 0x4002ff52 ) ;
  PROVIDE ( sip_task_q = 0x4085f28c ) ;
  PROVIDE ( sip_to_host_chain_append = 0x4003033e ) ;
  PROVIDE ( sip_to_host_done_cb = 0x4002fd3a ) ;
  PROVIDE ( sip_to_host_done_process = 0x40030090 ) ;
  PROVIDE ( sip_to_host_evt_send_done = 0x4003001c ) ;
  PROVIDE ( siprintf = 0x40039978 ) ;
  PROVIDE ( slcCtrl = 0x4085f2ac ) ;
  PROVIDE ( slc_add_credits = 0x40030e90 ) ;
  PROVIDE ( slc_enable = 0x40030b34 ) ;
  PROVIDE ( slc_from_host_chain_fetch = 0x40030c9c ) ;
  PROVIDE ( slc_from_host_chain_recycle = 0x40030ea2 ) ;
  PROVIDE ( slc_has_pkt_to_host = 0x400309ea ) ;
  PROVIDE ( slc_init_attach = 0x40030d4e ) ;
  PROVIDE ( slc_init_credit = 0x40030e80 ) ;
  PROVIDE ( slc_isr = 0x40030912 ) ;
  PROVIDE ( slc_reattach = 0x40030a1c ) ;
  PROVIDE ( slc_send_to_host_chain = 0x40030b82 ) ;
  PROVIDE ( slc_set_host_io_max_window = 0x40030d34 ) ;
  PROVIDE ( slc_to_host_chain_recycle = 0x40030c16 ) ;
  PROVIDE ( sniprintf = 0x400398c2 ) ;
  PROVIDE ( snprintf = 0x400398c2 ) ;
  PROVIDE ( software_reset = 0x4001df02 ) ;
  PROVIDE ( software_reset_cpu = 0x4001df12 ) ;
  PROVIDE ( spi_cache_mode_switch = 0x4002940a ) ;
  PROVIDE ( spi_common_set_dummy_output = 0x4002955c ) ;
  PROVIDE ( spi_common_set_flash_cs_timing = 0x40029516 ) ;
  PROVIDE ( spi_dummy_len_fix = 0x400289de ) ;
  PROVIDE ( spi_flash_attach = 0x400298b4 ) ;
  PROVIDE ( spi_flash_boot_attach = 0x40029888 ) ;
  PROVIDE ( spi_flash_cache2phys = 0x4002be7c ) ;
  PROVIDE ( spi_flash_cache_enabled = 0x40029ea8 ) ;
  PROVIDE ( spi_flash_check_and_flush_cache = 0x4002c07e ) ;
  PROVIDE ( spi_flash_chip_gd_get_io_mode = 0x4002af02 ) ;
  PROVIDE ( spi_flash_chip_gd_probe = 0x4002ae8e ) ;
  PROVIDE ( spi_flash_chip_gd_set_io_mode = 0x4002aeb0 ) ;
  PROVIDE ( spi_flash_chip_generic_config_host_io_mode = 0x4002b4ee ) ;
  PROVIDE ( spi_flash_chip_generic_default_config_data = 0x4004dc38 ) ;
  PROVIDE ( spi_flash_chip_generic_detect_size = 0x4002b03a ) ;
  PROVIDE ( spi_flash_chip_generic_erase_block = 0x4002b11c ) ;
  PROVIDE ( spi_flash_chip_generic_erase_chip = 0x4002b060 ) ;
  PROVIDE ( spi_flash_chip_generic_erase_sector = 0x4002b0bc ) ;
  PROVIDE ( spi_flash_chip_generic_get_caps = 0x4002b7c8 ) ;
  PROVIDE ( spi_flash_chip_generic_get_io_mode = 0x4002b64c ) ;
  PROVIDE ( spi_flash_chip_generic_get_write_protect = 0x4002b374 ) ;
  PROVIDE ( spi_flash_chip_generic_page_program = 0x4002b17c ) ;
  PROVIDE ( spi_flash_chip_generic_probe = 0x4002afe0 ) ;
  PROVIDE ( spi_flash_chip_generic_read = 0x4002b5a0 ) ;
  PROVIDE ( spi_flash_chip_generic_read_reg = 0x4002b41e ) ;
  PROVIDE ( spi_flash_chip_generic_read_unique_id = 0x4002b750 ) ;
  PROVIDE ( spi_flash_chip_generic_reset = 0x4002afe4 ) ;
  PROVIDE ( spi_flash_chip_generic_set_io_mode = 0x4002b730 ) ;
  PROVIDE ( spi_flash_chip_generic_set_write_protect = 0x4002b32c ) ;
  PROVIDE ( spi_flash_chip_generic_suspend_cmd_conf = 0x4002b7da ) ;
  PROVIDE ( spi_flash_chip_generic_wait_idle = 0x4002b466 ) ;
  PROVIDE ( spi_flash_chip_generic_write = 0x4002b1d8 ) ;
  PROVIDE ( spi_flash_chip_generic_write_encrypted = 0x4002b266 ) ;
  PROVIDE ( spi_flash_chip_generic_yield = 0x4002b430 ) ;
  PROVIDE ( spi_flash_common_read_qe_sr.isra.1.constprop.3 = 0x4002af6a ) ;
  PROVIDE ( spi_flash_common_read_status_16b_rdsr_rdsr2 = 0x4002afa4 ) ;
  PROVIDE ( spi_flash_common_read_status_8b_rdsr = 0x4002b66a ) ;
  PROVIDE ( spi_flash_common_read_status_8b_rdsr2 = 0x4002b638 ) ;
  PROVIDE ( spi_flash_common_set_io_mode = 0x4002b6a6 ) ;
  PROVIDE ( spi_flash_common_write_qe_sr.isra.2 = 0x4002af20 ) ;
  PROVIDE ( spi_flash_common_write_status_16b_wrsr = 0x4002af56 ) ;
  PROVIDE ( spi_flash_common_write_status_8b_wrsr = 0x4002b67c ) ;
  PROVIDE ( spi_flash_common_write_status_8b_wrsr2 = 0x4002b690 ) ;
  PROVIDE ( spi_flash_disable_cache = 0x40029e7c ) ;
  PROVIDE ( spi_flash_enable_cache = 0x40029ec0 ) ;
  PROVIDE ( spi_flash_encryption_default = 0x4004dc78 ) ;
  PROVIDE ( spi_flash_encryption_hal_check = 0x400204a0 ) ;
  PROVIDE ( spi_flash_encryption_hal_destroy = 0x40020494 ) ;
  PROVIDE ( spi_flash_encryption_hal_disable = 0x4002043a ) ;
  PROVIDE ( spi_flash_encryption_hal_done = 0x40020472 ) ;
  PROVIDE ( spi_flash_encryption_hal_enable = 0x40020424 ) ;
  PROVIDE ( spi_flash_encryption_hal_prepare = 0x40020446 ) ;
  PROVIDE ( spi_flash_generic_wait_host_idle = 0x4002b3be ) ;
  PROVIDE ( spi_flash_get_chip_size = 0x4002c0cc ) ;
  PROVIDE ( spi_flash_guard_get = 0x4002c0e2 ) ;
  PROVIDE ( spi_flash_guard_set = 0x4002c0d8 ) ;
  PROVIDE ( spi_flash_hal_check_status = 0x400209bc ) ;
  PROVIDE ( spi_flash_hal_common_command = 0x40020710 ) ;
  PROVIDE ( spi_flash_hal_configure_host_io_mode = 0x4002057a ) ;
  PROVIDE ( spi_flash_hal_device_config = 0x40020bcc ) ;
  PROVIDE ( spi_flash_hal_disable_auto_resume_mode = 0x40020b92 ) ;
  PROVIDE ( spi_flash_hal_disable_auto_suspend_mode = 0x40020b24 ) ;
  PROVIDE ( spi_flash_hal_erase_block = 0x400208cc ) ;
  PROVIDE ( spi_flash_hal_erase_chip = 0x4002085e ) ;
  PROVIDE ( spi_flash_hal_erase_sector = 0x40020882 ) ;
  PROVIDE ( spi_flash_hal_host_idle = 0x40020996 ) ;
  PROVIDE ( spi_flash_hal_poll_cmd_done = 0x40020554 ) ;
  PROVIDE ( spi_flash_hal_program_page = 0x40020912 ) ;
  PROVIDE ( spi_flash_hal_read = 0x400207f0 ) ;
  PROVIDE ( spi_flash_hal_resume = 0x40020c26 ) ;
  PROVIDE ( spi_flash_hal_set_write_protect = 0x40020972 ) ;
  PROVIDE ( spi_flash_hal_setup_auto_resume_mode = 0x40020aea ) ;
  PROVIDE ( spi_flash_hal_setup_auto_suspend_mode = 0x40020a7a ) ;
  PROVIDE ( spi_flash_hal_setup_read_suspend = 0x400209d2 ) ;
  PROVIDE ( spi_flash_hal_suspend = 0x40020c36 ) ;
  PROVIDE ( spi_flash_mmap = 0x4002bbfa ) ;
  PROVIDE ( spi_flash_mmap_dump = 0x4002bd76 ) ;
  PROVIDE ( spi_flash_mmap_get_free_pages = 0x4002be0e ) ;
  PROVIDE ( spi_flash_mmap_init = 0x4002b820 ) ;
  PROVIDE ( spi_flash_mmap_os_func_set = 0x4002b906 ) ;
  PROVIDE ( spi_flash_mmap_page_num_init = 0x4002b918 ) ;
  PROVIDE ( spi_flash_mmap_pages = 0x4002b94e ) ;
  PROVIDE ( spi_flash_munmap = 0x4002bcaa ) ;
  PROVIDE ( spi_flash_phys2cache = 0x4002bf82 ) ;
  PROVIDE ( spi_flash_read_encrypted = 0x4002c0ec ) ;
  PROVIDE ( spi_flash_restore_cache = 0x40029e9a ) ;
  PROVIDE ( spi_modes = 0x4004b940 ) ;
  PROVIDE ( spi_set_dummy_output = 0x400289f6 ) ;
  PROVIDE ( spi_update_xts_key = 0x4002957c ) ;
  PROVIDE ( spiflash_end_default = 0x4002a394 ) ;
  PROVIDE ( spiflash_start_default = 0x4002a370 ) ;
  PROVIDE ( spimem_flash_ll_get_buffer_data = 0x400204f6 ) ;
  PROVIDE ( spimem_flash_ll_set_buffer_data = 0x400204aa ) ;
  PROVIDE ( sprintf = 0x40039978 ) ;
  PROVIDE ( srand = 0x40039670 ) ;
  PROVIDE ( sta_get_beacon_timeout = 0x4001b8de ) ;
  PROVIDE ( sta_input = 0x4001a566 ) ;
  PROVIDE ( sta_reset_beacon_timeout = 0x4001b86e ) ;
  PROVIDE ( sta_rx_eapol = 0x4001a3f4 ) ;
  PROVIDE ( strcasecmp = 0x400399c2 ) ;
  PROVIDE ( strcasestr = 0x40039a06 ) ;
  PROVIDE ( strcat = 0x40039a9a ) ;
  PROVIDE ( strchr = 0x40039aba ) ;
  PROVIDE ( strcmp = 0x40039ad4 ) ;
  PROVIDE ( strcoll = 0x40039bf2 ) ;
  PROVIDE ( strcpy = 0x40039bf6 ) ;
  PROVIDE ( strcspn = 0x40039c58 ) ;
  PROVIDE ( strdup = 0x40039c7a ) ;
  PROVIDE ( strlcat = 0x40039cc2 ) ;
  PROVIDE ( strlcpy = 0x40039d16 ) ;
  PROVIDE ( strlen = 0x40039d54 ) ;
  PROVIDE ( strlwr = 0x40039dbc ) ;
  PROVIDE ( strncasecmp = 0x40039dea ) ;
  PROVIDE ( strncat = 0x40039e44 ) ;
  PROVIDE ( strncmp = 0x40039e72 ) ;
  PROVIDE ( strncpy = 0x40039e9e ) ;
  PROVIDE ( strndup = 0x40039ec2 ) ;
  PROVIDE ( strnlen = 0x40039f2a ) ;
  PROVIDE ( strrchr = 0x40039f42 ) ;
  PROVIDE ( strsep = 0x40039f74 ) ;
  PROVIDE ( strspn = 0x40039f7c ) ;
  PROVIDE ( strstr = 0x40039f9e ) ;
  PROVIDE ( strtok_r = 0x4003a030 ) ;
  PROVIDE ( strtol = 0x4003a196 ) ;
  PROVIDE ( strtol_l = 0x4003a176 ) ;
  PROVIDE ( strtoul = 0x4003a2f4 ) ;
  PROVIDE ( strtoul_l = 0x4003a2d4 ) ;
  PROVIDE ( strupr = 0x4003a314 ) ;
  PROVIDE ( sum = 0x400376d6 ) ;
  PROVIDE ( swapfunc = 0x4003932c ) ;
  PROVIDE ( systimer_hal_connect_alarm_counter = 0x40020f7a ) ;
  PROVIDE ( systimer_hal_counter_can_stall_by_cpu = 0x40020fc8 ) ;
  PROVIDE ( systimer_hal_counter_value_advance = 0x40020e7c ) ;
  PROVIDE ( systimer_hal_deinit = 0x40020c60 ) ;
  PROVIDE ( systimer_hal_enable_alarm_int = 0x40020e6a ) ;
  PROVIDE ( systimer_hal_enable_counter = 0x40020ef0 ) ;
  PROVIDE ( systimer_hal_get_alarm_value = 0x40020e3a ) ;
  PROVIDE ( systimer_hal_get_counter_value = 0x40020c80 ) ;
  PROVIDE ( systimer_hal_get_time = 0x40020cf8 ) ;
  PROVIDE ( systimer_hal_init = 0x40020c46 ) ;
  PROVIDE ( systimer_hal_on_apb_freq_update = 0x40020e7a ) ;
  PROVIDE ( systimer_hal_select_alarm_mode = 0x40020f06 ) ;
  PROVIDE ( systimer_hal_set_alarm_period = 0x40020d9c ) ;
  PROVIDE ( systimer_hal_set_alarm_target = 0x40020d08 ) ;
  PROVIDE ( systimer_hal_set_tick_rate_ops = 0x40020c76 ) ;
  PROVIDE ( tbtt_adaptive_servo = 0x4000c334 ) ;
  PROVIDE ( tbtt_adaptive_setup = 0x4000c2a4 ) ;
  PROVIDE ( tdefl_compress = 0x40024670 ) ;
  PROVIDE ( tdefl_compress_buffer = 0x40024e44 ) ;
  PROVIDE ( tdefl_compress_lz_codes = 0x400220de ) ;
  PROVIDE ( tdefl_compress_mem_to_heap = 0x40024f68 ) ;
  PROVIDE ( tdefl_compress_mem_to_mem = 0x40024f76 ) ;
  PROVIDE ( tdefl_compress_mem_to_output = 0x40024f64 ) ;
  PROVIDE ( tdefl_flush_block = 0x40022f84 ) ;
  PROVIDE ( tdefl_flush_output_buffer = 0x40022390 ) ;
  PROVIDE ( tdefl_get_adler32 = 0x40024f60 ) ;
  PROVIDE ( tdefl_get_prev_return_status = 0x40024f5c ) ;
  PROVIDE ( tdefl_init = 0x40024e5e ) ;
  PROVIDE ( tdefl_optimize_huffman_table = 0x400223f8 ) ;
  PROVIDE ( tdefl_start_dynamic_block = 0x400229f2 ) ;
  PROVIDE ( tdefl_start_static_block = 0x40022914 ) ;
  PROVIDE ( tdefl_write_image_to_png_file_in_memory = 0x40024f82 ) ;
  PROVIDE ( tdefl_write_image_to_png_file_in_memory_ex = 0x40024f7a ) ;
  PROVIDE ( tee_hal_config_master_mode = 0x400213f0 ) ;
  PROVIDE ( test_get_nonmumimo_common = 0x400177c0 ) ;
  PROVIDE ( test_mimo_update_user_info = 0x400172be ) ;
  PROVIDE ( test_mumimo_get_heltf_num = 0x4001728a ) ;
  PROVIDE ( test_nonmimo_update_user_info = 0x40017466 ) ;
  PROVIDE ( test_parse_rx_mu_mimo = 0x40017364 ) ;
  PROVIDE ( test_rx_parse_mumimo_complete_sigb = 0x400176a4 ) ;
  PROVIDE ( test_rx_parse_nonmumimo = 0x40017b80 ) ;
  PROVIDE ( test_rx_parse_nonmumimo_complete_sigb = 0x40017862 ) ;
  PROVIDE ( test_rx_process_complete_noeb = 0x40017d0e ) ;
  PROVIDE ( test_rx_process_complete_retry = 0x40017dca ) ;
  PROVIDE ( test_tx_fail_statistics = 0x400186ba ) ;
  PROVIDE ( test_tx_succ_statistics = 0x400187c8 ) ;
  PROVIDE ( tinfl_decompress = 0x40023502 ) ;
  PROVIDE ( tinfl_decompress_mem_to_callback = 0x4002466c ) ;
  PROVIDE ( tinfl_decompress_mem_to_heap = 0x40024596 ) ;
  PROVIDE ( tinfl_decompress_mem_to_mem = 0x40024610 ) ;
  PROVIDE ( tlsf_add_pool = 0x4002dcd8 ) ;
  PROVIDE ( tlsf_align_size = 0x4002dcb6 ) ;
  PROVIDE ( tlsf_alloc_overhead = 0x4002dcd4 ) ;
  PROVIDE ( tlsf_block_size = 0x4002dc3e ) ;
  PROVIDE ( tlsf_block_size_max = 0x4002dcbe ) ;
  PROVIDE ( tlsf_block_size_min = 0x4002dcba ) ;
  PROVIDE ( tlsf_check = 0x4002da92 ) ;
  PROVIDE ( tlsf_check_hook = 0x4002da18 ) ;
  PROVIDE ( tlsf_check_pool = 0x4002dc4c ) ;
  PROVIDE ( tlsf_create = 0x4002dfb0 ) ;
  PROVIDE ( tlsf_create_with_pool = 0x4002e130 ) ;
  PROVIDE ( tlsf_fit_size = 0x4002dc6c ) ;
  PROVIDE ( tlsf_free = 0x4002eb30 ) ;
  PROVIDE ( tlsf_get_pool = 0x4002e15a ) ;
  PROVIDE ( tlsf_malloc = 0x4002e164 ) ;
  PROVIDE ( tlsf_memalign = 0x4002eb22 ) ;
  PROVIDE ( tlsf_memalign_offs = 0x4002e530 ) ;
  PROVIDE ( tlsf_poison_check_pfunc_set = 0x4002d9f8 ) ;
  PROVIDE ( tlsf_poison_fill_pfunc_set = 0x4002d9ee ) ;
  PROVIDE ( tlsf_pool_overhead = 0x4002dcd0 ) ;
  PROVIDE ( tlsf_realloc = 0x4002efa0 ) ;
  PROVIDE ( tlsf_remove_pool = 0x4002de42 ) ;
  PROVIDE ( tlsf_size = 0x4002dcac ) ;
  PROVIDE ( tlsf_walk_pool = 0x4002dbde ) ;
  PROVIDE ( toascii = 0x4003a354 ) ;
  PROVIDE ( tolower = 0x4003a35a ) ;
  PROVIDE ( toupper = 0x4003a376 ) ;
  PROVIDE ( trcAmpduSetState = 0x40015210 ) ;
  PROVIDE ( trc_SetTxAmpduState = 0x40015230 ) ;
  PROVIDE ( trc_calc_duration = 0x400154b4 ) ;
  PROVIDE ( trc_isTxAmpduOperational = 0x4001478a ) ;
  PROVIDE ( trc_onAmpduOp = 0x40015236 ) ;
  PROVIDE ( trc_onPPTxDone = 0x400155fa ) ;
  PROVIDE ( trc_set_bf_report_rate = 0x4001481a ) ;
  PROVIDE ( trc_tid_isTxAmpduOperational = 0x40014796 ) ;
  PROVIDE ( tsf_hal_get_counter_value = 0x40008eb8 ) ;
  PROVIDE ( tsf_hal_get_tbtt_interval = 0x40008e6c ) ;
  PROVIDE ( tsf_hal_get_time = 0x40008f00 ) ;
  PROVIDE ( tsf_hal_set_rx_beacon_abort_tsf_time_deviation_sync_enable = 0x4000927a ) ;
  PROVIDE ( tsf_hal_set_tbtt_intr_disable = 0x40008f76 ) ;
  PROVIDE ( tsf_hal_set_tbtt_intr_enable = 0x40008f4a ) ;
  PROVIDE ( tsf_hal_set_tbtt_modem_wakeup_disable = 0x400090e0 ) ;
  PROVIDE ( tsf_hal_set_tbtt_modem_wakeup_enable = 0x40009078 ) ;
  PROVIDE ( tsf_hal_set_tbtt_rf_ctrl_disable = 0x400091d0 ) ;
  PROVIDE ( tsf_hal_set_tbtt_rf_ctrl_enable = 0x4000914a ) ;
  PROVIDE ( tsf_hal_set_tbtt_rf_ctrl_wait_cycles = 0x400091b2 ) ;
  PROVIDE ( tsf_hal_set_tbtt_soc_wakeup_disable = 0x4000900e ) ;
  PROVIDE ( tsf_hal_set_tbtt_soc_wakeup_enable = 0x40008fa6 ) ;
  PROVIDE ( tsf_hal_set_tsf_time_deviation = 0x4000924e ) ;
  PROVIDE ( tsf_hal_set_tsf_time_deviation_sync_enable = 0x40009266 ) ;
  PROVIDE ( uartAttach = 0x400260c8 ) ;
  PROVIDE ( uart_baudrate_detect = 0x40026102 ) ;
  PROVIDE ( uart_buff_switch = 0x4002637a ) ;
  PROVIDE ( uart_div_modify = 0x40026118 ) ;
  PROVIDE ( uart_hal_clk_enable = 0x4003af68 ) ;
  PROVIDE ( uart_hal_clk_set_div = 0x4003afc0 ) ;
  PROVIDE ( uart_hal_clk_source_sel = 0x4003affa ) ;
  PROVIDE ( uart_hal_clr_intsts_mask = 0x4003add8 ) ;
  PROVIDE ( uart_hal_disable_autobaud = 0x4003ae34 ) ;
  PROVIDE ( uart_hal_disable_intr_mask = 0x4003adf4 ) ;
  PROVIDE ( uart_hal_enable_autobaud = 0x4003ae16 ) ;
  PROVIDE ( uart_hal_enable_glitch_filter = 0x4003ae66 ) ;
  PROVIDE ( uart_hal_enable_intr_mask = 0x4003ade4 ) ;
  PROVIDE ( uart_hal_get_autobaud_sts = 0x4003ae54 ) ;
  PROVIDE ( uart_hal_get_fsm_status = 0x4003b0d0 ) ;
  PROVIDE ( uart_hal_get_high_pulse_cnt = 0x4003aeb0 ) ;
  PROVIDE ( uart_hal_get_intsts_mask = 0x4003ae08 ) ;
  PROVIDE ( uart_hal_get_low_pulse_cnt = 0x4003ae9e ) ;
  PROVIDE ( uart_hal_get_rxd_edge_cnt = 0x4003ae8c ) ;
  PROVIDE ( uart_hal_get_rxfifo_count = 0x4003af58 ) ;
  PROVIDE ( uart_hal_get_txfifo_count = 0x4003af46 ) ;
  PROVIDE ( uart_hal_init_reset = 0x4003b0e0 ) ;
  PROVIDE ( uart_hal_read_fifo = 0x4003b0c0 ) ;
  PROVIDE ( uart_hal_rxfifo_rst = 0x4003aef6 ) ;
  PROVIDE ( uart_hal_set_data_bits_num = 0x4003b07c ) ;
  PROVIDE ( uart_hal_set_glitch_filter = 0x4003ae78 ) ;
  PROVIDE ( uart_hal_set_parity = 0x4003b03a ) ;
  PROVIDE ( uart_hal_set_rx_stop_err = 0x4003af28 ) ;
  PROVIDE ( uart_hal_set_rxfifo_trigger = 0x4003b09c ) ;
  PROVIDE ( uart_hal_set_stop_bits_num = 0x4003b058 ) ;
  PROVIDE ( uart_hal_txfifo_rst = 0x4003aec4 ) ;
  PROVIDE ( uart_hal_write_fifo = 0x4003b0b4 ) ;
  PROVIDE ( uart_ll_update = 0x4003adb8 ) ;
  PROVIDE ( uart_rx_buff.7474 = 0x4085e5b0 ) ;
  PROVIDE ( uart_rx_intr_handler = 0x40026266 ) ;
  PROVIDE ( uart_rx_one_char = 0x40026242 ) ;
  PROVIDE ( uart_rx_one_char_block = 0x40026222 ) ;
  PROVIDE ( uart_rx_readbuff = 0x4002632e ) ;
  PROVIDE ( uart_serial_baudrate_detect = 0x40025f72 ) ;
  PROVIDE ( uart_serial_config = 0x40025e6c ) ;
  PROVIDE ( uart_serial_div_modify = 0x40025ff0 ) ;
  PROVIDE ( uart_serial_init = 0x40025df6 ) ;
  PROVIDE ( uart_serial_intr_config = 0x40025eda ) ;
  PROVIDE ( uart_serial_param_attach = 0x40025f0e ) ;
  PROVIDE ( uart_serial_rx_intr_disable = 0x40026098 ) ;
  PROVIDE ( uart_serial_rx_intr_enable = 0x400260b0 ) ;
  PROVIDE ( uart_serial_rx_isr_handler = 0x40025d94 ) ;
  PROVIDE ( uart_serial_rx_one_char = 0x40026076 ) ;
  PROVIDE ( uart_serial_rx_one_char_block = 0x4002605e ) ;
  PROVIDE ( uart_serial_tx_flush = 0x40026032 ) ;
  PROVIDE ( uart_serial_tx_idle = 0x40026044 ) ;
  PROVIDE ( uart_serial_tx_one_char = 0x4002600a ) ;
  PROVIDE ( uart_tx_flush = 0x400261dc ) ;
  PROVIDE ( uart_tx_one_char = 0x4002612c ) ;
  PROVIDE ( uart_tx_one_char2 = 0x40026172 ) ;
  PROVIDE ( uart_tx_one_char3 = 0x400261b4 ) ;
  PROVIDE ( uart_tx_send_queued_data = 0x400261fa ) ;
  PROVIDE ( uart_tx_switch = 0x400260f6 ) ;
  PROVIDE ( uart_tx_wait_idle = 0x4002620e ) ;
  PROVIDE ( und_ov_flow = 0x4003745e ) ;
  PROVIDE ( undflow = 0x40037bc6 ) ;
  PROVIDE ( unpackloop = 0x40001704 ) ;
  PROVIDE ( usb_serial_device_print_is_enabled = 0x40025d84 ) ;
  PROVIDE ( usb_serial_device_rx_one_char = 0x40025d6c ) ;
  PROVIDE ( usb_serial_device_rx_one_char_block = 0x40025d5a ) ;
  PROVIDE ( usb_serial_device_tx_flush = 0x40025d50 ) ;
  PROVIDE ( usb_serial_device_tx_one_char = 0x40025cea ) ;
  PROVIDE ( user_code_start = 0x4085edb0 ) ;
  PROVIDE ( utoa = 0x4003a424 ) ;
  PROVIDE ( vfiprintf = 0x40038ee8 ) ;
  PROVIDE ( vfprintf = 0x40038ee8 ) ;
  PROVIDE ( vht_get_min_subframe_len = 0x4000df0e ) ;
  PROVIDE ( viprintf = 0x4003a426 ) ;
  PROVIDE ( vprintf = 0x4003a426 ) ;
  PROVIDE ( vsniprintf = 0x4003a4e6 ) ;
  PROVIDE ( vsnprintf = 0x4003a4e6 ) ;
  PROVIDE ( wDevCheckBlockError = 0x400161c0 ) ;
  PROVIDE ( wDev_AppendRxBlocks = 0x4001609e ) ;
  PROVIDE ( wDev_DiscardFrame = 0x40016262 ) ;
  PROVIDE ( wDev_GetNoiseFloor = 0x4001604a ) ;
  PROVIDE ( wDev_IndicateAmpdu = 0x4001699a ) ;
  PROVIDE ( wDev_IndicateBeaconMemoryFrame = 0x40017000 ) ;
  PROVIDE ( wDev_IndicateFrame = 0x40016672 ) ;
  PROVIDE ( wDev_ProcessBeaconMemoryRxSuc = 0x40017184 ) ;
  PROVIDE ( wDev_ProcessFiq = 0x40015e56 ) ;
  PROVIDE ( wDev_ProcessRxSucData = 0x40016a28 ) ;
  PROVIDE ( wdevProcessModemStateRxBeacon = 0x4001725a ) ;
  PROVIDE ( wdevProcessRxSucDataAll = 0x40016ef0 ) ;
  PROVIDE ( wdev_csi_len_align = 0x4001653c ) ;
  PROVIDE ( wdev_is_data_in_rxlist = 0x4001648c ) ;
  PROVIDE ( wdev_mac_reg_load = 0x40016288 ) ;
  PROVIDE ( wdev_mac_reg_store = 0x4001635c ) ;
  PROVIDE ( wdev_mac_sleep = 0x400164c6 ) ;
  PROVIDE ( wdev_mac_special_reg_load = 0x4001642e ) ;
  PROVIDE ( wdev_mac_special_reg_store = 0x40016444 ) ;
  PROVIDE ( wdev_mac_wakeup = 0x40016464 ) ;
  PROVIDE ( wdev_process_beacon_filter = 0x40015e0e ) ;
  PROVIDE ( wdev_process_mac_modem_beacon_miss = 0x40015e44 ) ;
  PROVIDE ( wdev_process_tbtt = 0x40015dea ) ;
  PROVIDE ( wdev_process_tsf_timer = 0x40015dfc ) ;
  PROVIDE ( wdt_hal_config_stage = 0x400211e0 ) ;
  PROVIDE ( wdt_hal_deinit = 0x4002117e ) ;
  PROVIDE ( wdt_hal_disable = 0x40021330 ) ;
  PROVIDE ( wdt_hal_enable = 0x40021308 ) ;
  PROVIDE ( wdt_hal_feed = 0x40021374 ) ;
  PROVIDE ( wdt_hal_handle_intr = 0x4002134e ) ;
  PROVIDE ( wdt_hal_init = 0x40020ff2 ) ;
  PROVIDE ( wdt_hal_is_enabled = 0x400213be ) ;
  PROVIDE ( wdt_hal_set_flashboot_en = 0x4002138c ) ;
  PROVIDE ( wdt_hal_write_protect_disable = 0x400212e0 ) ;
  PROVIDE ( wdt_hal_write_protect_enable = 0x400212f6 ) ;
  PROVIDE ( wifi_get_macaddr = 0x40019886 ) ;
  PROVIDE ( wifi_he_get_hetb_tid_bawin = 0x400169da ) ;
  PROVIDE ( wifi_he_get_hetb_tid_bitmap = 0x400169b0 ) ;
  PROVIDE ( wifi_is_started = 0x40018f2a ) ;
  PROVIDE ( wifi_rf_phy_disable = 0x4001b296 ) ;
  PROVIDE ( wifi_rf_phy_enable = 0x4001b202 ) ;
  PROVIDE ( xor_end = 0x40037d48 ) ;
  PROVIDE ( zero = 0x40037516 ) ;
  PROVIDE ( zero_den = 0x4003716c ) ;
  PROVIDE ( zero_denormal = 0x400374f8 ) ;
  PROVIDE ( zero_operand = 0x4003788e ) ;
  PROVIDE ( zero_operand_return = 0x40037898 ) ;
}
