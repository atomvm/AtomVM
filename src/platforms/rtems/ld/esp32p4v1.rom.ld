/*
 * SPDX-FileCopyrightText: 2023-2026 Espressif Systems (Shanghai) CO LTD
 *
 * SPDX-License-Identifier: Apache-2.0
 */
/* ESP32-P4 revision 1.x public ROM ABI, from ESP-IDF release/v6.1
 * (9a97f6c54ec638111ce55cd36581b3c192f15207), esp32p4.rom.eco0_4.ld
 * and esp32p4.rom.api.ld. The BSP rejects ECO0 and revision 3.x.
 */
SECTIONS {
  PROVIDE ( rtc_get_reset_reason = 0x4fc00018 ) ;
  PROVIDE ( rtc_get_wakeup_cause = 0x4fc0001c ) ;
  PROVIDE ( pmu_enable_unhold_pads = 0x4fc00020 ) ;
  PROVIDE ( ets_printf = 0x4fc00024 ) ;
  PROVIDE ( ets_install_putc1 = 0x4fc00028 ) ;
  PROVIDE ( ets_install_putc2 = 0x4fc0002c ) ;
  PROVIDE ( ets_install_uart_printf = 0x4fc00030 ) ;
  PROVIDE ( ets_install_usb_printf = 0x4fc00034 ) ;
  PROVIDE ( ets_get_printf_channel = 0x4fc00038 ) ;
  PROVIDE ( ets_delay_us = 0x4fc0003c ) ;
  PROVIDE ( ets_get_cpu_frequency = 0x4fc00040 ) ;
  PROVIDE ( ets_update_cpu_frequency = 0x4fc00044 ) ;
  PROVIDE ( ets_install_lock = 0x4fc00048 ) ;
  PROVIDE ( UartRxString = 0x4fc0004c ) ;
  PROVIDE ( UartGetCmdLn = 0x4fc00050 ) ;
  PROVIDE ( uart_tx_one_char = 0x4fc00054 ) ;
  PROVIDE ( uart_tx_one_char2 = 0x4fc00058 ) ;
  PROVIDE ( uart_tx_one_char3 = 0x4fc0005c ) ;
  PROVIDE ( uart_rx_one_char = 0x4fc00060 ) ;
  PROVIDE ( uart_rx_one_char_block = 0x4fc00064 ) ;
  PROVIDE ( uart_rx_intr_handler = 0x4fc00068 ) ;
  PROVIDE ( uart_rx_readbuff = 0x4fc0006c ) ;
  PROVIDE ( uartAttach = 0x4fc00070 ) ;
  PROVIDE ( uart_tx_flush = 0x4fc00074 ) ;
  PROVIDE ( uart_tx_wait_idle = 0x4fc00078 ) ;
  PROVIDE ( uart_div_modify = 0x4fc0007c ) ;
  PROVIDE ( ets_write_char_uart = 0x4fc00080 ) ;
  PROVIDE ( uart_tx_switch = 0x4fc00084 ) ;
  PROVIDE ( uart_buff_switch = 0x4fc00088 ) ;
  PROVIDE ( roundup2 = 0x4fc0008c ) ;
  PROVIDE ( multofup = 0x4fc00090 ) ;
  PROVIDE ( software_reset = 0x4fc00094 ) ;
  PROVIDE ( software_reset_cpu = 0x4fc00098 ) ;
  PROVIDE ( ets_clk_assist_debug_clock_enable = 0x4fc0009c ) ;
  PROVIDE ( clear_super_wdt_reset_flag = 0x4fc000a0 ) ;
  PROVIDE ( disable_default_watchdog = 0x4fc000a4 ) ;
  PROVIDE ( ets_set_appcpu_boot_addr = 0x4fc000a8 ) ;
  PROVIDE ( send_packet = 0x4fc000ac ) ;
  PROVIDE ( recv_packet = 0x4fc000b0 ) ;
  PROVIDE ( GetUartDevice = 0x4fc000b4 ) ;
  PROVIDE ( UartDwnLdProc = 0x4fc000b8 ) ;
  PROVIDE ( GetSecurityInfoProc = 0x4fc000bc ) ;
  PROVIDE ( Uart_Init = 0x4fc000c0 ) ;
  PROVIDE ( ets_set_user_start = 0x4fc000c4 ) ;
  PROVIDE ( ets_rom_layout_p = 0x4fc1fffc ) ;
  PROVIDE ( ets_ops_table_ptr = 0x4ff3fff4 ) ;
  PROVIDE ( g_saved_pc = 0x4ff3fff8 ) ;
  PROVIDE ( mz_adler32 = 0x4fc000c8 ) ;
  PROVIDE ( mz_free = 0x4fc000cc ) ;
  PROVIDE ( tdefl_compress = 0x4fc000d0 ) ;
  PROVIDE ( tdefl_compress_buffer = 0x4fc000d4 ) ;
  PROVIDE ( tdefl_compress_mem_to_heap = 0x4fc000d8 ) ;
  PROVIDE ( tdefl_compress_mem_to_mem = 0x4fc000dc ) ;
  PROVIDE ( tdefl_compress_mem_to_output = 0x4fc000e0 ) ;
  PROVIDE ( tdefl_get_adler32 = 0x4fc000e4 ) ;
  PROVIDE ( tdefl_get_prev_return_status = 0x4fc000e8 ) ;
  PROVIDE ( tdefl_init = 0x4fc000ec ) ;
  PROVIDE ( tdefl_write_image_to_png_file_in_memory = 0x4fc000f0 ) ;
  PROVIDE ( tdefl_write_image_to_png_file_in_memory_ex = 0x4fc000f4 ) ;
  PROVIDE ( tinfl_decompress = 0x4fc000f8 ) ;
  PROVIDE ( tinfl_decompress_mem_to_callback = 0x4fc000fc ) ;
  PROVIDE ( tinfl_decompress_mem_to_heap = 0x4fc00100 ) ;
  PROVIDE ( tinfl_decompress_mem_to_mem = 0x4fc00104 ) ;
  PROVIDE ( esp_rom_spi_cmd_config = 0x4fc00108 ) ;
  PROVIDE ( esp_rom_spi_cmd_start = 0x4fc0010c ) ;
  PROVIDE ( esp_rom_spi_set_op_mode = 0x4fc00110 ) ;
  PROVIDE ( esp_rom_spi_set_dtr_swap_mode = 0x4fc00114 ) ;
  PROVIDE ( esp_rom_spiflash_wait_idle = 0x4fc00118 ) ;
  PROVIDE ( esp_rom_spiflash_write_encrypted = 0x4fc0011c ) ;
  PROVIDE ( esp_rom_spiflash_write_encrypted_dest = 0x4fc00120 ) ;
  PROVIDE ( esp_rom_spiflash_write_encrypted_enable = 0x4fc00124 ) ;
  PROVIDE ( esp_rom_spiflash_write_encrypted_disable = 0x4fc00128 ) ;
  PROVIDE ( esp_rom_spiflash_erase_chip = 0x4fc0012c ) ;
  PROVIDE ( _esp_rom_spiflash_erase_sector = 0x4fc00130 ) ;
  PROVIDE ( _esp_rom_spiflash_erase_block = 0x4fc00134 ) ;
  PROVIDE ( _esp_rom_spiflash_write = 0x4fc00138 ) ;
  PROVIDE ( _esp_rom_spiflash_read = 0x4fc0013c ) ;
  PROVIDE ( _esp_rom_spiflash_unlock = 0x4fc00140 ) ;
  PROVIDE ( _SPIEraseArea = 0x4fc00144 ) ;
  PROVIDE ( _SPI_write_enable = 0x4fc00148 ) ;
  PROVIDE ( esp_rom_spiflash_erase_sector = 0x4fc0014c ) ;
  PROVIDE ( esp_rom_spiflash_erase_block = 0x4fc00150 ) ;
  PROVIDE ( esp_rom_spiflash_write = 0x4fc00154 ) ;
  PROVIDE ( esp_rom_spiflash_read = 0x4fc00158 ) ;
  PROVIDE ( esp_rom_spiflash_unlock = 0x4fc0015c ) ;
  PROVIDE ( SPIEraseArea = 0x4fc00160 ) ;
  PROVIDE ( SPI_write_enable = 0x4fc00164 ) ;
  PROVIDE ( esp_rom_spiflash_config_param = 0x4fc00168 ) ;
  PROVIDE ( esp_rom_spiflash_read_user_cmd = 0x4fc0016c ) ;
  PROVIDE ( esp_rom_spiflash_select_qio_pins = 0x4fc00170 ) ;
  PROVIDE ( esp_rom_spi_flash_auto_sus_res = 0x4fc00174 ) ;
  PROVIDE ( esp_rom_spi_flash_send_resume = 0x4fc00178 ) ;
  PROVIDE ( esp_rom_spi_flash_update_id = 0x4fc0017c ) ;
  PROVIDE ( esp_rom_spiflash_config_clk = 0x4fc00180 ) ;
  PROVIDE ( esp_rom_spiflash_config_readmode = 0x4fc00184 ) ;
  PROVIDE ( esp_rom_spiflash_read_status = 0x4fc00188 ) ;
  PROVIDE ( esp_rom_spiflash_read_statushigh = 0x4fc0018c ) ;
  PROVIDE ( esp_rom_spiflash_write_status = 0x4fc00190 ) ;
  PROVIDE ( esp_rom_spiflash_write_disable = 0x4fc00194 ) ;
  PROVIDE ( spi_cache_mode_switch = 0x4fc00198 ) ;
  PROVIDE ( spi_common_set_dummy_output = 0x4fc0019c ) ;
  PROVIDE ( spi_common_set_flash_cs_timing = 0x4fc001a0 ) ;
  PROVIDE ( esp_rom_spi_set_address_bit_len = 0x4fc001a4 ) ;
  PROVIDE ( SPILock = 0x4fc001a8 ) ;
  PROVIDE ( SPIMasterReadModeCnfig = 0x4fc001ac ) ;
  PROVIDE ( SPI_Common_Command = 0x4fc001b0 ) ;
  PROVIDE ( SPI_WakeUp = 0x4fc001b4 ) ;
  PROVIDE ( SPI_block_erase = 0x4fc001b8 ) ;
  PROVIDE ( SPI_chip_erase = 0x4fc001bc ) ;
  PROVIDE ( SPI_init = 0x4fc001c0 ) ;
  PROVIDE ( SPI_page_program = 0x4fc001c4 ) ;
  PROVIDE ( SPI_read_data = 0x4fc001c8 ) ;
  PROVIDE ( SPI_sector_erase = 0x4fc001cc ) ;
  PROVIDE ( SelectSpiFunction = 0x4fc001d0 ) ;
  PROVIDE ( SetSpiDrvs = 0x4fc001d4 ) ;
  PROVIDE ( Wait_SPI_Idle = 0x4fc001d8 ) ;
  PROVIDE ( spi_dummy_len_fix = 0x4fc001dc ) ;
  PROVIDE ( Disable_QMode = 0x4fc001e0 ) ;
  PROVIDE ( Enable_QMode = 0x4fc001e4 ) ;
  PROVIDE ( spi_flash_attach = 0x4fc001e8 ) ;
  PROVIDE ( spi_flash_get_chip_size = 0x4fc001ec ) ;
  PROVIDE ( spi_flash_guard_set = 0x4fc001f0 ) ;
  PROVIDE ( spi_flash_guard_get = 0x4fc001f4 ) ;
  PROVIDE ( spi_flash_read_encrypted = 0x4fc001f8 ) ;
  PROVIDE ( rom_spiflash_legacy_funcs = 0x4ff3ffec ) ;
  PROVIDE ( rom_spiflash_legacy_data = 0x4ff3ffe8 ) ;
  PROVIDE ( g_flash_guard_ops = 0x4ff3fff0 ) ;
  PROVIDE ( Cache_Get_L1_ICache_Line_Size = 0x4fc003c4 ) ;
  PROVIDE ( Cache_Get_L1_DCache_Line_Size = 0x4fc003c8 ) ;
  PROVIDE ( Cache_Get_L2_Cache_Line_Size = 0x4fc003cc ) ;
  PROVIDE ( Cache_Get_Mode = 0x4fc003d0 ) ;
  PROVIDE ( Cache_Set_L2_Cache_Mode = 0x4fc003d4 ) ;
  PROVIDE ( Cache_Address_Through_Cache = 0x4fc003d8 ) ;
  PROVIDE ( ROM_Boot_Cache_Init = 0x4fc003dc ) ;
  PROVIDE ( Cache_Sync_Addr = 0x4fc003e0 ) ;
  PROVIDE ( Cache_Invalidate_Addr = 0x4fc003e4 ) ;
  PROVIDE ( Cache_Invalidate_Addr_Gid = 0x4fc003e8 ) ;
  PROVIDE ( Cache_Clean_Addr = 0x4fc003ec ) ;
  PROVIDE ( Cache_Clean_Addr_Gid = 0x4fc003f0 ) ;
  PROVIDE ( Cache_WriteBack_Addr = 0x4fc003f4 ) ;
  PROVIDE ( Cache_WriteBack_Addr_Gid = 0x4fc003f8 ) ;
  PROVIDE ( Cache_WriteBack_Invalidate_Addr = 0x4fc003fc ) ;
  PROVIDE ( Cache_WriteBack_Invalidate_Addr_Gid = 0x4fc00400 ) ;
  PROVIDE ( Cache_Invalidate_All = 0x4fc00404 ) ;
  PROVIDE ( Cache_Invalidate_All_Gid = 0x4fc00408 ) ;
  PROVIDE ( Cache_Clean_All = 0x4fc0040c ) ;
  PROVIDE ( Cache_Clean_All_Gid = 0x4fc00410 ) ;
  PROVIDE ( Cache_WriteBack_All = 0x4fc00414 ) ;
  PROVIDE ( Cache_WriteBack_All_Gid = 0x4fc00418 ) ;
  PROVIDE ( Cache_WriteBack_Invalidate_All = 0x4fc0041c ) ;
  PROVIDE ( Cache_WriteBack_Invalidate_All_Gid = 0x4fc00420 ) ;
  PROVIDE ( Cache_Mask_All = 0x4fc00424 ) ;
  PROVIDE ( Cache_Suspend_L1_CORE0_ICache_Autoload = 0x4fc00428 ) ;
  PROVIDE ( Cache_Resume_L1_CORE0_ICache_Autoload = 0x4fc0042c ) ;
  PROVIDE ( Cache_Suspend_L1_CORE1_ICache_Autoload = 0x4fc00430 ) ;
  PROVIDE ( Cache_Resume_L1_CORE1_ICache_Autoload = 0x4fc00434 ) ;
  PROVIDE ( Cache_Suspend_L1_DCache_Autoload = 0x4fc00438 ) ;
  PROVIDE ( Cache_Resume_L1_DCache_Autoload = 0x4fc0043c ) ;
  PROVIDE ( Cache_Suspend_L2_Cache_Autoload = 0x4fc00440 ) ;
  PROVIDE ( Cache_Resume_L2_Cache_Autoload = 0x4fc00444 ) ;
  PROVIDE ( Cache_Start_L1_CORE0_ICache_Preload = 0x4fc00448 ) ;
  PROVIDE ( Cache_L1_CORE0_ICache_Preload_Done = 0x4fc0044c ) ;
  PROVIDE ( Cache_End_L1_CORE0_ICache_Preload = 0x4fc00450 ) ;
  PROVIDE ( Cache_Start_L1_CORE1_ICache_Preload = 0x4fc00454 ) ;
  PROVIDE ( Cache_L1_CORE1_ICache_Preload_Done = 0x4fc00458 ) ;
  PROVIDE ( Cache_End_L1_CORE1_ICache_Preload = 0x4fc0045c ) ;
  PROVIDE ( Cache_Start_L1_DCache_Preload = 0x4fc00460 ) ;
  PROVIDE ( Cache_L1_DCache_Preload_Done = 0x4fc00464 ) ;
  PROVIDE ( Cache_End_L1_DCache_Preload = 0x4fc00468 ) ;
  PROVIDE ( Cache_Start_L2_Cache_Preload = 0x4fc0046c ) ;
  PROVIDE ( Cache_L2_Cache_Preload_Done = 0x4fc00470 ) ;
  PROVIDE ( Cache_End_L2_Cache_Preload = 0x4fc00474 ) ;
  PROVIDE ( Cache_Config_L1_CORE0_ICache_Autoload = 0x4fc00478 ) ;
  PROVIDE ( Cache_Enable_L1_CORE0_ICache_Autoload = 0x4fc0047c ) ;
  PROVIDE ( Cache_Disable_L1_CORE0_ICache_Autoload = 0x4fc00480 ) ;
  PROVIDE ( Cache_Config_L1_CORE1_ICache_Autoload = 0x4fc00484 ) ;
  PROVIDE ( Cache_Enable_L1_CORE1_ICache_Autoload = 0x4fc00488 ) ;
  PROVIDE ( Cache_Disable_L1_CORE1_ICache_Autoload = 0x4fc0048c ) ;
  PROVIDE ( Cache_Config_L1_DCache_Autoload = 0x4fc00490 ) ;
  PROVIDE ( Cache_Enable_L1_DCache_Autoload = 0x4fc00494 ) ;
  PROVIDE ( Cache_Disable_L1_DCache_Autoload = 0x4fc00498 ) ;
  PROVIDE ( Cache_Config_L2_Cache_Autoload = 0x4fc0049c ) ;
  PROVIDE ( Cache_Enable_L2_Cache_Autoload = 0x4fc004a0 ) ;
  PROVIDE ( Cache_Disable_L2_Cache_Autoload = 0x4fc004a4 ) ;
  PROVIDE ( Cache_Enable_L1_CORE0_ICache_PreLock = 0x4fc004a8 ) ;
  PROVIDE ( Cache_Disable_L1_CORE0_ICache_PreLock = 0x4fc004ac ) ;
  PROVIDE ( Cache_Enable_L1_CORE1_ICache_PreLock = 0x4fc004b0 ) ;
  PROVIDE ( Cache_Disable_L1_CORE1_ICache_PreLock = 0x4fc004b4 ) ;
  PROVIDE ( Cache_Enable_L1_DCache_PreLock = 0x4fc004b8 ) ;
  PROVIDE ( Cache_Disable_L1_DCache_PreLock = 0x4fc004bc ) ;
  PROVIDE ( Cache_Enable_L2_Cache_PreLock = 0x4fc004c0 ) ;
  PROVIDE ( Cache_Disable_L2_Cache_PreLock = 0x4fc004c4 ) ;
  PROVIDE ( Cache_Lock_Addr = 0x4fc004c8 ) ;
  PROVIDE ( Cache_Unlock_Addr = 0x4fc004cc ) ;
  PROVIDE ( Cache_Disable_L1_CORE0_ICache = 0x4fc004d0 ) ;
  PROVIDE ( Cache_Enable_L1_CORE0_ICache = 0x4fc004d4 ) ;
  PROVIDE ( Cache_Suspend_L1_CORE0_ICache = 0x4fc004d8 ) ;
  PROVIDE ( Cache_Resume_L1_CORE0_ICache = 0x4fc004dc ) ;
  PROVIDE ( Cache_Disable_L1_CORE1_ICache = 0x4fc004e0 ) ;
  PROVIDE ( Cache_Enable_L1_CORE1_ICache = 0x4fc004e4 ) ;
  PROVIDE ( Cache_Suspend_L1_CORE1_ICache = 0x4fc004e8 ) ;
  PROVIDE ( Cache_Resume_L1_CORE1_ICache = 0x4fc004ec ) ;
  PROVIDE ( Cache_Disable_L1_DCache = 0x4fc004f0 ) ;
  PROVIDE ( Cache_Enable_L1_DCache = 0x4fc004f4 ) ;
  PROVIDE ( Cache_Suspend_L1_DCache = 0x4fc004f8 ) ;
  PROVIDE ( Cache_Resume_L1_DCache = 0x4fc004fc ) ;
  PROVIDE ( Cache_Disable_L2_Cache = 0x4fc00500 ) ;
  PROVIDE ( Cache_Enable_L2_Cache = 0x4fc00504 ) ;
  PROVIDE ( Cache_Suspend_L2_Cache = 0x4fc00508 ) ;
  PROVIDE ( Cache_Resume_L2_Cache = 0x4fc0050c ) ;
  PROVIDE ( Cache_FLASH_MMU_Init = 0x4fc00510 ) ;
  PROVIDE ( Cache_PSRAM_MMU_Init = 0x4fc00514 ) ;
  PROVIDE ( Cache_FLASH_MMU_Set = 0x4fc00518 ) ;
  PROVIDE ( Cache_FLASH_MMU_Set_Secure = 0x4fc0051c ) ;
  PROVIDE ( Cache_PSRAM_MMU_Set = 0x4fc00520 ) ;
  PROVIDE ( Cache_PSRAM_MMU_Set_Secure = 0x4fc00524 ) ;
  PROVIDE ( Cache_Count_Flash_Pages = 0x4fc00528 ) ;
  PROVIDE ( Cache_Flash_To_SPIRAM_Copy = 0x4fc0052c ) ;
  PROVIDE ( Cache_Travel_Tag_Memory = 0x4fc00530 ) ;
  PROVIDE ( Cache_Travel_Tag_Memory2 = 0x4fc00534 ) ;
  PROVIDE ( Cache_Get_Virtual_Addr = 0x4fc00538 ) ;
  PROVIDE ( Cache_Set_IDROM_MMU_Size = 0x4fc0053c ) ;
  PROVIDE ( flash2spiram_instruction_offset = 0x4fc00540 ) ;
  PROVIDE ( flash2spiram_rodata_offset = 0x4fc00544 ) ;
  PROVIDE ( flash_instr_rodata_start_page = 0x4fc00548 ) ;
  PROVIDE ( flash_instr_rodata_end_page = 0x4fc0054c ) ;
  PROVIDE ( Cache_Set_IDROM_MMU_Info = 0x4fc00550 ) ;
  PROVIDE ( Cache_Get_IROM_MMU_End = 0x4fc00554 ) ;
  PROVIDE ( Cache_Get_DROM_MMU_End = 0x4fc00558 ) ;
  PROVIDE ( rom_cache_op_cb = 0x4ff3ffdc ) ;
  PROVIDE ( rom_cache_internal_table_ptr = 0x4ff3ffd8 ) ;
  PROVIDE ( ets_clk_get_xtal_freq = 0x4fc0055c ) ;
  PROVIDE ( ets_clk_get_cpu_freq = 0x4fc00560 ) ;
  PROVIDE ( rom_gpio_set_output_level = 0x4fc00564 ) ;
  PROVIDE ( rom_gpio_get_input_level = 0x4fc00568 ) ;
  PROVIDE ( rom_gpio_matrix_in = 0x4fc0056c ) ;
  PROVIDE ( rom_gpio_matrix_out = 0x4fc00570 ) ;
  PROVIDE ( rom_gpio_bypass_matrix_in = 0x4fc00574 ) ;
  PROVIDE ( rom_gpio_output_disable = 0x4fc00578 ) ;
  PROVIDE ( rom_gpio_output_enable = 0x4fc0057c ) ;
  PROVIDE ( rom_gpio_pad_input_disable = 0x4fc00580 ) ;
  PROVIDE ( rom_gpio_pad_input_enable = 0x4fc00584 ) ;
  PROVIDE ( rom_gpio_pad_pulldown = 0x4fc00588 ) ;
  PROVIDE ( rom_gpio_pad_pullup = 0x4fc0058c ) ;
  PROVIDE ( rom_gpio_pad_select_gpio = 0x4fc00590 ) ;
  PROVIDE ( rom_gpio_pad_set_drv = 0x4fc00594 ) ;
  PROVIDE ( rom_gpio_pad_unhold = 0x4fc00598 ) ;
  PROVIDE ( rom_gpio_pad_hold = 0x4fc0059c ) ;
  PROVIDE ( rom_gpio_lppad_select_mux = 0x4fc005a0 ) ;
  PROVIDE ( rom_gpio_ded_pad_set_drv = 0x4fc005a4 ) ;
  PROVIDE ( rom_gpio_ded_pad_pullup = 0x4fc005a8 ) ;
  PROVIDE ( rom_gpio_ded_pad_pulldown = 0x4fc005ac ) ;
  PROVIDE ( rom_gpio_ded_pad_hold = 0x4fc005b0 ) ;
  PROVIDE ( rom_gpio_ded_pad_unhold = 0x4fc005b4 ) ;
  PROVIDE ( esprv_intc_int_set_priority = 0x4fc005b8 ) ;
  PROVIDE ( esprv_intc_int_set_threshold = 0x4fc005bc ) ;
  PROVIDE ( esprv_intc_int_enable = 0x4fc005c0 ) ;
  PROVIDE ( esprv_intc_int_disable = 0x4fc005c4 ) ;
  PROVIDE ( intr_handler_set = 0x4fc005cc ) ;
  PROVIDE ( intr_matrix_set = 0x4fc005d0 ) ;
  PROVIDE ( ets_intr_lock = 0x4fc005d4 ) ;
  PROVIDE ( ets_intr_unlock = 0x4fc005d8 ) ;
  PROVIDE ( ets_isr_attach = 0x4fc005dc ) ;
  PROVIDE ( ets_isr_mask = 0x4fc005e0 ) ;
  PROVIDE ( ets_isr_unmask = 0x4fc005e4 ) ;
  PROVIDE ( md5_vector = 0x4fc005e8 ) ;
  PROVIDE ( MD5Init = 0x4fc005ec ) ;
  PROVIDE ( MD5Update = 0x4fc005f0 ) ;
  PROVIDE ( MD5Final = 0x4fc005f4 ) ;
  PROVIDE ( crc32_le = 0x4fc005f8 ) ;
  PROVIDE ( crc16_le = 0x4fc005fc ) ;
  PROVIDE ( crc8_le = 0x4fc00600 ) ;
  PROVIDE ( crc32_be = 0x4fc00604 ) ;
  PROVIDE ( crc16_be = 0x4fc00608 ) ;
  PROVIDE ( crc8_be = 0x4fc0060c ) ;
  PROVIDE ( esp_crc8 = 0x4fc00610 ) ;
  PROVIDE ( ets_sha_enable = 0x4fc00614 ) ;
  PROVIDE ( ets_sha_disable = 0x4fc00618 ) ;
  PROVIDE ( ets_sha_get_state = 0x4fc0061c ) ;
  PROVIDE ( ets_sha_init = 0x4fc00620 ) ;
  PROVIDE ( ets_sha_process = 0x4fc00624 ) ;
  PROVIDE ( ets_sha_starts = 0x4fc00628 ) ;
  PROVIDE ( ets_sha_update = 0x4fc0062c ) ;
  PROVIDE ( ets_sha_finish = 0x4fc00630 ) ;
  PROVIDE ( ets_sha_clone = 0x4fc00634 ) ;
  PROVIDE ( ets_hmac_enable = 0x4fc00638 ) ;
  PROVIDE ( ets_hmac_disable = 0x4fc0063c ) ;
  PROVIDE ( ets_hmac_calculate_message = 0x4fc00640 ) ;
  PROVIDE ( ets_hmac_calculate_downstream = 0x4fc00644 ) ;
  PROVIDE ( ets_hmac_invalidate_downstream = 0x4fc00648 ) ;
  PROVIDE ( ets_jtag_enable_temporarily = 0x4fc0064c ) ;
  PROVIDE ( ets_aes_enable = 0x4fc00650 ) ;
  PROVIDE ( ets_aes_disable = 0x4fc00654 ) ;
  PROVIDE ( ets_aes_setkey = 0x4fc00658 ) ;
  PROVIDE ( ets_aes_block = 0x4fc0065c ) ;
  PROVIDE ( ets_aes_setkey_dec = 0x4fc00660 ) ;
  PROVIDE ( ets_aes_setkey_enc = 0x4fc00664 ) ;
  PROVIDE ( ets_bigint_enable = 0x4fc00668 ) ;
  PROVIDE ( ets_bigint_disable = 0x4fc0066c ) ;
  PROVIDE ( ets_bigint_multiply = 0x4fc00670 ) ;
  PROVIDE ( ets_bigint_modmult = 0x4fc00674 ) ;
  PROVIDE ( ets_bigint_modexp = 0x4fc00678 ) ;
  PROVIDE ( ets_bigint_wait_finish = 0x4fc0067c ) ;
  PROVIDE ( ets_bigint_getz = 0x4fc00680 ) ;
  PROVIDE ( ets_ds_enable = 0x4fc00684 ) ;
  PROVIDE ( ets_ds_disable = 0x4fc00688 ) ;
  PROVIDE ( ets_ds_start_sign = 0x4fc0068c ) ;
  PROVIDE ( ets_ds_is_busy = 0x4fc00690 ) ;
  PROVIDE ( ets_ds_finish_sign = 0x4fc00694 ) ;
  PROVIDE ( ets_ds_encrypt_params = 0x4fc00698 ) ;
  PROVIDE ( ets_mgf1_sha256 = 0x4fc0069c ) ;
  PROVIDE ( crc32_le_table_ptr = 0x4fc1fff8 ) ;
  PROVIDE ( crc16_le_table_ptr = 0x4fc1fff4 ) ;
  PROVIDE ( crc8_le_table_ptr = 0x4fc1fff0 ) ;
  PROVIDE ( crc32_be_table_ptr = 0x4fc1ffec ) ;
  PROVIDE ( crc16_be_table_ptr = 0x4fc1ffe8 ) ;
  PROVIDE ( crc8_be_table_ptr = 0x4fc1ffe4 ) ;
  PROVIDE ( ets_efuse_read = 0x4fc006a0 ) ;
  PROVIDE ( ets_efuse_program = 0x4fc006a4 ) ;
  PROVIDE ( ets_efuse_clear_program_registers = 0x4fc006a8 ) ;
  PROVIDE ( ets_efuse_write_key = 0x4fc006ac ) ;
  PROVIDE ( ets_efuse_get_read_register_address = 0x4fc006b0 ) ;
  PROVIDE ( ets_efuse_get_key_purpose = 0x4fc006b4 ) ;
  PROVIDE ( ets_efuse_key_block_unused = 0x4fc006b8 ) ;
  PROVIDE ( ets_efuse_find_unused_key_block = 0x4fc006bc ) ;
  PROVIDE ( ets_efuse_rs_calculate = 0x4fc006c0 ) ;
  PROVIDE ( ets_efuse_count_unused_key_blocks = 0x4fc006c4 ) ;
  PROVIDE ( ets_efuse_secure_boot_enabled = 0x4fc006c8 ) ;
  PROVIDE ( ets_efuse_secure_boot_aggressive_revoke_enabled = 0x4fc006cc ) ;
  PROVIDE ( ets_efuse_cache_encryption_enabled = 0x4fc006d0 ) ;
  PROVIDE ( ets_efuse_download_modes_disabled = 0x4fc006d4 ) ;
  PROVIDE ( ets_efuse_find_purpose = 0x4fc006d8 ) ;
  PROVIDE ( ets_efuse_force_send_resume = 0x4fc006dc ) ;
  PROVIDE ( ets_efuse_get_flash_delay_us = 0x4fc006e0 ) ;
  PROVIDE ( ets_efuse_get_uart_print_control = 0x4fc006e4 ) ;
  PROVIDE ( ets_efuse_direct_boot_mode_disabled = 0x4fc006e8 ) ;
  PROVIDE ( ets_efuse_security_download_modes_enabled = 0x4fc006ec ) ;
  PROVIDE ( ets_efuse_jtag_disabled = 0x4fc006f0 ) ;
  PROVIDE ( ets_efuse_usb_print_is_disabled = 0x4fc006f4 ) ;
  PROVIDE ( ets_efuse_usb_download_mode_disabled = 0x4fc006f8 ) ;
  PROVIDE ( ets_efuse_usb_device_disabled = 0x4fc006fc ) ;
  PROVIDE ( ets_efuse_get_km_huk_gen_state = 0x4fc00700 ) ;
  PROVIDE ( ets_efuse_get_km_deploy_only_once = 0x4fc00704 ) ;
  PROVIDE ( ets_efuse_get_force_use_km_key = 0x4fc00708 ) ;
  PROVIDE ( ets_efuse_xts_key_length_256 = 0x4fc0070c ) ;
  PROVIDE ( ets_efuse_get_km_key_lock = 0x4fc00710 ) ;
  PROVIDE ( esp_rom_check_recover_key = 0x4fc00714 ) ;
  PROVIDE ( esp_rom_km_huk_conf = 0x4fc00718 ) ;
  PROVIDE ( esp_rom_km_huk_risk = 0x4fc0071c ) ;
  PROVIDE ( ets_emsa_pss_verify = 0x4fc00720 ) ;
  PROVIDE ( ets_rsa_pss_verify = 0x4fc00724 ) ;
  PROVIDE ( _rom_ets_ecdsa_verify = 0x4fc00728 ) ;
  PROVIDE ( _rom_ets_secure_boot_verify_signature = 0x4fc00730 ) ;
  PROVIDE ( ets_secure_boot_read_key_digests = 0x4fc00734 ) ;
  PROVIDE ( ets_secure_boot_revoke_public_key_digest = 0x4fc00738 ) ;
  PROVIDE ( usb_serial_device_rx_one_char = 0x4fc008b0 ) ;
  PROVIDE ( usb_serial_device_rx_one_char_block = 0x4fc008b4 ) ;
  PROVIDE ( usb_serial_device_tx_flush = 0x4fc008b8 ) ;
  PROVIDE ( usb_serial_device_tx_one_char = 0x4fc008bc ) ;
  PROVIDE ( Uart_Init_USB = 0x4fc008c0 ) ;
  PROVIDE ( usb_serial_otg_rx_one_char = 0x4fc008c4 ) ;
  PROVIDE ( usb_serial_otg_rx_one_char_block = 0x4fc008c8 ) ;
  PROVIDE ( usb_serial_otg_tx_flush = 0x4fc008cc ) ;
  PROVIDE ( usb_serial_otg_tx_one_char = 0x4fc008d0 ) ;
  PROVIDE ( uart_acm_dev = 0x4ff3ffd4 ) ;
  PROVIDE ( cdc_acm_class_handle_req = 0x4fc008d4 ) ;
  PROVIDE ( cdc_acm_init = 0x4fc008d8 ) ;
  PROVIDE ( cdc_acm_fifo_fill = 0x4fc008dc ) ;
  PROVIDE ( cdc_acm_rx_fifo_cnt = 0x4fc008e0 ) ;
  PROVIDE ( cdc_acm_fifo_read = 0x4fc008e4 ) ;
  PROVIDE ( cdc_acm_irq_tx_enable = 0x4fc008e8 ) ;
  PROVIDE ( cdc_acm_irq_tx_disable = 0x4fc008ec ) ;
  PROVIDE ( cdc_acm_irq_state_enable = 0x4fc008f0 ) ;
  PROVIDE ( cdc_acm_irq_state_disable = 0x4fc008f4 ) ;
  PROVIDE ( cdc_acm_irq_tx_ready = 0x4fc008f8 ) ;
  PROVIDE ( cdc_acm_irq_rx_enable = 0x4fc008fc ) ;
  PROVIDE ( cdc_acm_irq_rx_disable = 0x4fc00900 ) ;
  PROVIDE ( cdc_acm_irq_rx_ready = 0x4fc00904 ) ;
  PROVIDE ( cdc_acm_irq_is_pending = 0x4fc00908 ) ;
  PROVIDE ( cdc_acm_irq_callback_set = 0x4fc0090c ) ;
  PROVIDE ( cdc_acm_line_ctrl_set = 0x4fc00910 ) ;
  PROVIDE ( cdc_acm_line_ctrl_get = 0x4fc00914 ) ;
  PROVIDE ( cdc_acm_poll_out = 0x4fc00918 ) ;
  PROVIDE ( chip_usb_dw_did_persist = 0x4fc0091c ) ;
  PROVIDE ( chip_usb_dw_init = 0x4fc00920 ) ;
  PROVIDE ( chip_usb_detach = 0x4fc00924 ) ;
  PROVIDE ( chip_usb_dw_prepare_persist = 0x4fc00928 ) ;
  PROVIDE ( chip_usb_get_persist_flags = 0x4fc0092c ) ;
  PROVIDE ( chip_usb_set_persist_flags = 0x4fc00930 ) ;
  PROVIDE ( cpio_start = 0x4fc00934 ) ;
  PROVIDE ( cpio_feed = 0x4fc00938 ) ;
  PROVIDE ( cpio_done = 0x4fc0093c ) ;
  PROVIDE ( cpio_destroy = 0x4fc00940 ) ;
  PROVIDE ( dfu_flash_init = 0x4fc00944 ) ;
  PROVIDE ( dfu_flash_erase = 0x4fc00948 ) ;
  PROVIDE ( dfu_flash_program = 0x4fc0094c ) ;
  PROVIDE ( dfu_flash_read = 0x4fc00950 ) ;
  PROVIDE ( dfu_flash_attach = 0x4fc00954 ) ;
  PROVIDE ( dfu_cpio_callback = 0x4fc00958 ) ;
  PROVIDE ( dfu_updater_get_err = 0x4fc0095c ) ;
  PROVIDE ( dfu_updater_clear_err = 0x4fc00960 ) ;
  PROVIDE ( dfu_updater_enable = 0x4fc00964 ) ;
  PROVIDE ( dfu_updater_begin = 0x4fc00968 ) ;
  PROVIDE ( dfu_updater_feed = 0x4fc0096c ) ;
  PROVIDE ( dfu_updater_end = 0x4fc00970 ) ;
  PROVIDE ( dfu_updater_set_raw_addr = 0x4fc00974 ) ;
  PROVIDE ( dfu_updater_flash_read = 0x4fc00978 ) ;
  PROVIDE ( usb_dc_prepare_persist = 0x4fc0097c ) ;
  PROVIDE ( usb_dw_isr_handler = 0x4fc00980 ) ;
  PROVIDE ( usb_dc_attach = 0x4fc00984 ) ;
  PROVIDE ( usb_dc_detach = 0x4fc00988 ) ;
  PROVIDE ( usb_dc_reset = 0x4fc0098c ) ;
  PROVIDE ( usb_dc_set_address = 0x4fc00990 ) ;
  PROVIDE ( usb_dc_ep_check_cap = 0x4fc00994 ) ;
  PROVIDE ( usb_dc_ep_configure = 0x4fc00998 ) ;
  PROVIDE ( usb_dc_ep_set_stall = 0x4fc0099c ) ;
  PROVIDE ( usb_dc_ep_clear_stall = 0x4fc009a0 ) ;
  PROVIDE ( usb_dc_ep_halt = 0x4fc009a4 ) ;
  PROVIDE ( usb_dc_ep_is_stalled = 0x4fc009a8 ) ;
  PROVIDE ( usb_dc_ep_enable = 0x4fc009ac ) ;
  PROVIDE ( usb_dc_ep_disable = 0x4fc009b0 ) ;
  PROVIDE ( usb_dc_ep_flush = 0x4fc009b4 ) ;
  PROVIDE ( usb_dc_ep_write_would_block = 0x4fc009b8 ) ;
  PROVIDE ( usb_dc_ep_write = 0x4fc009bc ) ;
  PROVIDE ( usb_dc_ep_read_wait = 0x4fc009c0 ) ;
  PROVIDE ( usb_dc_ep_read_continue = 0x4fc009c4 ) ;
  PROVIDE ( usb_dc_ep_read = 0x4fc009c8 ) ;
  PROVIDE ( usb_dc_ep_set_callback = 0x4fc009cc ) ;
  PROVIDE ( usb_dc_set_status_callback = 0x4fc009d0 ) ;
  PROVIDE ( usb_dc_ep_mps = 0x4fc009d4 ) ;
  PROVIDE ( usb_dc_check_poll_for_interrupts = 0x4fc009d8 ) ;
  PROVIDE ( mac_addr_to_serial_str_desc = 0x4fc009dc ) ;
  PROVIDE ( usb_set_current_descriptor = 0x4fc009e0 ) ;
  PROVIDE ( usb_get_descriptor = 0x4fc009e4 ) ;
  PROVIDE ( usb_dev_resume = 0x4fc009e8 ) ;
  PROVIDE ( usb_dev_get_configuration = 0x4fc009ec ) ;
  PROVIDE ( usb_set_config = 0x4fc009f0 ) ;
  PROVIDE ( usb_deconfig = 0x4fc009f4 ) ;
  PROVIDE ( usb_enable = 0x4fc009f8 ) ;
  PROVIDE ( usb_disable = 0x4fc009fc ) ;
  PROVIDE ( usb_write_would_block = 0x4fc00a00 ) ;
  PROVIDE ( usb_write = 0x4fc00a04 ) ;
  PROVIDE ( usb_read = 0x4fc00a08 ) ;
  PROVIDE ( usb_ep_set_stall = 0x4fc00a0c ) ;
  PROVIDE ( usb_ep_clear_stall = 0x4fc00a10 ) ;
  PROVIDE ( usb_ep_read_wait = 0x4fc00a14 ) ;
  PROVIDE ( usb_ep_read_continue = 0x4fc00a18 ) ;
  PROVIDE ( usb_transfer_ep_callback = 0x4fc00a1c ) ;
  PROVIDE ( usb_transfer = 0x4fc00a20 ) ;
  PROVIDE ( usb_cancel_transfer = 0x4fc00a24 ) ;
  PROVIDE ( usb_transfer_sync = 0x4fc00a28 ) ;
  PROVIDE ( usb_dfu_set_detach_cb = 0x4fc00a2c ) ;
  PROVIDE ( dfu_class_handle_req = 0x4fc00a30 ) ;
  PROVIDE ( dfu_status_cb = 0x4fc00a34 ) ;
  PROVIDE ( dfu_custom_handle_req = 0x4fc00a38 ) ;
  PROVIDE ( usb_dfu_init = 0x4fc00a3c ) ;
  PROVIDE ( usb_dfu_force_detach = 0x4fc00a40 ) ;
  PROVIDE ( usb_dev_deinit = 0x4fc00a44 ) ;
  PROVIDE ( usb_dw_ctrl_deinit = 0x4fc00a48 ) ;
  PROVIDE ( s_usb_osglue = 0x4ff3ffc8 ) ;
PROVIDE ( esp_rom_crc32_le = crc32_le );
PROVIDE ( esp_rom_crc16_le = crc16_le );
PROVIDE ( esp_rom_crc8_le  = crc8_le );
PROVIDE ( esp_rom_crc32_be = crc32_be );
PROVIDE ( esp_rom_crc16_be = crc16_be );
PROVIDE ( esp_rom_crc8_be  = crc8_be );
PROVIDE ( esp_rom_gpio_pad_select_gpio    = rom_gpio_pad_select_gpio );
PROVIDE ( esp_rom_gpio_pad_pullup_only    = rom_gpio_pad_pullup );
PROVIDE ( esp_rom_gpio_pad_set_drv        = rom_gpio_pad_set_drv );
PROVIDE ( esp_rom_gpio_pad_unhold         = rom_gpio_pad_unhold );
PROVIDE ( esp_rom_gpio_connect_in_signal  = rom_gpio_matrix_in );
PROVIDE ( esp_rom_gpio_connect_out_signal = rom_gpio_matrix_out );
PROVIDE ( esp_rom_efuse_mac_address_crc8       = esp_crc8 );
PROVIDE ( esp_rom_efuse_is_secure_boot_enabled = ets_efuse_secure_boot_enabled );
PROVIDE ( esp_rom_uart_flush_tx       = uart_tx_flush );
PROVIDE ( esp_rom_uart_tx_one_char    = uart_tx_one_char2 );
PROVIDE ( esp_rom_uart_tx_wait_idle   = uart_tx_wait_idle );
PROVIDE ( esp_rom_uart_rx_one_char    = uart_rx_one_char );
PROVIDE ( esp_rom_uart_rx_string      = UartRxString );
PROVIDE ( esp_rom_uart_set_as_console = uart_tx_switch );
PROVIDE ( esp_rom_uart_putc           = ets_write_char_uart );
PROVIDE ( esp_rom_usb_serial_putc     = uart_tx_one_char3 );
PROVIDE ( esp_rom_output_flush_tx       = uart_tx_flush );
PROVIDE ( esp_rom_output_tx_one_char    = uart_tx_one_char );
PROVIDE ( esp_rom_output_tx_wait_idle   = uart_tx_wait_idle );
PROVIDE ( esp_rom_output_rx_one_char    = uart_rx_one_char );
PROVIDE ( esp_rom_output_rx_string      = UartRxString );
PROVIDE ( esp_rom_output_set_as_console = uart_tx_switch );
PROVIDE ( esp_rom_output_putc           = ets_write_char_uart );
PROVIDE ( esp_rom_md5_init   = MD5Init );
PROVIDE ( esp_rom_md5_update = MD5Update );
PROVIDE ( esp_rom_md5_final  = MD5Final );
PROVIDE ( esp_rom_software_reset_system = software_reset );
PROVIDE ( esp_rom_software_reset_cpu    = software_reset_cpu );
PROVIDE ( esp_rom_printf   = ets_printf );
PROVIDE ( esp_rom_install_uart_printf = ets_install_uart_printf );
PROVIDE ( esp_rom_delay_us = ets_delay_us );
PROVIDE ( esp_rom_get_reset_reason = rtc_get_reset_reason );
PROVIDE ( esp_rom_route_intr_matrix = intr_matrix_set );
PROVIDE ( esp_rom_get_cpu_ticks_per_us = ets_get_cpu_frequency );
PROVIDE ( esp_rom_set_cpu_ticks_per_us = ets_update_cpu_frequency );
PROVIDE ( esp_rom_spiflash_attach = spi_flash_attach );
PROVIDE ( esp_rom_spiflash_clear_bp = esp_rom_spiflash_unlock );
PROVIDE ( esp_rom_spiflash_write_enable = SPI_write_enable );
PROVIDE ( esp_rom_spiflash_erase_area = SPIEraseArea );
PROVIDE ( esp_rom_spiflash_fix_dummylen = spi_dummy_len_fix );
PROVIDE ( esp_rom_spiflash_set_drvs = SetSpiDrvs);
PROVIDE ( esp_rom_spiflash_select_padsfunc = SelectSpiFunction );
PROVIDE ( esp_rom_spiflash_common_cmd = SPI_Common_Command );
}
